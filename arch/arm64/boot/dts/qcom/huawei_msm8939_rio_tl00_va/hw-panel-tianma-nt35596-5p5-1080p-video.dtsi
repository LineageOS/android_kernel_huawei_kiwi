/* Copyright (c) 2013, The Linux Foundation. All rights reserved.
 *
 * This program is free software; you can redistribute it and/or modify
 * it under the terms of the GNU General Public License version 2 and
 * only version 2 as published by the Free Software Foundation.
 *
 * This program is distributed in the hope that it will be useful,
 * but WITHOUT ANY WARRANTY; without even the implied warranty of
 * MERCHANTABILITY or FITNESS FOR A PARTICULAR PURPOSE.  See the
 * GNU General Public License for more details.
 */

/*---------------------------------------------------------------------------
 * This file is autogenerated file using gcdb parser. Please do not edit it.
 * Update input XML file to add a new entry or update variable in this file
 * VERSION = "1.0"
 *---------------------------------------------------------------------------*/
&mdss_mdp {
	dsi_tianma_nt35596_5p5_1080p_video: qcom,mdss_dsi_tianma_nt35596_5p5_1080p_video {
		qcom,mdss-dsi-panel-name = "TIANMA_NT35596_5P5_1080P_VIDEO";
		qcom,cont-splash-enabled;
		qcom,mdss-dsi-panel-controller = <&mdss_dsi0>;
		qcom,mdss-dsi-panel-type = "dsi_video_mode";
		qcom,mdss-dsi-panel-destination = "display_1";
		qcom,mdss-dsi-panel-clockrate = <898000000>;
		qcom,mdss-dsi-panel-framerate = <60>;
		qcom,mdss-dsi-virtual-channel-id = <0>;
		qcom,mdss-dsi-stream = <0>;
		qcom,mdss-dsi-panel-width = <1080>;
		qcom,mdss-dsi-panel-height = <1920>;
		qcom,mdss-dsi-h-front-porch = <108>;
		qcom,mdss-dsi-h-back-porch = <96>;
		qcom,mdss-dsi-h-pulse-width = <8>;
		qcom,mdss-dsi-h-sync-skew = <0>;
		qcom,mdss-dsi-v-back-porch = <3>;
		qcom,mdss-dsi-v-front-porch = <7>;
		qcom,mdss-dsi-v-pulse-width = <2>;
		qcom,mdss-dsi-h-left-border = <0>;
		qcom,mdss-dsi-h-right-border = <0>;
		qcom,mdss-dsi-v-top-border = <0>;
		qcom,mdss-dsi-v-bottom-border = <0>;
		qcom,mdss-dsi-bpp = <24>;
		qcom,mdss-dsi-underflow-color = <0x00>;
		qcom,mdss-dsi-border-color = <0>;
		qcom,mdss-dsi-color-order = "rgb_swap_rgb";
		qcom,mdss-dsi-on-command = [29 01 00 00 00 00 02 FF EE
					29 01 00 00 00 00 02 FB 01
					29 01 00 00 0a 00 02 18 40
					29 01 00 00 14 00 02 18 00
					29 01 00 00 00 00 02 FF 03
					29 01 00 00 00 00 02 FB 01
					29 01 00 00 00 00 02 00 50
					29 01 00 00 00 00 02 01 50
					29 01 00 00 00 00 02 02 50
					29 01 00 00 00 00 02 03 50
					29 01 00 00 00 00 02 04 50
					29 01 00 00 00 00 02 05 50
					29 01 00 00 00 00 02 06 50
					29 01 00 00 00 00 02 07 50
					29 01 00 00 00 00 02 08 50
					29 01 00 00 00 00 02 09 46
					29 01 00 00 00 00 02 0A 3C
					29 01 00 00 00 00 02 0B 32
					29 01 00 00 00 00 02 0C 28
					29 01 00 00 00 00 02 0D 20
					29 01 00 00 00 00 02 0E 18
					29 01 00 00 00 00 02 0F 10
					29 01 00 00 00 00 02 10 00
					29 01 00 00 00 00 02 11 00
					29 01 00 00 00 00 02 12 00
					29 01 00 00 00 00 02 13 00
					29 01 00 00 00 00 02 32 00
					29 01 00 00 00 00 02 33 00
					29 01 00 00 00 00 02 34 00
					29 01 00 00 00 00 02 35 02
					29 01 00 00 00 00 02 36 06
					29 01 00 00 00 00 02 37 0D
					29 01 00 00 00 00 02 38 0D
					29 01 00 00 00 00 02 39 10
					29 01 00 00 00 00 02 3A 10
					29 01 00 00 00 00 02 3B 0E
					29 01 00 00 00 00 02 3F 10
					29 01 00 00 00 00 02 40 12
					29 01 00 00 00 00 02 41 14
					29 01 00 00 00 00 02 42 14
					29 01 00 00 00 00 02 43 12
					29 01 00 00 00 00 02 44 10
					29 01 00 00 00 00 02 45 0E
					29 01 00 00 00 00 02 46 0C
					29 01 00 00 00 00 02 47 0A
					29 01 00 00 00 00 02 48 08
					29 01 00 00 00 00 02 49 06
					29 01 00 00 00 00 02 4A 04
					29 01 00 00 00 00 02 4B 02
					29 01 00 00 00 00 02 4C 00
					29 01 00 00 00 00 02 4E 05
					29 01 00 00 00 00 02 1A 00
					29 01 00 00 00 00 02 53 77
					29 01 00 00 00 00 02 54 00
					29 01 00 00 00 00 02 55 77
					29 01 00 00 00 00 02 5B 00
					29 01 00 00 00 00 02 63 00
					29 01 00 00 00 00 02 FF 04
					29 01 00 00 00 00 02 FB 01
					29 01 00 00 00 00 02 13 F3
					29 01 00 00 00 00 02 14 F2
					29 01 00 00 00 00 02 15 F1
					29 01 00 00 00 00 02 16 F0
					29 01 00 00 00 00 02 21 FF
					29 01 00 00 00 00 02 22 F4
					29 01 00 00 00 00 02 23 E9
					29 01 00 00 00 00 02 24 DE
					29 01 00 00 00 00 02 25 D3
					29 01 00 00 00 00 02 26 C8
					29 01 00 00 00 00 02 27 BD
					29 01 00 00 00 00 02 28 B2
					29 01 00 00 00 00 02 29 A7
					29 01 00 00 00 00 02 2A 9C
					29 01 00 00 00 00 02 FF 04
					29 01 00 00 00 00 02 FB 01
					29 01 00 00 00 00 02 07 20
					29 01 00 00 00 00 02 08 06
					29 01 00 00 00 00 02 FF 05
					29 01 00 00 00 00 02 FB 01
					29 01 00 00 00 00 02 C5 31
					29 01 00 00 00 00 02 FF 00
					29 01 00 00 00 00 02 FB 01
					29 01 00 00 00 00 02 35 00
					15 01 00 00 00 00 02 53 24
					15 01 00 00 00 00 02 55 91
					15 01 00 00 00 00 02 5E 28
					15 01 00 00 00 00 02 51 00
					15 01 00 00 00 00 02 D3 05
					15 01 00 00 00 00 02 D4 07
					05 01 00 00 78 00 02 11 00
					05 01 00 00 28 00 02 29 00];
		qcom,mdss-dsi-off-command = [29 01 00 00 00 00 02 FF 00
					29 01 00 00 00 00 02 FB 01
					05 01 00 00 28 00 02 28 00
					05 01 00 00 78 00 02 10 00];
		qcom,mdss-dsi-on-command-state = "dsi_lp_mode";
		qcom,mdss-dsi-off-command-state = "dsi_hs_mode";
		qcom,mdss-dsi-h-sync-pulse = <1>;
		qcom,mdss-dsi-traffic-mode = "burst_mode";
		qcom,mdss-dsi-lane-map = "lane_map_0123";
		qcom,mdss-dsi-bllp-eof-power-mode;
		qcom,mdss-dsi-bllp-power-mode;
		qcom,mdss-dsi-lane-0-state;
		qcom,mdss-dsi-lane-1-state;
		qcom,mdss-dsi-lane-2-state;
		qcom,mdss-dsi-lane-3-state;
		qcom,mdss-dsi-panel-timings = [e6 38 26 00 68 6e 2a 3c 2c 03 04 00];
		qcom,mdss-dsi-t-clk-post = <0x1e>;
		qcom,mdss-dsi-t-clk-pre = <0x38>;
		qcom,mdss-dsi-bl-min-level = <4>;
		qcom,mdss-dsi-bl-max-level = <250>;
		qcom,mdss-dsi-dma-trigger = "trigger_sw";
		qcom,mdss-dsi-mdp-trigger = "none";
		qcom,mdss-dsi-bl-pmic-control-type = "bl_ctrl_dcs";
		qcom,panel-cabc-ui-cmds = [29 01 00 00 00 00 02 FF 00
					29 01 00 00 00 00 02 FB 01
					15 01 00 00 00 00 02 55 91
					15 01 00 00 00 00 02 53 24
					29 01 00 00 00 00 02 FF 04 
					29 01 00 00 00 00 02 FB 01
					29 01 00 00 00 00 02 13 F3
					29 01 00 00 00 00 02 14 F2
					29 01 00 00 00 00 02 15 F1
					29 01 00 00 00 00 02 16 F0
					29 01 00 00 00 00 02 FF 00
					29 01 00 00 00 00 02 FB 01
					];
		qcom,panel-cabc-video-cmds = [29 01 00 00 00 00 02 FF 00
					29 01 00 00 00 00 02 FB 01
					15 01 00 00 00 00 02 55 93
					15 01 00 00 00 00 02 53 2C
					29 01 00 00 00 00 02 FF 04
					29 01 00 00 00 00 02 FB 01
					29 01 00 00 00 00 02 21 FF
					29 01 00 00 00 00 02 22 F4
					29 01 00 00 00 00 02 23 E9
					29 01 00 00 00 00 02 24 DE
					29 01 00 00 00 00 02 25 D3
					29 01 00 00 00 00 02 26 C8
					29 01 00 00 00 00 02 27 BD
					29 01 00 00 00 00 02 28 B2
					29 01 00 00 00 00 02 29 A7
					29 01 00 00 00 00 02 2A 9C
					29 01 00 00 00 00 02 FF 00
					29 01 00 00 00 00 02 FB 01
					];
		qcom,cabc-ui-cmds-dsi-state = "dsi_lp_mode";
		qcom,cabc-video-cmds-dsi-state = "dsi_lp_mode";
		qcom,panel-dot-inversion-mode-cmds = [29 01 00 00 00 00 02 FF 05
					29 01 00 00 00 00 02 FB 01
					29 01 00 00 00 00 02 9B 01
					29 01 00 00 00 00 02 FF 00
					29 01 00 00 00 00 02 FB 01];
		qcom,panel-column-inversion-mode-cmds = [29 01 00 00 00 00 02 FF 05
					29 01 00 00 00 00 02 FB 01
					29 01 00 00 00 00 02 9B 0F
					29 01 00 00 00 00 02 FF 00
					29 01 00 00 00 00 02 FB 01];
		qcom,dot-inversion-cmds-dsi-state = "dsi_lp_mode";
		qcom,column-inversion-cmds-dsi-state = "dsi_lp_mode";
		qcom,panel-frame_crc_enable_cmds = [29 01 00 00 00 00 02 FF FF
					29 01 00 00 00 00 02 7B 00
					15 01 00 00 00 00 02 92 01];
		qcom,panel-frame_crc_disable_cmds = [29 01 00 00 00 00 02 FF FF
					15 01 00 00 00 00 02 92 00
					29 01 00 00 00 00 02 FF 00
					29 01 00 00 00 00 02 FB 01];
		qcom,panel-frame_crc_read_cmds = [73 74 75 76 77 78 79 7a];
		qcom,panel-frame-checksum-support;
		qcom,panel-frame_crc_read_cmds_value = [f2 e9 b9 50 55 36 43 60
					74 50 e3 27 54 07 cf ba
					8a fb 62 b5 a2 7e 61 24];
		qcom,frame-checksum-enable-dsi-state = "dsi_lp_mode";
		qcom,frame-checksum-disable-dsi-state = "dsi_lp_mode";
		qcom,mdss-dsi-lp11-init;
		qcom,mdss-pan-physical-width-dimension = <68>;
		qcom,mdss-pan-physical-height-dimension = <121>;
			qcom,mdss-dsi-reset-sequence = <1 1>, <0 5>, <1 15>;

	};
};
