 / {
        huawei_fac_info {
                  compatible = "huawei,hw_fac_info";
                  fac,product_name = "HUAWEI FDR-A01W";
                  fac,hardware_ver = "SH1FDRA01WM_VERA";
                  fac,software_ver = "MSM8939_FDR_A01W_VA";
                  status = "ok";
        };
};
