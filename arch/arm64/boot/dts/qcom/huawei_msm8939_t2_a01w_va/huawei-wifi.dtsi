
 / {
        huawei_wifi_info {
                  compatible = "huawei,hw_wifi_info";
                  status = "ok";
                  wifi,chiptype = "2.7";
                  wifi,pubfile_id = "t2_a01w_va";
                  wifi,fw_ver = "QCOM_WCN3680B_2.0.1";
                  wifi,softap_feature = "wps";
        };
};
