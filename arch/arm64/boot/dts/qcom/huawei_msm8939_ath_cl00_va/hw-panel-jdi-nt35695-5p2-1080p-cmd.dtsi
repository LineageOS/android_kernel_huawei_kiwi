/* Copyright (c) 2013, The Linux Foundation. All rights reserved.
 *
 * This program is free software; you can redistribute it and/or modify
 * it under the terms of the GNU General Public License version 2 and
 * only version 2 as published by the Free Software Foundation.
 *
 * This program is distributed in the hope that it will be useful,
 * but WITHOUT ANY WARRANTY; without even the implied warranty of
 * MERCHANTABILITY or FITNESS FOR A PARTICULAR PURPOSE.  See the
 * GNU General Public License for more details.
 */

/*---------------------------------------------------------------------------
 * This file is autogenerated file using gcdb parser. Please do not edit it.
 * Update input XML file to add a new entry or update variable in this file
 * VERSION = "1.0"
 *---------------------------------------------------------------------------*/
&mdss_mdp {
	dsi_jdi_nt35695_5p2_1080p_cmd: qcom,mdss_dsi_jdi_nt35695_5p2_1080p_cmd {
		qcom,mdss-dsi-panel-name = "JDI_NT35695_5P2_1080P_CMD";
		qcom,cont-splash-enabled;
		qcom,mdss-dsi-panel-controller = <&mdss_dsi0>;
		qcom,mdss-dsi-panel-type = "dsi_cmd_mode";
		qcom,mdss-dsi-panel-destination = "display_1";
		qcom,mdss-dsi-panel-clockrate = <896000000>;
		qcom,mdss-dsi-panel-framerate = <60>;
		qcom,mdss-dsi-virtual-channel-id = <0>;
		qcom,mdss-dsi-stream = <0>;
		qcom,mdss-dsi-panel-width = <1080>;
		qcom,mdss-dsi-panel-height = <1920>;
		qcom,mdss-dsi-h-front-porch = <80>;
		qcom,mdss-dsi-h-back-porch = <16>;
		qcom,mdss-dsi-h-pulse-width = <16>;
		qcom,mdss-dsi-h-sync-skew = <0>;
		qcom,mdss-dsi-v-back-porch = <32>;
		qcom,mdss-dsi-v-front-porch = <32>;
		qcom,mdss-dsi-v-pulse-width = <16>;
		qcom,mdss-dsi-h-left-border = <0>;
		qcom,mdss-dsi-h-right-border = <0>;
		qcom,mdss-dsi-v-top-border = <0>;
		qcom,mdss-dsi-v-bottom-border = <0>;
		qcom,mdss-dsi-bpp = <24>;
		qcom,mdss-dsi-underflow-color = <0xff>;
		qcom,mdss-dsi-border-color = <0>;
		qcom,mdss-dsi-color-order = "rgb_swap_rgb";
		qcom,mdss-dsi-on-command = [29 00 00 00 00 00 02 FF 20
					29 00 00 00 00 00 02 10 02
					29 00 00 00 00 00 02 FB 01
					29 00 00 00 00 00 02 68 03
					29 00 00 00 00 00 02 FF 22
					29 01 00 00 00 00 02 FB 01
					29 00 00 00 00 00 02 00 50
					29 00 00 00 00 00 02 01 50
					29 00 00 00 00 00 02 02 50
					29 00 00 00 00 00 02 03 50
					29 01 00 00 00 00 02 04 50
					29 00 00 00 00 00 02 05 50
					29 00 00 00 00 00 02 06 4C
					29 00 00 00 00 00 02 07 48
					29 00 00 00 00 00 02 08 44
					29 01 00 00 00 00 02 09 40
					29 00 00 00 00 00 02 0A 3C
					29 00 00 00 00 00 02 0B 38
					29 00 00 00 00 00 02 0C 38
					29 00 00 00 00 00 02 0D 30
					29 01 00 00 00 00 02 0E 28
					29 00 00 00 00 00 02 0F 20
					29 00 00 00 00 00 02 10 10
					29 00 00 00 00 00 02 11 00
					29 00 00 00 00 00 02 12 00
					29 01 00 00 00 00 02 13 00
					29 00 00 00 00 00 02 1B 4C
					29 00 00 00 00 00 02 1C 48
					29 00 00 00 00 00 02 1D 44
					29 00 00 00 00 00 02 1E 40
					29 01 00 00 00 00 02 1F 3C
					29 00 00 00 00 00 02 20 38
					29 00 00 00 00 00 02 21 38
					29 00 00 00 00 00 02 22 38
					29 00 00 00 00 00 02 23 38
					29 01 00 00 00 00 02 24 38
					29 00 00 00 00 00 02 25 38
					29 00 00 00 00 00 02 26 38
					29 00 00 00 00 00 02 27 38
					29 00 00 00 00 00 02 28 30
					29 01 00 00 00 00 02 29 28
					29 00 00 00 00 00 02 2A 20
					29 00 00 00 00 00 02 2B 10
					29 00 00 00 00 00 02 2F 00
					29 00 00 00 00 00 02 30 00
					29 01 00 00 00 00 02 31 00
					29 00 00 00 00 00 02 32 80
					29 00 00 00 00 00 02 33 80
					29 00 00 00 00 00 02 34 80
					29 00 00 00 00 00 02 35 86
					29 01 00 00 00 00 02 36 88
					29 00 00 00 00 00 02 37 8F
					29 00 00 00 00 00 02 38 93
					29 00 00 00 00 00 02 39 94
					29 00 00 00 00 00 02 3A 92
					29 01 00 00 00 00 02 3B 91
					29 00 00 00 00 00 02 3F 90
					29 00 00 00 00 00 02 40 93
					29 00 00 00 00 00 02 41 96
					29 00 00 00 00 00 02 42 96
					29 01 00 00 00 00 02 43 99
					29 00 00 00 00 00 02 44 98
					29 00 00 00 00 00 02 45 95
					29 00 00 00 00 00 02 46 92
					29 00 00 00 00 00 02 47 8F
					29 01 00 00 00 00 02 48 8C
					29 00 00 00 00 00 02 49 89
					29 00 00 00 00 00 02 4A 86
					29 00 00 00 00 00 02 4B 83
					29 00 00 00 00 00 02 4C 80
					29 01 00 00 00 00 02 4D 00
					29 00 00 00 00 00 02 4E 04
					29 00 00 00 00 00 02 4F 0a
					29 00 00 00 00 00 02 1A 00
					29 00 00 00 00 00 02 53 77
					29 01 00 00 00 00 02 54 03
					29 00 00 00 00 00 02 55 77
					29 00 00 00 00 00 02 56 00
					29 00 00 00 00 00 02 68 00
					29 00 00 00 00 00 02 65 82
					29 01 00 00 00 00 02 66 A6
					29 00 00 00 00 00 02 67 C8
					29 00 00 00 00 00 02 69 F2
					29 00 00 00 00 00 02 97 FF
					29 00 00 00 00 00 02 98 1C
					29 01 00 00 00 00 02 A2 20
					29 00 00 00 00 00 02 FF 23
					29 00 00 00 00 00 02 FB 01
					29 01 00 00 00 00 02 13 F3
					29 01 00 00 00 00 02 14 F2
					29 01 00 00 00 00 02 15 F1
					29 01 00 00 00 00 02 16 F0
					29 01 00 00 00 00 02 21 FF
					29 01 00 00 00 00 02 22 F4
					29 01 00 00 00 00 02 23 E9
					29 01 00 00 00 00 02 24 DE
					29 01 00 00 00 00 02 25 D3
					29 01 00 00 00 00 02 26 C8
					29 01 00 00 00 00 02 27 BD
					29 01 00 00 00 00 02 28 B2
					29 01 00 00 00 00 02 29 A7
					29 01 00 00 00 00 02 2A 9C
					29 00 00 00 00 00 02 00 02
					29 00 00 00 00 00 02 32 03
					29 01 00 00 00 00 02 08 03
					29 00 00 00 00 00 02 FF 10
					29 00 00 00 00 00 02 FF E0
					29 00 00 00 00 00 02 B8 AD
					29 00 00 00 00 00 02 FB 01
					29 01 00 00 00 00 02 FF 10
					29 00 00 00 00 00 05 2A 00 00 04 37
					29 00 00 00 00 00 05 2B 00 00 07 7F
					29 00 00 00 00 00 02 53 24
					29 01 00 00 00 00 02 55 91
					29 00 00 00 00 00 02 35 00
					29 00 00 00 00 00 03 44 05 00
					15 00 00 00 00 00 02 51 00
					15 01 00 00 00 00 02 5E 28
					05 01 00 00 78 00 02 11 00
					05 01 00 00 28 00 02 29 00];
		qcom,mdss-dsi-off-command = [05 01 00 00 28 00 02 28 00
					05 01 00 00 78 00 02 10 00];
		qcom,mdss-dsi-on-command-state = "dsi_lp_mode";
		qcom,mdss-dsi-off-command-state = "dsi_hs_mode";
		qcom,mdss-dsi-h-sync-pulse = <1>;
		qcom,mdss-dsi-traffic-mode = "burst_mode";
		qcom,mdss-dsi-lane-map = "lane_map_0123";
		qcom,mdss-dsi-bllp-eof-power-mode;
		qcom,mdss-dsi-bllp-power-mode;
		qcom,mdss-dsi-lane-0-state;
		qcom,mdss-dsi-lane-1-state;
		qcom,mdss-dsi-lane-2-state;
		qcom,mdss-dsi-lane-3-state;
		qcom,mdss-dsi-te-pin-select = <1>;
		qcom,mdss-dsi-te-v-sync-rd-ptr-irq-line = <0x2c>;
		qcom,mdss-dsi-te-dcs-command = <1>;
		qcom,mdss-dsi-te-check-enable;
		qcom,mdss-dsi-te-using-te-pin;
		qcom,mdss-dsi-panel-timings = [E6 38 26 00 68 6C 2A 3C 2C 03 04 00];
		qcom,mdss-dsi-t-clk-post = <0x2c>;
		qcom,mdss-dsi-t-clk-pre = <0x2d>;
		qcom,mdss-dsi-bl-min-level = <4>;
		qcom,mdss-dsi-bl-max-level = <250>;
		qcom,mdss-dsi-dma-trigger = "trigger_sw";
		qcom,mdss-dsi-mdp-trigger = "none";
		qcom,mdss-dsi-bl-pmic-control-type = "bl_ctrl_dcs";
		qcom,panel-cabc-ui-cmds = [29 01 00 00 00 00 02 FF 10
					29 01 00 00 00 00 02 FB 01
					15 01 00 00 00 00 02 55 91
					15 01 00 00 00 00 02 53 24
					29 01 00 00 00 00 02 FF 23
					29 01 00 00 00 00 02 FB 01
					29 01 00 00 00 00 02 13 F3
					29 01 00 00 00 00 02 14 F2
					29 01 00 00 00 00 02 15 F1
					29 01 00 00 00 00 02 16 F0
					29 01 00 00 00 00 02 FF 10
					29 01 00 00 00 00 02 FB 01];
		qcom,panel-cabc-video-cmds = [29 01 00 00 00 00 02 FF 10
					29 01 00 00 00 00 02 FB 01
					15 01 00 00 00 00 02 55 93
					15 01 00 00 00 00 02 53 2C
					29 01 00 00 00 00 02 FF 23
					29 01 00 00 00 00 02 FB 01
					29 01 00 00 00 00 02 21 FF
					29 01 00 00 00 00 02 22 F4
					29 01 00 00 00 00 02 23 E9
					29 01 00 00 00 00 02 24 DE
					29 01 00 00 00 00 02 25 D3
					29 01 00 00 00 00 02 26 C8
					29 01 00 00 00 00 02 27 BD
					29 01 00 00 00 00 02 28 B2
					29 01 00 00 00 00 02 29 A7
					29 01 00 00 00 00 02 2A 9C
					29 01 00 00 00 00 02 FF 10
					29 01 00 00 00 00 02 FB 01];
		qcom,cabc-ui-cmds-dsi-state = "dsi_lp_mode";
		qcom,cabc-video-cmds-dsi-state = "dsi_lp_mode";
		qcom,panel-dot-inversion-mode-cmds = [29 01 00 00 00 00 02 FF 24
					29 01 00 00 00 00 02 FB 01
					29 01 00 00 00 00 02 9B 01
					29 01 00 00 00 00 02 FF 10
					29 01 00 00 00 00 02 FB 01];
		qcom,panel-column-inversion-mode-cmds = [29 01 00 00 00 00 02 FF 24
					29 01 00 00 00 00 02 FB 01
					29 01 00 00 00 00 02 9B 0F
					29 01 00 00 00 00 02 FF 10
					29 01 00 00 00 00 02 FB 01];
		qcom,dot-inversion-cmds-dsi-state = "dsi_lp_mode";
		qcom,column-inversion-cmds-dsi-state = "dsi_lp_mode";
		qcom,panel-esd-check-enabled;
		qcom,panel-esd-read-commands = [06 01 00 00 00 00 02 0A 9C];
		qcom,panel-frame_crc_enable_cmds = [29 01 00 00 00 00 02 FF F0
					29 01 00 00 00 00 02 7B 00
					15 01 00 00 00 00 02 92 01];
		qcom,panel-frame_crc_disable_cmds = [29 01 00 00 00 00 02 FF F0
					15 01 00 00 00 00 02 92 00
					29 01 00 00 00 00 02 FF 10
					29 01 00 00 00 00 02 FB 01];
		qcom,panel-frame_crc_read_cmds = [73 74 75 76 77 78 79 7a];
		qcom,panel-frame-checksum-support;
		qcom,panel-frame_crc_read_cmds_value = [1d 9c 82 af 3b 64 9a fc
					18 0b 83 79 02 05 f2 2e
					8e bf d7 66 1c b9 85 ab];
		qcom,frame-checksum-enable-dsi-state = "dsi_lp_mode";
		qcom,frame-checksum-disable-dsi-state = "dsi_lp_mode";
		qcom,mdss-dsi-lp11-init;
		qcom,mdss-dsi-tp-reset_enable;
		qcom,mdss-dsi-post-delay-time = <1000>;
		qcom,mdss-pan-physical-width-dimension = <65>;
		qcom,mdss-pan-physical-height-dimension = <115>;
		qcom,mdss-dsi-mipi-rst-delay = <80>;
		huawei,mdss-dsi-lens-type = <2>;
			qcom,mdss-dsi-reset-sequence = <1 15>, <0 5>, <1 15>;

	};
};
