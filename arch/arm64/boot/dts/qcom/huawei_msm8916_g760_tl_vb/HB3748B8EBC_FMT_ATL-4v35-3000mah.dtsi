/* < DTS201505289999M zhujie 20150528 begin */
qcom,qrd-4v35-3000mAh-fmt-atl-data {
	qcom,batt-id-kohm = <10>;
	qcom,battery-type = "HB3748B8EBC_FMT_ATL";
	qcom,fcc-mah = <2000>;
	qcom,default-rbatt-mohm = <133>;
	qcom,rbatt-capacitive-mohm = <50>;
	qcom,flat-ocv-threshold-uv = <3800000>;
	qcom,max-voltage-uv = <4350000>;
	qcom,v-cutoff-uv = <3400000>;
	qcom,chg-term-ua = <100000>;

	qcom,warm-bat-decidegc = <420>;
	qcom,warm-bat-mv = <4100>;
	qcom,ibatmax-warm-ma = <1050>;

	qcom,cool-bat-decidegc = <100>;
	qcom,cool-bat-mv = <4340>;
	qcom,ibatmax-cool-ma = <900>;

	qcom,hot-bat-decidegc = <520>;
	qcom,cold-bat-decidegc = <0>;

	qcom,rbatt-sf-lut {
		qcom,lut-col-legend = <(-20) 0 25 40 60>;
		qcom,lut-row-legend = <100 95 90 85 80>,
				<75 70 65 60 55>,
				<50 45 40 35 30>,
				<25 20 16 13 11>,
				<10 9 8 7 6>,
				<5 4 3 2 1>,
				<0>;
		qcom,lut-data = <1190 278 100 81 72>,
				<1191 278 100 81 72>,
				<1204 289 103 84 74>,
				<1303 301 109 87 76>,
				<1415 312 115 90 79>,
				<1338 327 121 94 81>,
				<1324 310 129 100 85>,
				<1329 300 138 106 89>,
				<1382 296 138 111 94>,
				<1460 293 116 101 89>,
				<1557 295 106 84 76>,
				<1674 300 108 87 78>,
				<1814 320 112 93 83>,
				<2000 352 115 95 86>,
				<2475 399 122 93 83>,
				<3630 454 127 93 78>,
				<5251 502 130 94 80>,
				<6730 550 133 94 80>,
				<7474 584 130 90 78>,
				<7351 636 136 96 81>,
				<8175 672 142 100 83>,
				<9132 714 151 103 84>,
				<10306 768 160 107 86>,
				<11699 833 169 111 86>,
				<13477 910 175 109 84>,
				<15726 1009 177 107 83>,
				<18685 1154 185 109 85>,
				<22611 1369 203 115 88>,
				<28548 1821 233 124 93>,
				<41971 2700 282 144 103>,
				<76511 5016 700 980 245>;
	};

	qcom,fcc-temp-lut {
		qcom,lut-col-legend = <(-20) 0 25 40 60>;
		qcom,lut-data = <2048 2076 2074 2071 2060>;
	};

	qcom,pc-temp-ocv-lut {
		qcom,lut-col-legend = <(-20) 0 25 40 60>;
		qcom,lut-row-legend = <100 95 90 85 80>,
				<75 70 65 60 55>,
				<50 45 40 35 30>,
				<25 20 16 13 11>,
				<10 9 8 7 6>,
				<5 4 3 2 1>,
				<0>;
		qcom,lut-data = <4305 4306 4304 4308 4302>,
				<4229 4251 4255 4253 4247>,
				<4159 4190 4197 4196 4190>,
				<4098 4134 4142 4140 4135>,
				<4040 4082 4089 4088 4083>,
				<3955 4029 4041 4039 4035>,
				<3907 3974 3995 3995 3991>,
				<3865 3927 3955 3955 3951>,
				<3843 3887 3914 3916 3914>,
				<3826 3852 3867 3872 3870>,
				<3811 3823 3833 3833 3832>,
				<3796 3800 3810 3811 3809>,
				<3782 3785 3792 3793 3791>,
				<3768 3775 3778 3777 3776>,
				<3753 3764 3768 3763 3757>,
				<3735 3750 3757 3748 3733>,
				<3714 3724 3736 3727 3712>,
				<3690 3702 3705 3697 3683>,
				<3669 3689 3681 3673 3661>,
				<3652 3681 3676 3670 3659>,
				<3640 3678 3674 3668 3657>,
				<3626 3673 3672 3666 3655>,
				<3610 3669 3669 3663 3652>,
				<3590 3662 3664 3658 3646>,
				<3565 3648 3653 3644 3629>,
				<3532 3622 3624 3612 3591>,
				<3490 3580 3575 3562 3540>,
				<3432 3522 3510 3496 3475>,
				<3348 3438 3424 3408 3388>,
				<3223 3310 3295 3275 3257>,
				<3000 3000 3000 3000 3000>;
	};
};
/* DTS201505289999M zhujie 20150528 end > */
