 / {
        huawei_fac_info {
                  compatible = "huawei,hw_fac_info";
                  fac,product_name = "HUAWEI KIW-AL20";
                  fac,hardware_ver = "HL1KIWMH1AG";
                  fac,software_ver = "MSM8939_KIW_AL20_VB";
                  status = "ok";
        };
};
