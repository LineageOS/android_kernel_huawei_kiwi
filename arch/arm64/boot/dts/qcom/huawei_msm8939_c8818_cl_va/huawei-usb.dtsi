&usb_otg {
    qcom,hsusb-otg-phy-init-seq = <0x74 0x80 0x6B 0x81 0x24 0x82 0x13 0x83 0xffffffff>;
	qcom,hsusb-otg-mode = <1>;
	qcom,usbotg-chargeic-bq24152 = <1>;
	qcom,usbid-gpio = <&msm_gpio 117 0>; 
	pinctrl-names = "default"; 
	pinctrl-0 = <&usbid_default>;
};
