 / {
        huawei_wifi_info {
                  compatible = "huawei,hw_wifi_info";
                  status = "ok";
                  wifi,chiptype = "2.3";
                  wifi,pubfile_id = "C8818";
                  wifi,fw_ver = "QCOM_WCN3620_2.0.1";
        };
};
