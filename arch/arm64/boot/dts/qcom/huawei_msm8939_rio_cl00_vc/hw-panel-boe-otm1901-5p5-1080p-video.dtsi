/* Copyright (c) 2013, The Linux Foundation. All rights reserved.
 *
 * This program is free software; you can redistribute it and/or modify
 * it under the terms of the GNU General Public License version 2 and
 * only version 2 as published by the Free Software Foundation.
 *
 * This program is distributed in the hope that it will be useful,
 * but WITHOUT ANY WARRANTY; without even the implied warranty of
 * MERCHANTABILITY or FITNESS FOR A PARTICULAR PURPOSE.  See the
 * GNU General Public License for more details.
 */

/*---------------------------------------------------------------------------
 * This file is autogenerated file using gcdb parser. Please do not edit it.
 * Update input XML file to add a new entry or update variable in this file
 * VERSION = "1.0"
 *---------------------------------------------------------------------------*/
&mdss_mdp {
	dsi_boe_otm1901_5p5_1080p_video: qcom,mdss_dsi_boe_otm1901_5p5_1080p_video {
		qcom,mdss-dsi-panel-name = "BOE_OTM1901_5P5_1080P_VIDEO";
		qcom,cont-splash-enabled;
		qcom,mdss-dsi-panel-controller = <&mdss_dsi0>;
		qcom,mdss-dsi-panel-type = "dsi_video_mode";
		qcom,mdss-dsi-panel-destination = "display_1";
		qcom,mdss-dsi-panel-clockrate = <898000000>;
		qcom,mdss-dsi-panel-framerate = <60>;
		qcom,mdss-dsi-virtual-channel-id = <0>;
		qcom,mdss-dsi-stream = <0>;
		qcom,mdss-dsi-panel-width = <1080>;
		qcom,mdss-dsi-panel-height = <1920>;
		qcom,mdss-dsi-h-front-porch = <108>;
		qcom,mdss-dsi-h-back-porch = <96>;
		qcom,mdss-dsi-h-pulse-width = <8>;
		qcom,mdss-dsi-h-sync-skew = <0>;
		qcom,mdss-dsi-v-back-porch = <3>;
		qcom,mdss-dsi-v-front-porch = <7>;
		qcom,mdss-dsi-v-pulse-width = <2>;
		qcom,mdss-dsi-h-left-border = <0>;
		qcom,mdss-dsi-h-right-border = <0>;
		qcom,mdss-dsi-v-top-border = <0>;
		qcom,mdss-dsi-v-bottom-border = <0>;
		qcom,mdss-dsi-bpp = <24>;
		qcom,mdss-dsi-underflow-color = <0x00>;
		qcom,mdss-dsi-border-color = <0>;
		qcom,mdss-dsi-color-order = "rgb_swap_rgb";
		qcom,mdss-dsi-on-command = [29 01 00 00 00 00 02 00 00
				    29 01 00 00 00 00 04 FF 19 01 01
				    29 01 00 00 00 00 02 00 80
				    29 01 00 00 00 00 03 FF 19 01
				    29 01 00 00 00 00 02 00 00
				    29 01 00 00 00 00 02 1C 33
				    29 01 00 00 00 00 02 00 A0
				    29 01 00 00 00 00 02 C1 E8
				    29 01 00 00 00 00 02 00 A7
				    29 01 00 00 00 00 02 C1 00
				    29 01 00 00 00 00 02 00 90
				    29 01 00 00 00 00 07 C0 00 2F 00 00 00 01
				    29 01 00 00 00 00 02 00 C0
				    29 01 00 00 00 00 07 C0 00 2F 00 00 00 01
				    29 01 00 00 00 00 02 00 9A
				    29 01 00 00 00 00 02 C0 1E
				    29 01 00 00 00 00 02 00 AC
				    29 01 00 00 00 00 02 C0 06
				    29 01 00 00 00 00 02 00 DC
				    29 01 00 00 00 00 02 C0 06
				    29 01 00 00 00 00 02 00 81
				    29 01 00 00 00 00 02 A5 04
				    29 01 00 00 00 00 02 00 84
				    29 01 00 00 00 00 02 C4 20
				    29 01 00 00 00 00 02 00 A5
				    29 01 00 00 00 00 02 B3 1D
				    29 01 00 00 00 00 02 00 92
				    29 01 00 00 00 00 02 E9 00
				    29 01 00 00 00 00 02 00 90
				    29 01 00 00 00 00 02 F3 01
				    29 01 00 00 00 00 02 00 93
				    29 01 00 00 00 00 02 C5 19
				    29 01 00 00 00 00 02 00 95
				    29 01 00 00 00 00 02 C5 2D
				    29 01 00 00 00 00 02 00 97
				    29 01 00 00 00 00 02 C5 14
				    29 01 00 00 00 00 02 00 99
				    29 01 00 00 00 00 02 C5 29
				    29 01 00 00 00 00 02 00 00
				    29 01 00 00 00 00 03 D8 1D 1D
				    29 01 00 00 00 00 02 00 B3
				    29 01 00 00 00 00 02 C0 CC
				    29 01 00 00 00 00 02 00 BC
				    29 01 00 00 00 00 02 C0 00
				    29 01 00 00 00 00 02 00 F7
				    29 01 00 00 00 00 05 C3 04 18 04 04
				    29 01 00 00 00 00 02 00 81
				    29 01 00 00 00 00 02 A5 07
				    29 01 00 00 00 00 02 00 9D
				    29 01 00 00 00 00 02 C5 77
				    29 01 00 00 00 00 02 00 9B
				    29 01 00 00 00 00 03 C5 55 55
				    29 01 00 00 00 00 02 00 80
				    29 01 00 00 00 00 02 C4 15
				    29 01 00 00 00 00 02 00 00
				    29 01 00 00 00 00 19 E1 2E 30 32 37 3B 3F 45 50 57 65 6E 75 83 7B 70 5C 45 30 22 1A 11 07 04 03
				    29 01 00 00 00 00 02 00 00
				    29 01 00 00 00 00 19 E2 2E 30 32 37 3B 3F 45 50 57 65 6E 75 83 7B 70 5C 45 30 22 1A 11 07 04 03
				    29 01 00 00 00 00 02 00 00
				    29 01 00 00 00 00 19 E3 35 37 39 3D 40 44 4A 53 5A 67 6F 76 82 7A 70 5B 45 30 22 1A 11 07 04 03
				    29 01 00 00 00 00 02 00 00
				    29 01 00 00 00 00 19 E4 35 37 39 3D 40 44 4A 53 5A 67 6F 76 82 7A 70 5B 45 30 22 1A 11 07 04 03
				    29 01 00 00 00 00 02 00 00
				    29 01 00 00 00 00 19 E5 00 05 09 11 18 1F 2A 3C 47 5A 67 70 87 7E 73 5F 48 32 24 1C 12 08 04 03
				    29 01 00 00 00 00 02 00 00
				    29 01 00 00 00 00 19 E6 00 05 09 11 18 1F 2A 3C 47 5A 67 70 87 7E 73 5F 48 32 24 1C 12 08 04 03
				    29 01 00 00 00 00 02 00 80
				    29 01 00 00 00 00 0F C0 00 87 00 0A 0A 00 87 0A 0A 00 87 00 0A 0A
				    29 01 00 00 00 00 02 00 F0
				    29 01 00 00 00 00 07 C3 22 02 00 00 00 0C
				    29 01 00 00 00 00 02 00 A0
				    29 01 00 00 00 00 08 C0 00 00 00 00 03 22 03
				    29 01 00 00 00 00 02 00 D0
				    29 01 00 00 00 00 08 C0 00 00 00 00 03 22 03
				    29 01 00 00 00 00 02 00 90
				    29 01 00 00 00 00 09 C2 83 01 00 00 82 01 00 00
				    29 01 00 00 00 00 02 00 80
				    29 01 00 00 00 00 0D C3 82 02 03 00 03 84 81 03 03 00 03 84
				    29 01 00 00 00 00 02 00 90
				    29 01 00 00 00 00 0D C3 00 01 03 00 03 84 01 02 03 00 03 84
				    29 01 00 00 00 00 02 00 80
				    29 01 00 00 00 00 10 CC 09 0A 11 12 13 14 15 16 17 18 28 28 28 28 28
				    29 01 00 00 00 00 02 00 90
				    29 01 00 00 00 00 10 CC 0A 09 14 13 12 11 15 16 17 18 28 28 28 28 28
				    29 01 00 00 00 00 02 00 A0
				    29 01 00 00 00 00 10 CC 1D 1E 1F 19 1A 1B 1C 20 21 22 23 24 25 26 27
				    29 01 00 00 00 00 02 00 B0
				    29 01 00 00 00 00 09 CC 01 02 03 05 06 07 04 08
				    29 01 00 00 00 00 02 00 C0
				    29 01 00 00 00 00 0D CC 00 00 00 00 00 00 00 00 00 00 00 77
				    29 01 00 00 00 00 02 00 D0
				    29 01 00 00 00 00 0D CC 00 00 00 00 05 00 00 00 00 00 00 77
				    29 01 00 00 00 00 02 00 80
				    29 01 00 00 00 00 10 CB 00 00 00 00 00 00 00 00 00 00 00 00 00 00 00
				    29 01 00 00 00 00 02 00 90
				    29 01 00 00 00 00 10 CB 00 00 00 00 00 00 00 00 00 00 00 00 00 00 00
				    29 01 00 00 00 00 02 00 A0
				    29 01 00 00 00 00 10 CB 01 01 01 01 01 01 00 00 00 00 00 00 00 00 00
				    29 01 00 00 00 00 02 00 B0
				   	29 01 00 00 00 00 10 CB 00 01 FD 00 00 00 00 00 00 00 00 00 00 00 00
				   	29 01 00 00 00 00 02 00 C0
				   	29 01 00 00 00 00 09 CB 00 00 00 00 00 00 77 77
				   	29 01 00 00 00 00 02 00 D0
				   	29 01 00 00 00 00 09 CB 00 00 00 00 00 00 77 77
				   	29 01 00 00 00 00 02 00 E0
				   	29 01 00 00 00 00 09 CB 00 00 00 00 00 00 77 77
				   	29 01 00 00 00 00 02 00 F0
				   	29 01 00 00 00 00 09 CB 01 01 01 00 00 00 77 77
				   	29 01 00 00 00 00 02 00 80
				   	29 01 00 00 00 00 10 CD 3F 3F 3F 3F 3F 3F 3F 3F 3F 02 12 11 3F 04 3F
				   	29 01 00 00 00 00 02 00 90
				   	29 01 00 00 00 00 0C CD 06 3F 3F 26 26 26 21 20 1F 26 26
				   	29 01 00 00 00 00 02 00 A0
				   	29 01 00 00 00 00 10 CD 3F 3F 3F 3F 3F 3F 3F 3F 3F 01 12 11 3F 03 3F
				   	29 01 00 00 00 00 02 00 B0
				   	29 01 00 00 00 00 0C CD 05 3F 3F 26 26 26 21 20 1F 26 26
				   	29 01 00 00 00 00 02 00 B0
				   	29 01 00 00 00 00 02 CA 01
					15 01 00 00 00 00 02 55 01
					15 01 00 00 00 00 02 5E 28
				   	29 01 00 00 00 00 02 00 00
				   	29 01 00 00 00 00 04 FF FF FF FF
					15 01 00 00 00 00 02 53 24
					15 01 00 00 00 00 02 51 00
					05 01 00 00 78 00 02 11 00
					05 01 00 00 14 00 02 29 00];
		qcom,mdss-dsi-off-command = [05 01 00 00 28 00 02 28 00
					05 01 00 00 78 00 02 10 00];
		qcom,mdss-dsi-on-command-state = "dsi_lp_mode";
		qcom,mdss-dsi-off-command-state = "dsi_hs_mode";
		qcom,mdss-dsi-h-sync-pulse = <1>;
		qcom,mdss-dsi-traffic-mode = "burst_mode";
		qcom,mdss-dsi-lane-map = "lane_map_0123";
		qcom,mdss-dsi-bllp-eof-power-mode;
		qcom,mdss-dsi-bllp-power-mode;
		qcom,mdss-dsi-lane-0-state;
		qcom,mdss-dsi-lane-1-state;
		qcom,mdss-dsi-lane-2-state;
		qcom,mdss-dsi-lane-3-state;
		qcom,mdss-dsi-panel-timings = [e6 38 26 00 68 6e 2a 3c 2c 03 04 00];
		qcom,mdss-dsi-t-clk-post = <0x1e>;
		qcom,mdss-dsi-t-clk-pre = <0x38>;
		qcom,mdss-dsi-bl-min-level = <4>;
		qcom,mdss-dsi-bl-max-level = <250>;
		qcom,mdss-dsi-dma-trigger = "trigger_sw";
		qcom,mdss-dsi-mdp-trigger = "none";
		qcom,mdss-dsi-bl-pmic-control-type = "bl_ctrl_dcs";
		qcom,panel-cabc-ui-cmds = [15 01 00 00 00 00 02 55 01
					15 01 00 00 00 00 02 53 24];
		qcom,panel-cabc-video-cmds = [15 01 00 00 00 00 02 55 03
					15 01 00 00 00 00 02 53 2C];
		qcom,cabc-ui-cmds-dsi-state = "dsi_hs_mode";
		qcom,cabc-video-cmds-dsi-state = "dsi_lp_mode";
		qcom,panel-dot-inversion-mode-cmds = [29 01 00 00 00 00 02 00 00
					29 01 00 00 00 00 05 FF 19 01 01 00
					29 01 00 00 00 00 02 00 80
					29 01 00 00 00 00 03 FF 19 01
					29 01 00 00 00 00 02 00 B3
					29 01 00 00 00 00 02 C0 DD
					29 01 00 00 00 00 02 00 BC
					29 01 00 00 00 00 02 C0 11
					29 01 00 00 00 00 02 00 00
					29 01 00 00 00 00 02 FB 01
					29 01 00 00 00 00 02 00 00
					29 01 00 00 00 00 04 FF FF FF FF];
		qcom,panel-column-inversion-mode-cmds = [29 01 00 00 00 00 02 00 00
					29 01 00 00 00 00 05 FF 19 01 01 00
					29 01 00 00 00 00 02 00 80
					29 01 00 00 00 00 03 FF 19 01
					29 01 00 00 00 00 02 00 B3
					29 01 00 00 00 00 02 C0 CC
					29 01 00 00 00 00 02 00 BC
					29 01 00 00 00 00 02 C0 00
					29 01 00 00 00 00 02 00 00
					29 01 00 00 00 00 02 FB 01
					29 01 00 00 00 00 02 00 00
					29 01 00 00 00 00 04 FF FF FF FF];
		qcom,dot-inversion-cmds-dsi-state = "dsi_lp_mode";
		qcom,column-inversion-cmds-dsi-state = "dsi_lp_mode";
		qcom,panel-frame_crc_read_cmds = [AA];
		qcom,panel-frame-checksum-support;
		qcom,panel-frame_crc_read_cmds_value = [78 5e d7];
		qcom,mdss-dsi-lp11-init;
		qcom,mdss-pan-physical-width-dimension = <68>;
		qcom,mdss-pan-physical-height-dimension = <121>;
			qcom,mdss-dsi-reset-sequence = <1 5>, <0 5>, <1 15>;

	};
};
