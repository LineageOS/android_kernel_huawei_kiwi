/* Copyright (c) 2013, The Linux Foundation. All rights reserved.
 *
 * This program is free software; you can redistribute it and/or modify
 * it under the terms of the GNU General Public License version 2 and
 * only version 2 as published by the Free Software Foundation.
 *
 * This program is distributed in the hope that it will be useful,
 * but WITHOUT ANY WARRANTY; without even the implied warranty of
 * MERCHANTABILITY or FITNESS FOR A PARTICULAR PURPOSE.  See the
 * GNU General Public License for more details.
 */

/*---------------------------------------------------------------------------
 * This file is autogenerated file using gcdb parser. Please do not edit it.
 * Update input XML file to add a new entry or update variable in this file
 * VERSION = "1.0"
 *---------------------------------------------------------------------------*/
&mdss_mdp {
	dsi_boe_otm1906c_5p2_1080p_cmd: qcom,mdss_dsi_boe_otm1906c_5p2_1080p_cmd {
		qcom,mdss-dsi-panel-name = "BOE_OTM1906C_5P2_1080P_CMD";
		qcom,cont-splash-enabled;
		qcom,mdss-dsi-panel-controller = <&mdss_dsi0>;
		qcom,mdss-dsi-panel-type = "dsi_cmd_mode";
		qcom,mdss-dsi-panel-destination = "display_1";
		qcom,mdss-dsi-panel-clockrate = <896000000>;
		qcom,mdss-dsi-panel-framerate = <60>;
		qcom,mdss-dsi-virtual-channel-id = <0>;
		qcom,mdss-dsi-stream = <0>;
		qcom,mdss-dsi-panel-width = <1080>;
		qcom,mdss-dsi-panel-height = <1920>;
		qcom,mdss-dsi-h-front-porch = <80>;
		qcom,mdss-dsi-h-back-porch = <16>;
		qcom,mdss-dsi-h-pulse-width = <16>;
		qcom,mdss-dsi-h-sync-skew = <0>;
		qcom,mdss-dsi-v-back-porch = <32>;
		qcom,mdss-dsi-v-front-porch = <32>;
		qcom,mdss-dsi-v-pulse-width = <16>;
		qcom,mdss-dsi-h-left-border = <0>;
		qcom,mdss-dsi-h-right-border = <0>;
		qcom,mdss-dsi-v-top-border = <0>;
		qcom,mdss-dsi-v-bottom-border = <0>;
		qcom,mdss-dsi-bpp = <24>;
		qcom,mdss-dsi-underflow-color = <0xff>;
		qcom,mdss-dsi-border-color = <0>;
		qcom,mdss-dsi-color-order = "rgb_swap_rgb";
		qcom,mdss-dsi-on-command = [29 01 00 00 00 00 02 00 00
					29 01 00 00 00 00 04 FF 19 06 01
					29 01 00 00 00 00 02 00 80
					29 01 00 00 00 00 03 FF 19 06
					29 01 00 00 00 00 02 00 A0
					29 01 00 00 00 00 04 C1 00 C0 10
					29 01 00 00 00 00 02 00 91
					29 01 00 00 00 00 03 C5 14 28
					29 01 00 00 00 00 02 00 95
					29 01 00 00 00 00 02 C5 11
					29 01 00 00 00 00 02 00 80
					29 01 00 00 00 00 03 C1 55 55
					29 01 00 00 00 00 02 00 94
					29 01 00 00 00 00 02 C5 88
					29 01 00 00 00 00 02 00 00
					29 01 00 00 00 00 19 E1 00 08 0F 1A 23 2C 37 4A 55 64 6E 74 86 82 7B 6C 59 44 37 2F 24 19 16 00
					29 01 00 00 00 00 02 00 00
					29 01 00 00 00 00 19 E2 00 08 0F 1A 23 2C 37 4A 55 64 6E 74 86 82 7B 6C 59 44 37 2F 24 19 16 00
					29 01 00 00 00 00 02 00 00
					29 01 00 00 00 00 19 E3 00 08 0F 1A 23 2C 37 4A 55 64 6E 74 86 82 7B 6C 59 44 37 2F 24 19 16 00
					29 01 00 00 00 00 02 00 00
					29 01 00 00 00 00 19 E4 00 08 0F 1A 23 2C 37 4A 55 64 6E 74 86 82 7B 6C 59 44 37 2F 24 19 16 00
					29 01 00 00 00 00 02 00 00
					29 01 00 00 00 00 19 E5 00 08 0F 1A 23 2C 37 4A 55 64 6E 74 86 82 7B 6C 59 44 37 2F 24 19 16 00
					29 01 00 00 00 00 02 00 00
					29 01 00 00 00 00 19 E6 00 08 0F 1A 23 2C 37 4A 55 64 6E 74 86 82 7B 6C 59 44 37 2F 24 19 16 00
					29 01 00 00 00 00 02 00 00
					29 01 00 00 00 00 22 EC 40 44 44 44 34 44 44 44 44 44 44 44 34 44 44 44 44 44 44 44 34 44 44 44 44 44 44 44 34 44 44 44 04
					29 01 00 00 00 00 02 00 00
					29 01 00 00 00 00 22 ED 40 34 44 34 44 44 43 44 43 44 34 44 34 44 44 43 44 43 44 43 44 34 44 34 44 44 43 44 43 44 34 44 04
					29 01 00 00 00 00 02 00 00
					29 01 00 00 00 00 22 EE 40 44 44 44 44 44 44 44 44 44 44 44 44 44 44 44 44 44 44 44 44 44 44 44 44 44 44 44 44 44 44 44 04
					29 01 00 00 00 00 02 00 A4
					29 01 00 00 00 00 02 C5 88
					29 01 00 00 00 00 02 00 C1
					29 01 00 00 00 00 02 C5 f5
					29 01 00 00 00 00 02 00 B3
					29 01 00 00 00 00 02 C0 88
					29 01 00 00 00 00 02 00 B4
					29 01 00 00 00 00 02 C0 00
					29 01 00 00 00 00 02 00 00
					29 01 00 00 00 00 03 D8 23 23
					29 01 00 00 00 00 02 00 80
					29 01 00 00 00 00 02 C4 81
					29 01 00 00 00 00 02 00 A0
					29 01 00 00 00 00 02 B3 33
					29 01 00 00 00 00 02 00 A6
					29 01 00 00 00 00 02 B3 20
					29 01 00 00 00 00 02 00 E0
					29 01 00 00 00 00 0B B4 1C 19 3F 01 64 5C 01 A0 5F A0
					29 01 00 00 00 00 02 00 F0
					29 01 00 00 00 00 02 B4 64
					29 01 00 00 00 00 02 00 90
					29 01 00 00 00 00 07 C0 00 00 00 02 00 04
					29 01 00 00 00 00 02 00 80
					29 01 00 00 00 00 0F C0 00 71 00 0A 0A 00 71 0A 0A 00 71 00 0A 0A
					29 01 00 00 00 00 02 00 A0
					29 01 00 00 00 00 10 C0 00 00 02 00 04 14 04 00 00 00 00 00 00 00 00	
					29 01 00 00 00 00 02 00 D0
					29 01 00 00 00 00 10 C0 00 00 02 00 04 14 04 00 00 00 00 00 00 00 00
					29 01 00 00 00 00 02 00 80
					29 01 00 00 00 00 0D C2 83 01 00 00 82 01 00 00 00 00 00 00
					29 01 00 00 00 00 02 00 90
					29 01 00 00 00 00 0D C2 00 00 00 00 00 00 00 00 00 00 00 00
					29 01 00 00 00 00 02 00 A0
					29 01 00 00 00 00 0E C2 00 00 00 00 00 00 00 00 00 00 00 00 00
					29 01 00 00 00 00 02 00 B0
					29 01 00 00 00 00 10 C2 82 02 00 00 88 81 02 00 00 88 00 02 00 00 88
					29 01 00 00 00 00 02 00 C0
					29 01 00 00 00 00 10 C2 01 02 00 00 88 00 00 00 00 00 00 00 00 00 00
					29 01 00 00 00 00 02 00 D0
					29 01 00 00 00 00 10 C2 00 00 00 00 00 00 00 00 00 00 33 33 33 33 00
					29 01 00 00 00 00 02 00 80
					29 01 00 00 00 00 10 C3 00 00 00 00 00 00 00 00 00 00 00 00 00 00 00
					29 01 00 00 00 00 02 00 A0
					29 01 00 00 00 00 0D C3 83 01 00 00 82 01 00 00 00 00 00 00
					29 01 00 00 00 00 02 00 B0
					29 01 00 00 00 00 0F C3 00 00 00 00 82 02 00 00 88 81 02 00 00 88
					29 01 00 00 00 00 02 00 C0
					29 01 00 00 00 00 10 C3 00 02 00 00 88 01 02 00 00 88 00 00 00 00 00
					29 01 00 00 00 00 02 00 D0
					29 01 00 00 00 00 10 C3 00 00 00 00 00 00 00 00 00 00 00 00 00 00 00
					29 01 00 00 00 00 02 00 E0
					29 01 00 00 00 00 06 C3 33 33 33 33 00
					29 01 00 00 00 00 02 00 80
					29 01 00 00 00 00 0C CB 00 00 00 00 30 00 03 00 00 00 70
					29 01 00 00 00 00 02 00 90
					29 01 00 00 00 00 10 CB 00 00 00 00 00 00 00 00 00 00 00 00 00 00 00
					29 01 00 00 00 00 02 00 A0
					29 01 00 00 00 00 10 CB 00 00 00 BF 00 00 00 00 00 FF 00 00 00 00 00
					29 01 00 00 00 00 02 00 B0
					29 01 00 00 00 00 0D CB 00 00 00 00 00 00 00 00 00 00 77 77
					29 01 00 00 00 00 02 00 C0
					29 01 00 00 00 00 10 CB 01 01 01 01 01 01 01 01 01 01 01 01 01 01 01
					29 01 00 00 00 00 02 00 D0
					29 01 00 00 00 00 10 CB 01 01 01 F3 01 01 01 01 00 F3 00 00 01 00 01
					29 01 00 00 00 00 02 00 E0
					29 01 00 00 00 00 0D CB 00 01 00 01 00 01 00 01 00 00 77 07
					29 01 00 00 00 00 02 00 F0
					29 01 00 00 00 00 0C CB 00 00 FF FF FF FF 03 22 02 00 70
					29 01 00 00 00 00 02 00 80
					29 01 00 00 00 00 0D CC 08 09 18 19 0C 0D 0E 0F 07 07 07 07
					29 01 00 00 00 00 02 00 90
					29 01 00 00 00 00 0D CC 09 08 19 18 0F 0E 0D 0C 07 07 07 07
					29 01 00 00 00 00 02 00 A0
					29 01 00 00 00 00 10 CC 14 15 16 17 1C 1D 1E 1F 01 04 20 07 07 07 00
					29 01 00 00 00 00 02 00 B0
					29 01 00 00 00 00 0A CC 01 02 03 04 05 06 07 07 00
					29 01 00 00 00 00 02 00 80
					29 01 00 00 00 00 10 CD 1A 01 11 12 1A 05 18 07 1A 1A 23 23 23 1F 1E
					29 01 00 00 00 00 02 00 90
					29 01 00 00 00 00 04 CD 1D 23 23
					29 01 00 00 00 00 02 00 A0
					29 01 00 00 00 00 10 CD 1A 02 11 12 1A 06 18 08 1A 1A 23 23 23 1F 1E
					29 01 00 00 00 00 02 00 B0
					29 01 00 00 00 00 04 CD 1D 23 23
					29 01 00 00 00 00 02 00 80
					29 01 00 00 00 00 0B A4 AF 00 20 04 00 17 15 03 60 00
					29 01 00 00 00 00 02 00 90
					29 01 00 00 00 00 04 A4 00 00 00
					29 01 00 00 00 00 02 00 80
					29 01 00 00 00 00 0D A7 FF 0F 1E 00 1F 00 01 98 00 00 00 00
					29 01 00 00 00 00 02 00 90
					29 01 00 00 00 00 0B A7 1C 1F 3B 00 00 BE 80 BE 05 25
					29 01 00 00 00 00 02 00 A0
					29 01 00 00 00 00 02 A7 30
					29 01 00 00 00 00 02 00 B0
					29 01 00 00 00 00 06 A7 3B 1F 1E 00 00
					29 01 00 00 00 00 02 00 C0
					29 01 00 00 00 00 0D A7 FF 0F 1E 00 1F 00 01 18 00 00 00 00
					29 01 00 00 00 00 02 00 D0
					29 01 00 00 00 00 0B A7 FF FF 1C 00 01 7C 81 7C 0B E0
					29 01 00 00 00 00 02 00 E0
					29 01 00 00 00 00 02 A7 30
					29 01 00 00 00 00 02 00 F0
					29 01 00 00 00 00 06 A7 1C 3E 3D 00 00
					29 01 00 00 00 00 02 00 D0
					29 01 00 00 00 00 0B A7 FF FF 1D 00 01 7C 81 7C 0B E0
					29 01 00 00 00 00 02 00 80
					29 01 00 00 00 00 0D A9 00 00 00 00 00 00 00 00 00 00 00 00
					29 01 00 00 00 00 02 00 90
					29 01 00 00 00 00 0B A9 00 00 00 00 00 00 00 00 00 00
					29 01 00 00 00 00 02 00 A0
					29 01 00 00 00 00 02 A9 00
					29 01 00 00 00 00 02 00 B0
					29 01 00 00 00 00 06 A9 00 00 00 00 00
					29 01 00 00 00 00 02 00 C0
					29 01 00 00 00 00 0F A9 FF 3A 49 00 1E 00 01 00 00 00 00 00 00 77
					29 01 00 00 00 00 02 00 D0
					29 01 00 00 00 00 0B A9 FF FF 1D 00 01 7C 81 7C 0B E0
					29 01 00 00 00 00 02 00 E0
					29 01 00 00 00 00 02 A9 30
					29 01 00 00 00 00 02 00 F0
					29 01 00 00 00 00 06 A9 00 3C 3C 00 00
					29 01 00 00 00 00 02 00 B0
					29 01 00 00 00 00 09 A4 05 25 0B E0 00 00 0B E0
					29 01 00 00 00 00 02 00 80
					29 01 00 00 00 00 10 AB 05 14 00 00 FF 6A 00 00 00 00 00 00 00 00 00
					29 01 00 00 00 00 02 00 A0
					29 01 00 00 00 00 10 AB 00 00 00 00 00 00 00 07 00 00 00 00 01 00 00
					29 01 00 00 00 00 02 00 B0
					29 01 00 00 00 00 0D AB 00 00 68 0A 00 00 44 04 00 00 00 00
					29 01 00 00 00 00 02 00 93
					29 01 00 00 00 00 02 B3 01
					29 01 00 00 00 00 02 00 80
					29 01 00 00 00 00 08 CE 00 00 00 00 00 00 00
					29 01 00 00 00 00 02 00 87
					29 01 00 00 00 00 08 CE 00 00 33 00 33 00 00
					29 01 00 00 00 00 02 00 F0
					29 01 00 00 00 00 05 CE 00 00 00 00
					29 01 00 00 00 00 02 00 90
					29 01 00 00 00 00 10 CE 00 00 00 F0 00 00 00 00 FC 00 FC 00 00 00 00
					29 01 00 00 00 00 02 00 A0
					29 01 00 00 00 00 08 CE 00 00 40 40 40 00 00
					29 01 00 00 00 00 02 00 B0
					29 01 00 00 00 00 10 CE 01 01 01 01 01 01 01 01 F1 01 F1 01 01 01 01
					29 01 00 00 00 00 02 00 C0
					29 01 00 00 00 00 08 CE 01 01 01 01 01 01 01
					29 01 00 00 00 00 02 00 D0
					29 01 00 00 00 00 10 CE 04 04 04 04 04 04 04 04 F7 04 F7 04 04 00 00
					29 01 00 00 00 00 02 00 E0
					29 01 00 00 00 00 08 CE 00 00 15 15 15 04 04
					29 01 00 00 00 00 02 00 F4
					29 01 00 00 00 00 02 CE 25
					29 01 00 00 00 00 02 00 A0
					29 01 00 00 00 00 0D D6 02 fe 03 02 fc f5 fc 0c 02 f3 f1 05
					29 01 00 00 00 00 02 00 B0
					29 01 00 00 00 00 0D D6 00 00 cd e6 cd b3 66 fd fd fd da 00
					29 01 00 00 00 00 02 00 C0
					29 01 00 00 00 00 0D D6 00 00 89 9a 89 77 44 a9 a9 a9 91 00
					29 01 00 00 00 00 02 00 D0
					29 01 00 00 00 00 0D D6 00 09 44 4d 44 3c 22 54 54 54 49 00
					29 01 00 00 00 00 02 00 00
					29 01 00 00 00 00 02 81 80
					29 01 00 00 00 00 02 00 80
					29 01 00 00 00 00 03 FF 00 00
					29 01 00 00 00 00 02 00 00
					29 01 00 00 00 00 04 FF 00 00 00
					29 00 00 00 00 00 02 53 24
					29 01 00 00 00 00 02 55 01
                    29 01 00 00 00 00 02 5E 28
					29 00 00 00 00 00 02 35 00
					15 00 00 00 00 00 02 51 00
					29 00 00 00 00 00 05 2A 00 00 04 37
					29 00 00 00 00 00 05 2B 00 00 07 7F
					05 01 00 00 78 00 02 11 00
					05 01 00 00 28 00 02 29 00];
		qcom,mdss-dsi-off-command = [05 01 00 00 28 00 02 28 00
					05 01 00 00 78 00 02 10 00];
		qcom,mdss-dsi-on-command-state = "dsi_lp_mode";
		qcom,mdss-dsi-off-command-state = "dsi_hs_mode";
		qcom,mdss-dsi-h-sync-pulse = <1>;
		qcom,mdss-dsi-traffic-mode = "burst_mode";
		qcom,mdss-dsi-lane-map = "lane_map_0123";
		qcom,mdss-dsi-bllp-eof-power-mode;
		qcom,mdss-dsi-bllp-power-mode;
		qcom,mdss-dsi-lane-0-state;
		qcom,mdss-dsi-lane-1-state;
		qcom,mdss-dsi-lane-2-state;
		qcom,mdss-dsi-lane-3-state;
		qcom,mdss-dsi-te-pin-select = <1>;
		qcom,mdss-dsi-te-v-sync-rd-ptr-irq-line = <0x2c>;
		qcom,mdss-dsi-te-dcs-command = <1>;
		qcom,mdss-dsi-te-check-enable;
		qcom,mdss-dsi-te-using-te-pin;
		qcom,mdss-dsi-panel-timings = [E6 38 26 00 68 6c 2a 3c 2c 03 04 00];
		qcom,mdss-dsi-t-clk-post = <0x2c>;
		qcom,mdss-dsi-t-clk-pre = <0x1c>;
		qcom,mdss-dsi-bl-min-level = <6>;
		qcom,mdss-dsi-bl-max-level = <250>;
		qcom,mdss-dsi-dma-trigger = "trigger_sw";
		qcom,mdss-dsi-mdp-trigger = "none";
		qcom,mdss-dsi-bl-pmic-control-type = "bl_ctrl_dcs";
		qcom,panel-cabc-ui-cmds = [15 01 00 00 00 00 02 55 01
					15 01 00 00 00 00 02 53 24];
		qcom,panel-cabc-video-cmds = [15 01 00 00 00 00 02 55 03
					   15 01 00 00 00 00 02 53 2C];
		qcom,cabc-ui-cmds-dsi-state = "dsi_lp_mode";
		qcom,cabc-video-cmds-dsi-state = "dsi_lp_mode";
		qcom,panel-dot-inversion-mode-cmds = [29 01 00 00 00 00 02 00 00
                          29 01 00 00 00 00 04 FF 19 06 01
                          29 01 00 00 00 00 02 00 80
                          29 01 00 00 00 00 03 FF 19 06
                          29 01 00 00 00 00 02 00 B3
                          29 01 00 00 00 00 02 C0 00
                          29 01 00 00 00 00 02 00 80
                          29 01 00 00 00 00 03 FF 00 00
                          29 01 00 00 00 00 02 00 00
                          29 01 00 00 00 00 04 FF 00 00 00];
		qcom,panel-column-inversion-mode-cmds = [29 01 00 00 00 00 02 00 00
                             29 01 00 00 00 00 04 FF 19 06 01
                             29 01 00 00 00 00 02 00 80
                             29 01 00 00 00 00 03 FF 19 06
                             29 01 00 00 00 00 02 00 B3
                             29 01 00 00 00 00 02 C0 88
                             29 01 00 00 00 00 02 00 80
                             29 01 00 00 00 00 03 FF 00 00
                             29 01 00 00 00 00 02 00 00
                             29 01 00 00 00 00 04 FF 00 00 00];
		qcom,dot-inversion-cmds-dsi-state = "dsi_lp_mode";
		qcom,column-inversion-cmds-dsi-state = "dsi_lp_mode";
		qcom,panel-esd-check-enabled;
		qcom,panel-esd-read-commands = [06 01 00 00 00 00 02 0A 9C];
		qcom,mdss-dsi-lp11-init;
		qcom,mdss-pan-physical-width-dimension = <68>;
		qcom,mdss-pan-physical-height-dimension = <121>;
		qcom,mdss-dsi-mipi-rst-delay = <80>;
		huawei,mdss-dsi-lens-type = <2>;
			qcom,mdss-dsi-reset-sequence = <1 15>, <0 5>, <1 15>;

	};
};
