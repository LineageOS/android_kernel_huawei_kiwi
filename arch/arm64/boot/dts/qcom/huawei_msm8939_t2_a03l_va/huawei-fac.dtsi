 / {
        huawei_fac_info {
                  compatible = "huawei,hw_fac_info";
                  fac,product_name = "HUAWEI FDR-A03L";
                  fac,hardware_ver = "SH1FDRA03LM_VERA";
                  fac,software_ver = "MSM8939_FDR_A03L_VA";
                  status = "ok";
        };
};
