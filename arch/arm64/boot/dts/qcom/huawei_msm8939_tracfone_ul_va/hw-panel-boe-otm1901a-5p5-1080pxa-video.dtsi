/* Copyright (c) 2013, The Linux Foundation. All rights reserved.
 *
 * This program is free software; you can redistribute it and/or modify
 * it under the terms of the GNU General Public License version 2 and
 * only version 2 as published by the Free Software Foundation.
 *
 * This program is distributed in the hope that it will be useful,
 * but WITHOUT ANY WARRANTY; without even the implied warranty of
 * MERCHANTABILITY or FITNESS FOR A PARTICULAR PURPOSE.  See the
 * GNU General Public License for more details.
 */

/*---------------------------------------------------------------------------
 * This file is autogenerated file using gcdb parser. Please do not edit it.
 * Update input XML file to add a new entry or update variable in this file
 * VERSION = "1.0"
 *---------------------------------------------------------------------------*/
&mdss_mdp {
	dsi_boe_otm1901a_5p5_1080pxa_video: qcom,mdss_dsi_boe_otm1901a_5p5_1080pxa_video {
		qcom,mdss-dsi-panel-name = "BOE_OTM1901A_5P5_1080PXA_VIDEO";
		qcom,cont-splash-enabled;
		qcom,mdss-dsi-panel-controller = <&mdss_dsi0>;
		qcom,mdss-dsi-panel-type = "dsi_video_mode";
		qcom,mdss-dsi-panel-destination = "display_1";
		qcom,mdss-dsi-panel-clockrate = <897610000>;
		qcom,mdss-dsi-panel-framerate = <60>;
		qcom,mdss-dsi-virtual-channel-id = <0>;
		qcom,mdss-dsi-stream = <0>;
		qcom,mdss-dsi-panel-width = <1080>;
		qcom,mdss-dsi-panel-height = <1920>;
		qcom,mdss-dsi-h-front-porch = <104>;
		qcom,mdss-dsi-h-back-porch = <54>;
		qcom,mdss-dsi-h-pulse-width = <20>;
		qcom,mdss-dsi-h-sync-skew = <0>;
		qcom,mdss-dsi-v-back-porch = <46>;
		qcom,mdss-dsi-v-front-porch = <14>;
		qcom,mdss-dsi-v-pulse-width = <2>;
		qcom,mdss-dsi-h-left-border = <0>;
		qcom,mdss-dsi-h-right-border = <0>;
		qcom,mdss-dsi-v-top-border = <0>;
		qcom,mdss-dsi-v-bottom-border = <0>;
		qcom,mdss-dsi-bpp = <24>;
		qcom,mdss-dsi-underflow-color = <0x00>;
		qcom,mdss-dsi-border-color = <0>;
		qcom,mdss-dsi-color-order = "rgb_swap_rgb";
		qcom,mdss-dsi-on-command = [29 01 00 00 00 00 02 00 00
					29 01 00 00 00 00 04 FF 19 01 01
					29 01 00 00 00 00 02 00 80
					29 01 00 00 00 00 03 FF 19 01
					29 01 00 00 00 00 02 00 00
					29 01 00 00 00 00 02 1C 33
					29 01 00 00 00 00 02 00 A0
					29 01 00 00 00 00 02 C1 E8
					29 01 00 00 00 00 02 00 A7
					29 01 00 00 00 00 02 C1 00
					29 01 00 00 00 00 02 00 90
					29 01 00 00 00 00 07 C0 00 2F 00 00 00 01
					29 01 00 00 00 00 02 00 C0
					29 01 00 00 00 00 07 C0 00 2F 00 00 00 01
					29 01 00 00 00 00 02 00 9A
					29 01 00 00 00 00 02 C0 1E
					29 01 00 00 00 00 02 00 AC
					29 01 00 00 00 00 02 C0 06
					29 01 00 00 00 00 02 00 DC
					29 01 00 00 00 00 02 C0 06
					29 01 00 00 00 00 02 00 81
					29 01 00 00 00 00 02 A5 04
					29 01 00 00 00 00 02 00 84
					29 01 00 00 00 00 02 C4 20
					29 01 00 00 00 00 02 00 A5
					29 01 00 00 00 00 02 B3 1D
					29 01 00 00 00 00 02 00 92
					29 01 00 00 00 00 02 E9 00
					29 01 00 00 00 00 02 00 90
					29 01 00 00 00 00 02 F3 01
					29 01 00 00 00 00 02 00 F7
					29 01 00 00 00 00 05 C3 04 18 04 04
					29 01 00 00 00 00 02 00 B4
					29 01 00 00 00 00 02 C0 80
					29 01 00 00 00 00 02 00 93
					29 01 00 00 00 00 02 C5 19
					29 01 00 00 00 00 02 00 95
					29 01 00 00 00 00 02 C5 2D
					29 01 00 00 00 00 02 00 97
					29 01 00 00 00 00 02 C5 14
					29 01 00 00 00 00 02 00 99
					29 01 00 00 00 00 02 C5 29
					29 01 00 00 00 00 02 00 00
					29 01 00 00 00 00 03 D8 23 23
					29 01 00 00 00 00 02 00 00
					29 01 00 00 00 00 19 E1 00 07 09 14 17 1F 2B 3C 47 5C 68 71 88 81 78 64 50 3D 30 29 21 14 0C 03
					29 01 00 00 00 00 02 00 00
					29 01 00 00 00 00 19 E2 00 07 09 14 17 1F 2B 3C 47 5C 68 71 88 81 78 64 50 3D 30 29 21 14 0C 03
					29 01 00 00 00 00 02 00 00
					29 01 00 00 00 00 19 E3 00 07 09 14 17 1F 2B 3C 47 5C 68 71 88 81 78 64 50 3D 30 29 21 14 0C 03
					29 01 00 00 00 00 02 00 00
					29 01 00 00 00 00 19 E4 00 07 09 14 17 1F 2B 3C 47 5C 68 71 88 81 78 64 50 3D 30 29 21 14 0C 03
					29 01 00 00 00 00 02 00 00
					29 01 00 00 00 00 19 E5 00 07 09 14 17 1F 2B 3C 47 5C 68 71 88 81 78 64 50 3D 30 29 21 14 0C 03
					29 01 00 00 00 00 02 00 00
					29 01 00 00 00 00 19 E6 00 07 09 14 17 1F 2B 3C 47 5C 68 71 88 81 78 64 50 3D 30 29 21 14 0C 03
					29 01 00 00 00 00 02 00 81
					29 01 00 00 00 00 02 A5 07
					29 01 00 00 00 00 02 00 9D
					29 01 00 00 00 00 02 C5 77
					29 01 00 00 00 00 02 00 B3
					29 01 00 00 00 00 02 C0 CC
					29 01 00 00 00 00 02 00 BC
					29 01 00 00 00 00 02 C0 00
					29 01 00 00 00 00 02 00 80
					29 01 00 00 00 00 0F C0 00 87 00 0A 0A 00 87 0A 0A 00 87 00 0A 0A
					29 01 00 00 00 00 02 00 F0
					29 01 00 00 00 00 07 C3 22 02 00 00 00 0C
					29 01 00 00 00 00 02 00 A0
					29 01 00 00 00 00 08 C0 00 00 00 00 03 22 03
					29 01 00 00 00 00 02 00 D0
					29 01 00 00 00 00 08 C0 00 00 00 00 03 22 03
					29 01 00 00 00 00 02 00 90
					29 01 00 00 00 00 09 C2 83 01 00 00 82 01 00 00
					29 01 00 00 00 00 02 00 80
					29 01 00 00 00 00 0D C3 82 02 03 00 03 84 81 03 03 00 03 84
					29 01 00 00 00 00 02 00 90
					29 01 00 00 00 00 0D C3 00 01 03 00 03 84 01 02 03 00 03 84
					29 01 00 00 00 00 02 00 80
					29 01 00 00 00 00 10 CC 09 0A 11 12 13 14 15 16 17 18 28 28 28 28 28
					29 01 00 00 00 00 02 00 90
					29 01 00 00 00 00 10 CC 0A 09 14 13 12 11 15 16 17 18 28 28 28 28 28
					29 01 00 00 00 00 02 00 A0
					29 01 00 00 00 00 10 CC 1D 1E 1F 19 1A 1B 1C 20 21 22 23 24 25 26 27
					29 01 00 00 00 00 02 00 C0
					29 01 00 00 00 00 0D CC 00 00 00 00 00 00 00 00 00 00 00 77
					29 01 00 00 00 00 02 00 D0
					29 01 00 00 00 00 0D CC 00 00 00 00 05 00 00 00 00 00 00 77
					29 01 00 00 00 00 02 00 80
					29 01 00 00 00 00 10 CB 00 00 00 00 00 00 00 00 00 00 00 00 00 00 00
					29 01 00 00 00 00 02 00 90
					29 01 00 00 00 00 10 CB 00 00 00 00 00 00 00 00 00 00 00 00 00 00 00
					29 01 00 00 00 00 02 00 A0
					29 01 00 00 00 00 10 CB 01 01 01 01 01 01 00 00 00 00 00 00 00 00 00
					29 01 00 00 00 00 02 00 B0
					29 01 00 00 00 00 10 CB 00 01 FD 00 00 00 00 00 00 00 00 00 00 00 00
					29 01 00 00 00 00 02 00 C0
					29 01 00 00 00 00 09 CB 00 00 00 00 00 00 77 77
					29 01 00 00 00 00 02 00 D0
					29 01 00 00 00 00 09 CB 00 00 00 00 00 00 77 77
					29 01 00 00 00 00 02 00 E0
					29 01 00 00 00 00 09 CB 00 00 00 00 00 00 77 77
					29 01 00 00 00 00 02 00 F0
					29 01 00 00 00 00 09 CB 01 01 01 00 00 00 77 77
					29 01 00 00 00 00 02 00 80
					29 01 00 00 00 00 10 CD 3F 3F 3F 3F 3F 3F 3F 3F 3F 02 12 11 3F 04 3F
					29 01 00 00 00 00 02 00 90
					29 01 00 00 00 00 0C CD 06 3F 3F 26 26 26 21 20 1F 26 26
					29 01 00 00 00 00 02 00 A0
					29 01 00 00 00 00 10 CD 3F 3F 3F 3F 3F 3F 3F 3F 3F 01 12 11 3F 03 3F
					29 01 00 00 00 00 02 00 B0
					29 01 00 00 00 00 0C CD 05 3F 3F 26 26 26 21 20 1F 26 26
					29 01 00 00 00 00 02 00 9B
					29 01 00 00 00 00 03 C5 55 55
					29 01 00 00 00 00 02 00 80
					29 01 00 00 00 00 02 C4 15
					29 01 00 00 00 00 02 00 B0
					29 01 00 00 00 00 09 CC 01 02 03 05 06 07 04 08
					29 01 00 00 00 00 02 00 B0
					29 01 00 00 00 00 02 CA 04
					29 01 00 00 00 00 02 00 B1
					29 01 00 00 00 00 02 CA 04
					29 01 00 00 00 00 02 00 B3
					29 01 00 00 00 00 02 CA 48
					29 01 00 00 00 00 02 00 90
					29 01 00 00 00 00 0A CA CC FF A5 FF 80 FF 00 00 00
					29 01 00 00 00 00 02 00 00
					29 01 00 00 00 00 02 C6 10
					29 01 00 00 00 00 13 C7 A0 9D BB BC B8 DC AA BC BB 88 88 68 45 44 44 44 44 44
					29 01 00 00 00 00 02 00 00
					29 01 00 00 00 00 02 C6 11
					29 01 00 00 00 00 13 C7 A0 AB AB AC A9 CC AA BB AB 88 88 78 56 55 45 44 44 44
					29 01 00 00 00 00 02 00 00
					29 01 00 00 00 00 02 C6 12
					29 01 00 00 00 00 13 C7 A0 AB AA BB 98 CC AA BA AA 88 88 78 56 55 55 55 55 44
					29 01 00 00 00 00 02 00 00
					29 01 00 00 00 00 02 C6 13
					29 01 00 00 00 00 13 C7 90 AB A9 BB 98 CB A9 BA AA 88 88 88 57 55 55 55 55 55
					29 01 00 00 00 00 02 00 00
					29 01 00 00 00 00 02 C6 14
					29 01 00 00 00 00 13 C7 90 AA A9 AB 89 CB 99 AA AA 88 88 88 67 66 56 55 55 55
					29 01 00 00 00 00 02 00 00
					29 01 00 00 00 00 02 C6 15
					29 01 00 00 00 00 13 C7 90 9A 9A AA 89 CA 99 AA 9A 88 88 88 67 66 66 66 56 55
					29 01 00 00 00 00 02 00 00
					29 01 00 00 00 00 02 C6 16
					29 01 00 00 00 00 13 C7 90 99 9A AA 89 C9 89 AA A9 88 88 88 67 66 66 66 66 66
					29 01 00 00 00 00 02 00 00
					29 01 00 00 00 00 02 C6 17
					29 01 00 00 00 00 13 C7 90 99 99 AA 88 C9 98 99 9A 88 88 88 78 77 66 66 66 66
					29 01 00 00 00 00 02 00 00
					29 01 00 00 00 00 02 C6 18
					29 01 00 00 00 00 13 C7 80 99 99 A9 98 C8 88 9A 99 88 88 88 78 77 77 67 66 66
					29 01 00 00 00 00 02 00 00
					29 01 00 00 00 00 02 C6 19
					29 01 00 00 00 00 13 C7 80 99 99 A8 88 A9 89 99 99 88 88 88 78 77 77 77 77 66
					29 01 00 00 00 00 02 00 00
					29 01 00 00 00 00 02 C6 1A
					29 01 00 00 00 00 13 C7 80 89 99 99 88 B8 88 99 89 88 88 88 88 77 77 77 77 77
					29 01 00 00 00 00 02 00 00
					29 01 00 00 00 00 02 C6 1B
					29 01 00 00 00 00 13 C7 80 98 98 99 88 A8 88 99 98 88 88 88 88 88 77 77 77 77
					29 01 00 00 00 00 02 00 00
					29 01 00 00 00 00 02 C6 1C
					29 01 00 00 00 00 13 C7 80 98 98 99 88 A8 88 99 98 88 88 88 88 88 77 77 77 77
					29 01 00 00 00 00 02 00 00
					29 01 00 00 00 00 02 C6 1D
					29 01 00 00 00 00 13 C7 80 88 89 98 88 99 88 98 98 88 88 88 88 88 88 78 77 77
					29 01 00 00 00 00 02 00 00
					29 01 00 00 00 00 02 C6 1E
					29 01 00 00 00 00 13 C7 80 88 98 88 89 98 88 88 89 88 88 88 88 88 88 88 78 77
					29 01 00 00 00 00 02 00 00
					29 01 00 00 00 00 02 C6 1F
					29 01 00 00 00 00 13 C7 80 88 88 88 88 98 88 88 98 88 88 88 88 88 88 88 88 78
					29 01 00 00 00 00 02 00 00
					29 01 00 00 00 00 04 FF FF FF FF
					15 01 00 00 00 00 02 51 00
					15 01 00 00 00 00 02 53 24
					15 01 00 00 00 00 02 55 01
					15 01 00 00 00 00 02 5E 28
					05 01 00 00 78 00 02 11 00
					05 01 00 00 14 00 02 29 00];
		qcom,mdss-dsi-off-command = [05 01 00 00 28 00 02 28 00
					05 01 00 00 78 00 02 10 00];
		qcom,mdss-dsi-on-command-state = "dsi_lp_mode";
		qcom,mdss-dsi-off-command-state = "dsi_hs_mode";
		qcom,mdss-dsi-h-sync-pulse = <1>;
		qcom,mdss-dsi-traffic-mode = "burst_mode";
		qcom,mdss-dsi-lane-map = "lane_map_0123";
		qcom,mdss-dsi-bllp-eof-power-mode;
		qcom,mdss-dsi-bllp-power-mode;
		qcom,mdss-dsi-lane-0-state;
		qcom,mdss-dsi-lane-1-state;
		qcom,mdss-dsi-lane-2-state;
		qcom,mdss-dsi-lane-3-state;
		qcom,mdss-dsi-panel-timings = [e6 38 26 00 68 6e 2a 3c 2c 03 04 00];
		qcom,mdss-dsi-t-clk-post = <0x2c>;
		qcom,mdss-dsi-t-clk-pre = <0x2b>;
		qcom,mdss-dsi-bl-min-level = <2>;
		qcom,mdss-dsi-bl-max-level = <255>;
		qcom,mdss-dsi-dma-trigger = "trigger_sw";
		qcom,mdss-dsi-mdp-trigger = "none";
		qcom,mdss-dsi-bl-pmic-control-type = "bl_ctrl_dcs";
		qcom,panel-cabc-ui-cmds = [15 01 00 00 00 00 02 55 01
					15 01 00 00 00 00 02 53 24];
		qcom,panel-cabc-video-cmds = [15 01 00 00 00 00 02 55 03
					15 01 00 00 00 00 02 53 2C];
		qcom,cabc-ui-cmds-dsi-state = "dsi_hs_mode";
		qcom,cabc-video-cmds-dsi-state = "dsi_lp_mode";
		qcom,panel-dot-inversion-mode-cmds = [29 01 00 00 00 00 02 00 00
					29 01 00 00 00 00 05 FF 19 01 01 00
					29 01 00 00 00 00 02 00 80
					29 01 00 00 00 00 03 FF 19 01
					29 01 00 00 00 00 02 00 B3
					29 01 00 00 00 00 02 C0 DD
					29 01 00 00 00 00 02 00 BC
					29 01 00 00 00 00 02 C0 11
					29 01 00 00 00 00 02 00 00
					29 01 00 00 00 00 02 FB 01
					29 01 00 00 00 00 02 00 00
					29 01 00 00 00 00 04 FF FF FF FF];
		qcom,panel-column-inversion-mode-cmds = [29 01 00 00 00 00 02 00 00
					29 01 00 00 00 00 05 FF 19 01 01 00
					29 01 00 00 00 00 02 00 80
					29 01 00 00 00 00 03 FF 19 01
					29 01 00 00 00 00 02 00 B3
					29 01 00 00 00 00 02 C0 CC
					29 01 00 00 00 00 02 00 BC
					29 01 00 00 00 00 02 C0 00
					29 01 00 00 00 00 02 00 00
					29 01 00 00 00 00 02 FB 01
					29 01 00 00 00 00 02 00 00
					29 01 00 00 00 00 04 FF FF FF FF];
		qcom,dot-inversion-cmds-dsi-state = "dsi_lp_mode";
		qcom,column-inversion-cmds-dsi-state = "dsi_lp_mode";
		qcom,mdss-dsi-lp11-init;
		qcom,mdss-pan-physical-width-dimension = <68>;
		qcom,mdss-pan-physical-height-dimension = <121>;
			qcom,mdss-dsi-reset-sequence = <1 5>, <0 5>, <1 15>;

	};
};
