 / {
        huawei_fac_info {
                  compatible = "huawei,hw_fac_info";
                  fac,product_name = "HUAWEI KIW-L22";
                  fac,hardware_ver = "HL3KIWMAE";
                  fac,software_ver = "MSM8939_KIW_L22_VB";
                  status = "ok";
        };
};
