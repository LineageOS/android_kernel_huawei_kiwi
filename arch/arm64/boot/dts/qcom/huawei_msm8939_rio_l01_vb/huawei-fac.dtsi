 / {
        huawei_fac_info {
                  compatible = "huawei,hw_fac_info";
                  fac,product_name = "HUAWEI RIO-L01";
                  fac,hardware_ver = "HL1RIOL01M";
                  fac,software_ver = "MSM8939_RIO_L01_VB";
                  status = "ok";
        };
};
