 / {
        huawei_fac_info {
                  compatible = "huawei,hw_fac_info";
                  fac,product_name = "HUAWEI G7-L11";
                  fac,hardware_ver = "HL1G760SM";
                  fac,software_ver = "MSM8916_G760-L11_VA";
                  status = "ok";
        };
};
