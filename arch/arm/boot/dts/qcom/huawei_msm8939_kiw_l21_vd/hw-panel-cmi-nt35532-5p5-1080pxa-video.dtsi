/* Copyright (c) 2013, The Linux Foundation. All rights reserved.
 *
 * This program is free software; you can redistribute it and/or modify
 * it under the terms of the GNU General Public License version 2 and
 * only version 2 as published by the Free Software Foundation.
 *
 * This program is distributed in the hope that it will be useful,
 * but WITHOUT ANY WARRANTY; without even the implied warranty of
 * MERCHANTABILITY or FITNESS FOR A PARTICULAR PURPOSE.  See the
 * GNU General Public License for more details.
 */

/*---------------------------------------------------------------------------
 * This file is autogenerated file using gcdb parser. Please do not edit it.
 * Update input XML file to add a new entry or update variable in this file
 * VERSION = "1.0"
 *---------------------------------------------------------------------------*/
&mdss_mdp {
	dsi_cmi_nt35532_5p5_1080pxa_video: qcom,mdss_dsi_cmi_nt35532_5p5_1080pxa_video {
		qcom,mdss-dsi-panel-name = "CMI_NT35532_5P5_1080PXA_VIDEO";
		qcom,cont-splash-enabled;
		qcom,mdss-dsi-panel-controller = <&mdss_dsi0>;
		qcom,mdss-dsi-panel-type = "dsi_video_mode";
		qcom,mdss-dsi-panel-destination = "display_1";
		qcom,mdss-dsi-panel-clockrate = <897730000>;
		qcom,mdss-dsi-panel-framerate = <60>;
		qcom,mdss-dsi-virtual-channel-id = <0>;
		qcom,mdss-dsi-stream = <0>;
		qcom,mdss-dsi-panel-width = <1080>;
		qcom,mdss-dsi-panel-height = <1920>;
		qcom,mdss-dsi-h-front-porch = <94>;
		qcom,mdss-dsi-h-back-porch = <85>;
		qcom,mdss-dsi-h-pulse-width = <12>;
		qcom,mdss-dsi-h-sync-skew = <0>;
		qcom,mdss-dsi-v-back-porch = <8>;
		qcom,mdss-dsi-v-front-porch = <26>;
		qcom,mdss-dsi-v-pulse-width = <8>;
		qcom,mdss-dsi-h-left-border = <0>;
		qcom,mdss-dsi-h-right-border = <0>;
		qcom,mdss-dsi-v-top-border = <0>;
		qcom,mdss-dsi-v-bottom-border = <0>;
		qcom,mdss-dsi-bpp = <24>;
		qcom,mdss-dsi-underflow-color = <0x00>;
		qcom,mdss-dsi-border-color = <0>;
		qcom,mdss-dsi-color-order = "rgb_swap_rgb";
		qcom,mdss-dsi-on-command = [39 01 00 00 00 00 02 FF 01
					39 01 00 00 00 00 02 FB 01
					39 01 00 00 00 00 02 00 01
					39 01 00 00 00 00 02 01 55
					39 01 00 00 00 00 02 02 59
					39 01 00 00 00 00 02 04 0C
					39 01 00 00 00 00 02 05 3B
					39 01 00 00 00 00 02 06 6E
					39 01 00 00 00 00 02 07 C6
					39 01 00 00 00 00 02 0D C5
					39 01 00 00 00 00 02 0E C5
					39 01 00 00 00 00 02 0F E0
					39 01 00 00 00 00 02 10 03
					39 01 00 00 00 00 02 11 64
					39 01 00 00 00 00 02 12 5A
					39 01 00 00 00 00 02 16 18
					39 01 00 00 00 00 02 17 18
					39 01 00 00 00 00 02 68 13
					39 01 00 00 00 00 02 FF 01
					39 01 00 00 00 00 02 FB 01
					39 01 00 00 00 00 02 75 00
					39 01 00 00 00 00 02 76 EA
					39 01 00 00 00 00 02 77 00
					39 01 00 00 00 00 02 78 EE
					39 01 00 00 00 00 02 79 01
					39 01 00 00 00 00 02 7A 05
					39 01 00 00 00 00 02 7B 01
					39 01 00 00 00 00 02 7C 1C
					39 01 00 00 00 00 02 7D 01
					39 01 00 00 00 00 02 7E 2F
					39 01 00 00 00 00 02 7F 01
					39 01 00 00 00 00 02 80 3E
					39 01 00 00 00 00 02 81 01
					39 01 00 00 00 00 02 82 4C
					39 01 00 00 00 00 02 83 01
					39 01 00 00 00 00 02 84 58
					39 01 00 00 00 00 02 85 01
					39 01 00 00 00 00 02 86 64
					39 01 00 00 00 00 02 87 01
					39 01 00 00 00 00 02 88 89
					39 01 00 00 00 00 02 89 01
					39 01 00 00 00 00 02 8A A8
					39 01 00 00 00 00 02 8B 01
					39 01 00 00 00 00 02 8C D9
					39 01 00 00 00 00 02 8D 01
					39 01 00 00 00 00 02 8E FF
					39 01 00 00 00 00 02 8F 02
					39 01 00 00 00 00 02 90 41
					39 01 00 00 00 00 02 91 02
					39 01 00 00 00 00 02 92 72
					39 01 00 00 00 00 02 93 02
					39 01 00 00 00 00 02 94 74
					39 01 00 00 00 00 02 95 02
					39 01 00 00 00 00 02 96 A0
					39 01 00 00 00 00 02 97 02
					39 01 00 00 00 00 02 98 CC
					39 01 00 00 00 00 02 99 02
					39 01 00 00 00 00 02 9A EB
					39 01 00 00 00 00 02 9B 03
					39 01 00 00 00 00 02 9C 17
					39 01 00 00 00 00 02 9D 03
					39 01 00 00 00 00 02 9E 34
					39 01 00 00 00 00 02 9F 03
					39 01 00 00 00 00 02 A0 5E
					39 01 00 00 00 00 02 A2 03
					39 01 00 00 00 00 02 A3 66
					39 01 00 00 00 00 02 A4 03
					39 01 00 00 00 00 02 A5 73
					39 01 00 00 00 00 02 A6 03
					39 01 00 00 00 00 02 A7 82
					39 01 00 00 00 00 02 A9 03
					39 01 00 00 00 00 02 AA 91
					39 01 00 00 00 00 02 AB 03
					39 01 00 00 00 00 02 AC A4
					39 01 00 00 00 00 02 AD 03
					39 01 00 00 00 00 02 AE BB
					39 01 00 00 00 00 02 AF 03
					39 01 00 00 00 00 02 B0 CD
					39 01 00 00 00 00 02 B1 03
					39 01 00 00 00 00 02 B2 CF
					39 01 00 00 00 00 02 B3 00
					39 01 00 00 00 00 02 B4 76
					39 01 00 00 00 00 02 B5 00
					39 01 00 00 00 00 02 B6 DA
					39 01 00 00 00 00 02 B7 01
					39 01 00 00 00 00 02 B8 05
					39 01 00 00 00 00 02 B9 01
					39 01 00 00 00 00 02 BA 1C
					39 01 00 00 00 00 02 BB 01
					39 01 00 00 00 00 02 BC 2F
					39 01 00 00 00 00 02 BD 01
					39 01 00 00 00 00 02 BE 3E
					39 01 00 00 00 00 02 BF 01
					39 01 00 00 00 00 02 C0 4C
					39 01 00 00 00 00 02 C1 01
					39 01 00 00 00 00 02 C2 58
					39 01 00 00 00 00 02 C3 01
					39 01 00 00 00 00 02 C4 64
					39 01 00 00 00 00 02 C5 01
					39 01 00 00 00 00 02 C6 89
					39 01 00 00 00 00 02 C7 01
					39 01 00 00 00 00 02 C8 A8
					39 01 00 00 00 00 02 C9 01
					39 01 00 00 00 00 02 CA D9
					39 01 00 00 00 00 02 CB 01
					39 01 00 00 00 00 02 CC FF
					39 01 00 00 00 00 02 CD 02
					39 01 00 00 00 00 02 CE 41
					39 01 00 00 00 00 02 CF 02
					39 01 00 00 00 00 02 D0 72
					39 01 00 00 00 00 02 D1 02
					39 01 00 00 00 00 02 D2 74
					39 01 00 00 00 00 02 D3 02
					39 01 00 00 00 00 02 D4 A0
					39 01 00 00 00 00 02 D5 02
					39 01 00 00 00 00 02 D6 CC
					39 01 00 00 00 00 02 D7 02
					39 01 00 00 00 00 02 D8 EB
					39 01 00 00 00 00 02 D9 03
					39 01 00 00 00 00 02 DA 17
					39 01 00 00 00 00 02 DB 03
					39 01 00 00 00 00 02 DC 34
					39 01 00 00 00 00 02 DD 03
					39 01 00 00 00 00 02 DE 5E
					39 01 00 00 00 00 02 DF 03
					39 01 00 00 00 00 02 E0 66
					39 01 00 00 00 00 02 E1 03
					39 01 00 00 00 00 02 E2 73
					39 01 00 00 00 00 02 E3 03
					39 01 00 00 00 00 02 E4 82
					39 01 00 00 00 00 02 E5 03
					39 01 00 00 00 00 02 E6 91
					39 01 00 00 00 00 02 E7 03
					39 01 00 00 00 00 02 E8 A4
					39 01 00 00 00 00 02 E9 03
					39 01 00 00 00 00 02 EA BB
					39 01 00 00 00 00 02 EB 03
					39 01 00 00 00 00 02 EC CD
					39 01 00 00 00 00 02 ED 03
					39 01 00 00 00 00 02 EE CF
					39 01 00 00 00 00 02 EF 00
					39 01 00 00 00 00 02 F0 EA
					39 01 00 00 00 00 02 F1 00
					39 01 00 00 00 00 02 F2 EE
					39 01 00 00 00 00 02 F3 01
					39 01 00 00 00 00 02 F4 05
					39 01 00 00 00 00 02 F5 01
					39 01 00 00 00 00 02 F6 1C
					39 01 00 00 00 00 02 F7 01
					39 01 00 00 00 00 02 F8 2F
					39 01 00 00 00 00 02 F9 01
					39 01 00 00 00 00 02 FA 3E
					39 01 00 00 00 00 02 FF 02
					39 01 00 00 00 00 02 FB 01
					39 01 00 00 00 00 02 00 01
					39 01 00 00 00 00 02 01 4C
					39 01 00 00 00 00 02 02 01
					39 01 00 00 00 00 02 03 58
					39 01 00 00 00 00 02 04 01
					39 01 00 00 00 00 02 05 64
					39 01 00 00 00 00 02 06 01
					39 01 00 00 00 00 02 07 89
					39 01 00 00 00 00 02 08 01
					39 01 00 00 00 00 02 09 A8
					39 01 00 00 00 00 02 0A 01
					39 01 00 00 00 00 02 0B D9
					39 01 00 00 00 00 02 0C 01
					39 01 00 00 00 00 02 0D FF
					39 01 00 00 00 00 02 0E 02
					39 01 00 00 00 00 02 0F 41
					39 01 00 00 00 00 02 10 02
					39 01 00 00 00 00 02 11 72
					39 01 00 00 00 00 02 12 02
					39 01 00 00 00 00 02 13 74
					39 01 00 00 00 00 02 14 02
					39 01 00 00 00 00 02 15 A0
					39 01 00 00 00 00 02 16 02
					39 01 00 00 00 00 02 17 CC
					39 01 00 00 00 00 02 18 02
					39 01 00 00 00 00 02 19 EB
					39 01 00 00 00 00 02 1A 03
					39 01 00 00 00 00 02 1B 17
					39 01 00 00 00 00 02 1C 03
					39 01 00 00 00 00 02 1D 34
					39 01 00 00 00 00 02 1E 03
					39 01 00 00 00 00 02 1F 5E
					39 01 00 00 00 00 02 20 03
					39 01 00 00 00 00 02 21 66
					39 01 00 00 00 00 02 22 03
					39 01 00 00 00 00 02 23 73
					39 01 00 00 00 00 02 24 03
					39 01 00 00 00 00 02 25 82
					39 01 00 00 00 00 02 26 03
					39 01 00 00 00 00 02 27 91
					39 01 00 00 00 00 02 28 03
					39 01 00 00 00 00 02 29 A4
					39 01 00 00 00 00 02 2A 03
					39 01 00 00 00 00 02 2B BB
					39 01 00 00 00 00 02 2D 03
					39 01 00 00 00 00 02 2F CD
					39 01 00 00 00 00 02 30 03
					39 01 00 00 00 00 02 31 CF
					39 01 00 00 00 00 02 32 00
					39 01 00 00 00 00 02 33 76
					39 01 00 00 00 00 02 34 00
					39 01 00 00 00 00 02 35 DA
					39 01 00 00 00 00 02 36 01
					39 01 00 00 00 00 02 37 05
					39 01 00 00 00 00 02 38 01
					39 01 00 00 00 00 02 39 1C
					39 01 00 00 00 00 02 3A 01
					39 01 00 00 00 00 02 3B 2F
					39 01 00 00 00 00 02 3D 01
					39 01 00 00 00 00 02 3F 3E
					39 01 00 00 00 00 02 40 01
					39 01 00 00 00 00 02 41 4C
					39 01 00 00 00 00 02 42 01
					39 01 00 00 00 00 02 43 58
					39 01 00 00 00 00 02 44 01
					39 01 00 00 00 00 02 45 64
					39 01 00 00 00 00 02 46 01
					39 01 00 00 00 00 02 47 89
					39 01 00 00 00 00 02 48 01
					39 01 00 00 00 00 02 49 A8
					39 01 00 00 00 00 02 4A 01
					39 01 00 00 00 00 02 4B D9
					39 01 00 00 00 00 02 4C 01
					39 01 00 00 00 00 02 4D FF
					39 01 00 00 00 00 02 4E 02
					39 01 00 00 00 00 02 4F 41
					39 01 00 00 00 00 02 50 02
					39 01 00 00 00 00 02 51 72
					39 01 00 00 00 00 02 52 02
					39 01 00 00 00 00 02 53 74
					39 01 00 00 00 00 02 54 02
					39 01 00 00 00 00 02 55 A0
					39 01 00 00 00 00 02 56 02
					39 01 00 00 00 00 02 58 CC
					39 01 00 00 00 00 02 59 02
					39 01 00 00 00 00 02 5A EB
					39 01 00 00 00 00 02 5B 03
					39 01 00 00 00 00 02 5C 17
					39 01 00 00 00 00 02 5D 03
					39 01 00 00 00 00 02 5E 34
					39 01 00 00 00 00 02 5F 03
					39 01 00 00 00 00 02 60 5E
					39 01 00 00 00 00 02 61 03
					39 01 00 00 00 00 02 62 66
					39 01 00 00 00 00 02 63 03
					39 01 00 00 00 00 02 64 73
					39 01 00 00 00 00 02 65 03
					39 01 00 00 00 00 02 66 82
					39 01 00 00 00 00 02 67 03
					39 01 00 00 00 00 02 68 91
					39 01 00 00 00 00 02 69 03
					39 01 00 00 00 00 02 6A A4
					39 01 00 00 00 00 02 6B 03
					39 01 00 00 00 00 02 6C BB
					39 01 00 00 00 00 02 6D 03
					39 01 00 00 00 00 02 6E CD
					39 01 00 00 00 00 02 6F 03
					39 01 00 00 00 00 02 70 CF
					39 01 00 00 00 00 02 71 00
					39 01 00 00 00 00 02 72 EA
					39 01 00 00 00 00 02 73 00
					39 01 00 00 00 00 02 74 EE
					39 01 00 00 00 00 02 75 01
					39 01 00 00 00 00 02 76 05
					39 01 00 00 00 00 02 77 01
					39 01 00 00 00 00 02 78 1C
					39 01 00 00 00 00 02 79 01
					39 01 00 00 00 00 02 7A 2F
					39 01 00 00 00 00 02 7B 01
					39 01 00 00 00 00 02 7C 3E
					39 01 00 00 00 00 02 7D 01
					39 01 00 00 00 00 02 7E 4C
					39 01 00 00 00 00 02 7F 01
					39 01 00 00 00 00 02 80 58
					39 01 00 00 00 00 02 81 01
					39 01 00 00 00 00 02 82 64
					39 01 00 00 00 00 02 83 01
					39 01 00 00 00 00 02 84 89
					39 01 00 00 00 00 02 85 01
					39 01 00 00 00 00 02 86 A8
					39 01 00 00 00 00 02 87 01
					39 01 00 00 00 00 02 88 D9
					39 01 00 00 00 00 02 89 01
					39 01 00 00 00 00 02 8A FF
					39 01 00 00 00 00 02 8B 02
					39 01 00 00 00 00 02 8C 41
					39 01 00 00 00 00 02 8D 02
					39 01 00 00 00 00 02 8E 72
					39 01 00 00 00 00 02 8F 02
					39 01 00 00 00 00 02 90 74
					39 01 00 00 00 00 02 91 02
					39 01 00 00 00 00 02 92 A0
					39 01 00 00 00 00 02 93 02
					39 01 00 00 00 00 02 94 CC
					39 01 00 00 00 00 02 95 02
					39 01 00 00 00 00 02 96 EB
					39 01 00 00 00 00 02 97 03
					39 01 00 00 00 00 02 98 17
					39 01 00 00 00 00 02 99 03
					39 01 00 00 00 00 02 9A 34
					39 01 00 00 00 00 02 9B 03
					39 01 00 00 00 00 02 9C 5E
					39 01 00 00 00 00 02 9D 03
					39 01 00 00 00 00 02 9E 66
					39 01 00 00 00 00 02 9F 03
					39 01 00 00 00 00 02 A0 73
					39 01 00 00 00 00 02 A2 03
					39 01 00 00 00 00 02 A3 82
					39 01 00 00 00 00 02 A4 03
					39 01 00 00 00 00 02 A5 91
					39 01 00 00 00 00 02 A6 03
					39 01 00 00 00 00 02 A7 A4
					39 01 00 00 00 00 02 A9 03
					39 01 00 00 00 00 02 AA BB
					39 01 00 00 00 00 02 AB 03
					39 01 00 00 00 00 02 AC CD
					39 01 00 00 00 00 02 AD 03
					39 01 00 00 00 00 02 AE CF
					39 01 00 00 00 00 02 AF 00
					39 01 00 00 00 00 02 B0 76
					39 01 00 00 00 00 02 B1 00
					39 01 00 00 00 00 02 B2 DA
					39 01 00 00 00 00 02 B3 01
					39 01 00 00 00 00 02 B4 05
					39 01 00 00 00 00 02 B5 01
					39 01 00 00 00 00 02 B6 1C
					39 01 00 00 00 00 02 B7 01
					39 01 00 00 00 00 02 B8 2F
					39 01 00 00 00 00 02 B9 01
					39 01 00 00 00 00 02 BA 3E
					39 01 00 00 00 00 02 BB 01
					39 01 00 00 00 00 02 BC 4C
					39 01 00 00 00 00 02 BD 01
					39 01 00 00 00 00 02 BE 58
					39 01 00 00 00 00 02 BF 01
					39 01 00 00 00 00 02 C0 64
					39 01 00 00 00 00 02 C1 01
					39 01 00 00 00 00 02 C2 89
					39 01 00 00 00 00 02 C3 01
					39 01 00 00 00 00 02 C4 A8
					39 01 00 00 00 00 02 C5 01
					39 01 00 00 00 00 02 C6 D9
					39 01 00 00 00 00 02 C7 01
					39 01 00 00 00 00 02 C8 FF
					39 01 00 00 00 00 02 C9 02
					39 01 00 00 00 00 02 CA 41
					39 01 00 00 00 00 02 CB 02
					39 01 00 00 00 00 02 CC 72
					39 01 00 00 00 00 02 CD 02
					39 01 00 00 00 00 02 CE 74
					39 01 00 00 00 00 02 CF 02
					39 01 00 00 00 00 02 D0 A0
					39 01 00 00 00 00 02 D1 02
					39 01 00 00 00 00 02 D2 CC
					39 01 00 00 00 00 02 D3 02
					39 01 00 00 00 00 02 D4 EB
					39 01 00 00 00 00 02 D5 03
					39 01 00 00 00 00 02 D6 17
					39 01 00 00 00 00 02 D7 03
					39 01 00 00 00 00 02 D8 34
					39 01 00 00 00 00 02 D9 03
					39 01 00 00 00 00 02 DA 5E
					39 01 00 00 00 00 02 DB 03
					39 01 00 00 00 00 02 DC 66
					39 01 00 00 00 00 02 DD 03
					39 01 00 00 00 00 02 DE 73
					39 01 00 00 00 00 02 DF 03
					39 01 00 00 00 00 02 E0 82
					39 01 00 00 00 00 02 E1 03
					39 01 00 00 00 00 02 E2 91
					39 01 00 00 00 00 02 E3 03
					39 01 00 00 00 00 02 E4 A4
					39 01 00 00 00 00 02 E5 03
					39 01 00 00 00 00 02 E6 BB
					39 01 00 00 00 00 02 E7 03
					39 01 00 00 00 00 02 E8 CD
					39 01 00 00 00 00 02 E9 03
					39 01 00 00 00 00 02 EA CF
					39 01 00 00 00 00 02 FF 04
					39 01 00 00 00 00 02 FB 01
					39 01 00 00 00 00 02 13 F3
					39 01 00 00 00 00 02 14 F2
					39 01 00 00 00 00 02 15 F1
					39 01 00 00 00 00 02 16 F0
					39 01 00 00 00 00 02 21 FF
					39 01 00 00 00 00 02 22 F4
					39 01 00 00 00 00 02 23 E9
					39 01 00 00 00 00 02 24 DE
					39 01 00 00 00 00 02 25 D3
					39 01 00 00 00 00 02 26 C8
					39 01 00 00 00 00 02 27 BD
					39 01 00 00 00 00 02 28 B2
					39 01 00 00 00 00 02 29 A7
					39 01 00 00 00 00 02 2A 9C
					39 01 00 00 00 00 02 07 20
					39 01 00 00 00 00 02 08 07
					39 01 00 00 00 00 02 46 00
					39 01 00 00 00 00 02 FF 05
					39 01 00 00 00 00 02 FB 01
					39 01 00 00 00 00 02 00 40
					39 01 00 00 00 00 02 01 40
					39 01 00 00 00 00 02 02 40
					39 01 00 00 00 00 02 03 06
					39 01 00 00 00 00 02 04 40
					39 01 00 00 00 00 02 05 16
					39 01 00 00 00 00 02 06 18
					39 01 00 00 00 00 02 07 1A
					39 01 00 00 00 00 02 08 1C
					39 01 00 00 00 00 02 09 1E
					39 01 00 00 00 00 02 0A 20
					39 01 00 00 00 00 02 0B 40
					39 01 00 00 00 00 02 0C 40
					39 01 00 00 00 00 02 0D 26
					39 01 00 00 00 00 02 0E 28
					39 01 00 00 00 00 02 0F 08
					39 01 00 00 00 00 02 10 38
					39 01 00 00 00 00 02 11 38
					39 01 00 00 00 00 02 12 38
					39 01 00 00 00 00 02 13 0E
					39 01 00 00 00 00 02 14 40
					39 01 00 00 00 00 02 15 40
					39 01 00 00 00 00 02 16 40
					39 01 00 00 00 00 02 17 07
					39 01 00 00 00 00 02 18 40
					39 01 00 00 00 00 02 19 17
					39 01 00 00 00 00 02 1A 19
					39 01 00 00 00 00 02 1B 1B
					39 01 00 00 00 00 02 1C 1D
					39 01 00 00 00 00 02 1D 1F
					39 01 00 00 00 00 02 1E 21
					39 01 00 00 00 00 02 1F 40
					39 01 00 00 00 00 02 20 40
					39 01 00 00 00 00 02 21 26
					39 01 00 00 00 00 02 22 28
					39 01 00 00 00 00 02 23 09
					39 01 00 00 00 00 02 24 38
					39 01 00 00 00 00 02 25 38
					39 01 00 00 00 00 02 26 38
					39 01 00 00 00 00 02 27 0F
					39 01 00 00 00 00 02 28 40
					39 01 00 00 00 00 02 29 40
					39 01 00 00 00 00 02 2A 40
					39 01 00 00 00 00 02 2B 09
					39 01 00 00 00 00 02 2D 40
					39 01 00 00 00 00 02 2F 19
					39 01 00 00 00 00 02 30 17
					39 01 00 00 00 00 02 31 21
					39 01 00 00 00 00 02 32 1F
					39 01 00 00 00 00 02 33 1D
					39 01 00 00 00 00 02 34 1B
					39 01 00 00 00 00 02 35 40
					39 01 00 00 00 00 02 36 40
					39 01 00 00 00 00 02 37 26
					39 01 00 00 00 00 02 38 28
					39 01 00 00 00 00 02 39 07
					39 01 00 00 00 00 02 3A 38
					39 01 00 00 00 00 02 3B 38
					39 01 00 00 00 00 02 3D 38
					39 01 00 00 00 00 02 3F 0F
					39 01 00 00 00 00 02 40 40
					39 01 00 00 00 00 02 41 40
					39 01 00 00 00 00 02 42 40
					39 01 00 00 00 00 02 43 08
					39 01 00 00 00 00 02 44 40
					39 01 00 00 00 00 02 45 18
					39 01 00 00 00 00 02 46 16
					39 01 00 00 00 00 02 47 20
					39 01 00 00 00 00 02 48 1E
					39 01 00 00 00 00 02 49 1C
					39 01 00 00 00 00 02 4A 1A
					39 01 00 00 00 00 02 4B 40
					39 01 00 00 00 00 02 4C 40
					39 01 00 00 00 00 02 4D 26
					39 01 00 00 00 00 02 4E 28
					39 01 00 00 00 00 02 4F 06
					39 01 00 00 00 00 02 50 38
					39 01 00 00 00 00 02 51 38
					39 01 00 00 00 00 02 52 38
					39 01 00 00 00 00 02 53 0E
					39 01 00 00 00 00 02 54 07
					39 01 00 00 00 00 02 55 19
					39 01 00 00 00 00 02 59 24
					39 01 00 00 00 00 02 5B 4F
					39 01 00 00 00 00 02 5C 2C
					39 01 00 00 00 00 02 5D 01
					39 01 00 00 00 00 02 5E 22
					39 01 00 00 00 00 02 62 21
					39 01 00 00 00 00 02 63 69
					39 01 00 00 00 00 02 64 12
					39 01 00 00 00 00 02 66 57
					39 01 00 00 00 00 02 67 11
					39 01 00 00 00 00 02 68 2B
					39 01 00 00 00 00 02 69 12
					39 01 00 00 00 00 02 6A 05
					39 01 00 00 00 00 02 6B 29
					39 01 00 00 00 00 02 6C 08
					39 01 00 00 00 00 02 6D 18
					39 01 00 00 00 00 02 6F 3C
					39 01 00 00 00 00 02 70 03
					39 01 00 00 00 00 02 72 22
					39 01 00 00 00 00 02 73 22
					39 01 00 00 00 00 02 7D 01
					39 01 00 00 00 00 02 7E AA
					39 01 00 00 00 00 02 7F AA
					39 01 00 00 00 00 02 80 AA
					39 01 00 00 00 00 02 81 00
					39 01 00 00 00 00 02 85 3F
					39 01 00 00 00 00 02 86 3F
					39 01 00 00 00 00 02 A2 B0
					39 01 00 00 00 00 02 BD A6
					39 01 00 00 00 00 02 BE 08
					39 01 00 00 00 00 02 BF 12
					39 01 00 00 00 00 02 C8 00
					39 01 00 00 00 00 02 C9 00
					39 01 00 00 00 00 02 CA 00
					39 01 00 00 00 00 02 CB 00
					39 01 00 00 00 00 02 CC 09
					39 01 00 00 00 00 02 CE 18
					39 01 00 00 00 00 02 CF 88
					39 01 00 00 00 00 02 D0 00
					39 01 00 00 00 00 02 D1 00
					39 01 00 00 00 00 02 D2 00
					39 01 00 00 00 00 02 D3 00
					39 01 00 00 00 00 02 D4 40
					39 01 00 00 00 00 02 D6 22
					39 01 00 00 00 00 02 90 7B
					39 01 00 00 00 00 02 91 10
					39 01 00 00 00 00 02 92 10
					39 01 00 00 00 00 02 98 00
					39 01 00 00 00 00 02 99 00
					39 01 00 00 00 00 02 9F 0F
					39 01 00 00 00 00 02 FF 00
					39 01 00 00 00 00 02 FB 01
					39 01 00 00 00 00 02 BA C3
					39 01 00 00 00 00 02 D3 10
					39 01 00 00 00 00 02 D4 1a
					39 01 00 00 00 00 02 D5 14
					39 01 00 00 00 00 02 D6 14
					15 01 00 00 00 00 02 5E 28
					15 01 00 00 00 00 02 51 00
					15 01 00 00 00 00 02 53 24
					15 01 00 00 00 00 02 55 01
					05 01 00 00 78 00 02 11 00
					05 01 00 00 14 00 02 29 00];
		qcom,mdss-dsi-off-command = [39 01 00 00 00 00 02 FF 00
					39 01 00 00 00 00 02 FB 01
					05 01 00 00 14 00 02 28 00
					05 01 00 00 78 00 02 10 00];
		qcom,mdss-dsi-on-command-state = "dsi_lp_mode";
		qcom,mdss-dsi-off-command-state = "dsi_hs_mode";
		qcom,mdss-dsi-h-sync-pulse = <1>;
		qcom,mdss-dsi-traffic-mode = "burst_mode";
		qcom,mdss-dsi-lane-map = "lane_map_0123";
		qcom,mdss-dsi-bllp-eof-power-mode;
		qcom,mdss-dsi-bllp-power-mode;
		qcom,mdss-dsi-lane-0-state;
		qcom,mdss-dsi-lane-1-state;
		qcom,mdss-dsi-lane-2-state;
		qcom,mdss-dsi-lane-3-state;
		qcom,mdss-dsi-panel-timings = [e6 38 26 00 68 6e 2a 3c 2c 03 04 00];
		qcom,mdss-dsi-t-clk-post = <0x2c>;
		qcom,mdss-dsi-t-clk-pre = <0x2b>;
		qcom,mdss-dsi-bl-min-level = <2>;
		qcom,mdss-dsi-bl-max-level = <255>;
		qcom,mdss-dsi-dma-trigger = "trigger_sw";
		qcom,mdss-dsi-mdp-trigger = "none";
		qcom,mdss-dsi-bl-pmic-control-type = "bl_ctrl_dcs";
		qcom,panel-cabc-ui-cmds = [39 01 00 00 00 00 02 FF 00
					39 01 00 00 00 00 02 FB 01
					15 01 00 00 00 00 02 55 01
					15 01 00 00 00 00 02 53 24
					29 01 00 00 00 00 02 FF 04
					29 01 00 00 00 00 02 FB 01
					29 01 00 00 00 00 02 13 F3
					29 01 00 00 00 00 02 14 F2
					29 01 00 00 00 00 02 15 F1
					29 01 00 00 00 00 02 16 F0
					29 01 00 00 00 00 02 FF 00
					29 01 00 00 00 00 02 FB 01
					];
		qcom,panel-cabc-video-cmds = [39 01 00 00 00 00 02 FF 00
					39 01 00 00 00 00 02 FB 01
					15 01 00 00 00 00 02 55 03
					15 01 00 00 00 00 02 53 2C
					29 01 00 00 00 00 02 FF 04
					29 01 00 00 00 00 02 FB 01
					29 01 00 00 00 00 02 21 FF
					29 01 00 00 00 00 02 22 F4
					29 01 00 00 00 00 02 23 E9
					29 01 00 00 00 00 02 24 DE
					29 01 00 00 00 00 02 25 D3
					29 01 00 00 00 00 02 26 C8
					29 01 00 00 00 00 02 27 BD
					29 01 00 00 00 00 02 28 B2
					29 01 00 00 00 00 02 29 A7
					29 01 00 00 00 00 02 2A 9C
					29 01 00 00 00 00 02 FF 00
					29 01 00 00 00 00 02 FB 01
					];
		qcom,cabc-ui-cmds-dsi-state = "dsi_lp_mode";
		qcom,cabc-video-cmds-dsi-state = "dsi_lp_mode";
		qcom,panel-dot-inversion-mode-cmds = [39 01 00 00 00 00 02 FF 05
					39 01 00 00 00 00 02 FB 01
					39 01 00 00 00 00 02 9F 01
					39 01 00 00 00 00 02 FF 00
					39 01 00 00 00 00 02 FB 01];
		qcom,panel-column-inversion-mode-cmds = [39 01 00 00 00 00 02 FF 05
					39 01 00 00 00 00 02 FB 01
					39 01 00 00 00 00 02 9F 0F
					39 01 00 00 00 00 02 FF 00
					39 01 00 00 00 00 02 FB 01];
		qcom,dot-inversion-cmds-dsi-state = "dsi_lp_mode";
		qcom,column-inversion-cmds-dsi-state = "dsi_lp_mode";
		qcom,mdss-dsi-lp11-init;
		qcom,mdss-pan-physical-width-dimension = <68>;
		qcom,mdss-pan-physical-height-dimension = <121>;
			qcom,mdss-dsi-reset-sequence = <1 5>, <0 5>, <1 15>;

	};
};
