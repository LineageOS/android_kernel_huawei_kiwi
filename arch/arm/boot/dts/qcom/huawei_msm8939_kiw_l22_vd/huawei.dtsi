#include "../kiwi/huawei.dtsi"
#include "../kiwi/huawei-camera-vc.dtsi"
#include "../kiwi/huawei-sensors-vc.dtsi"

/ {
	huawei_audio_info {
		product-identifier = "kiw_l";
	};

	qcom,hw-camera-board-id {
		compatible = "qcom,hw-camera-board-id";
		qcom,product-name = "msm8939_kiw_l22_vc";
	};

	huawei_fac_info {
		compatible = "huawei,hw_fac_info";
		fac,product_name = "HUAWEI KIW-L22";
		fac,hardware_ver = "HL3KIWMAE";
		fac,software_ver = "MSM8939_KIW_L22_VD";
		status = "ok";
	};
};
