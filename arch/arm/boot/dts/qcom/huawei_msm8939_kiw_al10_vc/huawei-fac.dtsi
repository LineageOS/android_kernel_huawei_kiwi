 / {
        huawei_fac_info {
                  compatible = "huawei,hw_fac_info";
                  fac,product_name = "HUAWEI KIW-AL10";
                  fac,hardware_ver = "HL1KIWMAJ";
                  fac,software_ver = "MSM8939_KIW_AL10_VC";
                  status = "ok";
        };
};
