#include "../kiwi/huawei.dtsi"
#include "../kiwi/huawei-camera-vc.dtsi"
#include "../kiwi/huawei-sensors-vc.dtsi"
#include "../kiwi/huawei-rmtfs.dtsi"

/ {
	huawei_audio_info {
		product-identifier = "kiw";
	};

	qcom,hw-camera-board-id {
		compatible = "qcom,hw-camera-board-id";
		qcom,product-name = "msm8939_kiw_ul00_vc";
	};

	huawei_fac_info {
		compatible = "huawei,hw_fac_info";
		fac,product_name = "HUAWEI KIW-UL00";
		fac,hardware_ver = "HL1KIWMAM";
		fac,software_ver = "MSM8939_KIW_UL00_VC";
		status = "ok";
	};
};
