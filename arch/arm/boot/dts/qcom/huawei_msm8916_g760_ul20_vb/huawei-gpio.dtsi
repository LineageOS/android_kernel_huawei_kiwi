/* < DTS201505289999M zhujie 20150528 begin */
/* Copyright (c) 2013, The Linux Foundation. All rights reserved.
 *
 * This program is free software; you can redistribute it and/or modify
 * it under the terms of the GNU General Public License version 2 and
 * only version 2 as published by the Free Software Foundation.
 *
 * This program is distributed in the hope that it will be useful,
 * but WITHOUT ANY WARRANTY; without even the implied warranty of
 * MERCHANTABILITY or FITNESS FOR A PARTICULAR PURPOSE.  See the
 * GNU General Public License for more details.
 */

&soc {
nc_gpio {
    compatible = "qcom,sleep_gpio";
    ngpio = <18>;
    gpio = <0 74 82 83 87 88 89 92 94 95 101 102 105 106 112 116 118 119>;
    status = "okay";
    };
};
/* DTS201505289999M zhujie 20150528 end >*/
