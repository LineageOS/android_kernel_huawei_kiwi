#include "../kiwi/huawei.dtsi"
#include "../kiwi/huawei-camera-vb.dtsi"
#include "../kiwi/huawei-sensors-vb.dtsi"

/ {
    huawei_audio_info {
        product-identifier = "kiw_l";
    };

    qcom,hw-camera-board-id {
		compatible = "qcom,hw-camera-board-id";
		qcom,product-name = "msm8939_kiw_l21";
	};

        huawei_fac_info {
                  compatible = "huawei,hw_fac_info";
                  fac,product_name = "HUAWEI KIW-L21";
                  fac,hardware_ver = "HL3KIWMAD";
                  fac,software_ver = "MSM8939_KIW_L21_VB";
                  status = "ok";
        };
};
