 / {
        huawei_fac_info {
                  compatible = "huawei,hw_fac_info";
                  fac,product_name = "HUAWEI FDR-A02L";
                  fac,hardware_ver = "SH1FDRA02LM_VERA";
                  fac,software_ver = "MSM8939_FDR_A02L_VA";
                  status = "ok";
        };
};
