 / {
        huawei_wifi_info {
                  compatible = "huawei,hw_wifi_info";
                  status = "ok";
                  wifi,chiptype = "2.3";
                  wifi,pubfile_id = "KIW-tracfone_cl";
                  wifi,fw_ver = "QCOM_WCN3620_2.0.1";
                  wifi,fem_check_flag = "enable";
                  wifi,fem_check_low_pd_threshold = "550";
                  wifi,fem_check_high_pd_threshold = "1000";
        };
};
