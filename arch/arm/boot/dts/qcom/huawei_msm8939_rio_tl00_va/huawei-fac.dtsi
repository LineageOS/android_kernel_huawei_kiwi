 / {
        huawei_fac_info {
                  compatible = "huawei,hw_fac_info";
                  fac,product_name = "HUAWEI RIO-TL00";
                  fac,hardware_ver = "HL1RIOAL00M";
                  fac,software_ver = "MSM8939_RIO_TL00_VA";
                  status = "ok";
        };
};
