/* Copyright (c) 2014, The Linux Foundation. All rights reserved.
 *
 * This program is free software; you can redistribute it and/or modify
 * it under the terms of the GNU General Public License version 2 and
 * only version 2 as published by the Free Software Foundation.
 *
 * This program is distributed in the hope that it will be useful,
 * but WITHOUT ANY WARRANTY; without even the implied warranty of
 * MERCHANTABILITY or FITNESS FOR A PARTICULAR PURPOSE.  See the
 * GNU General Public License for more details.
 */
/dts-v1/;
#include "msm8916-qrd-skuh.dtsi"
#include "msm8916-memory.dtsi"
#include "huawei_msm8916_g760_l03_va/huawei.dtsi"
/ {
	model = "Qualcomm MSM 8916 HUAWEI G760-L03";
	compatible = "qcom,msm8916-qrd-skuh", "qcom,msm8916-qrd", "qcom,msm8916", "qcom,qrd";
	qcom,board-id = <8135 0x0> , <8135 0x4>;
	huawei,modem_id = <0xFEB0018F 0x0>;
};
