#include "../kiwi/huawei.dtsi"
#include "../kiwi/huawei-camera-vb.dtsi"
#include "../kiwi/huawei-sensors-vb.dtsi"

/ {
    huawei_audio_info {
        product-identifier = "kiw";
    };

    qcom,hw-camera-board-id {
		compatible = "qcom,hw-camera-board-id";
		qcom,product-name = "msm8939_kiw_cl00";
	};

        huawei_fac_info {
                  compatible = "huawei,hw_fac_info";
                  fac,product_name = "HUAWEI KIW-CL00";
                  fac,hardware_ver = "HL1KIWMAF";
                  fac,software_ver = "MSM8939_KIW_CL00_VB";
                  status = "ok";
        };
};
