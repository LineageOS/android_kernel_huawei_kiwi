&spmi_bus{
	qcom,pm8916@1 {
		pm8916_vib: qcom,vibrator@c000 {
		compatible = "qcom,qpnp-vibrator";
		qcom,vib-timeout-ms = <15000>;
		qcom,vib-vtg-level-mV = <2700>;
		reg = <0xc000 0x100>;
		label = "vibrator";
		status = "ok";
		};
	};
};
