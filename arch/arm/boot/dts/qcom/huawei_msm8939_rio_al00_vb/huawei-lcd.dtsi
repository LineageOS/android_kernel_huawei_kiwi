/*---------------------------------------------------------------------------
 * This file is autogenerated file using huawei LCD parser. Please do not edit it.
 * Update input XML file to add a new entry or update variable in this file
 * Parser location: device/qcom/common/display/tools/huawei_lcd_panel 
 *---------------------------------------------------------------------------*/


#include "hw-panel-boe-otm1901-5p5-1080p-video.dtsi"
#include "hw-panel-cmi-nt35532-5p5-1080p-video.dtsi"
#include "hw-panel-tianma-nt35596-5p5-1080p-video.dtsi"
