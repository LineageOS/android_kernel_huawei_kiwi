/* Copyright (c) 2013, The Linux Foundation. All rights reserved.
 *
 * This program is free software; you can redistribute it and/or modify
 * it under the terms of the GNU General Public License version 2 and
 * only version 2 as published by the Free Software Foundation.
 *
 * This program is distributed in the hope that it will be useful,
 * but WITHOUT ANY WARRANTY; without even the implied warranty of
 * MERCHANTABILITY or FITNESS FOR A PARTICULAR PURPOSE.  See the
 * GNU General Public License for more details.
 */

/*---------------------------------------------------------------------------
 * This file is autogenerated file using gcdb parser. Please do not edit it.
 * Update input XML file to add a new entry or update variable in this file
 * VERSION = "1.0"
 *---------------------------------------------------------------------------*/
&mdss_mdp {
	dsi_truly_hx8399a_5p5_1080pxa_video: qcom,mdss_dsi_truly_hx8399a_5p5_1080pxa_video {
		qcom,mdss-dsi-panel-name = "TRULY_HX8399A_5P5_1080PXA_VIDEO";
		qcom,cont-splash-enabled;
		qcom,mdss-dsi-panel-controller = <&mdss_dsi0>;
		qcom,mdss-dsi-panel-type = "dsi_video_mode";
		qcom,mdss-dsi-panel-destination = "display_1";
		qcom,mdss-dsi-panel-clockrate = <897860000>;
		qcom,mdss-dsi-panel-framerate = <60>;
		qcom,mdss-dsi-virtual-channel-id = <0>;
		qcom,mdss-dsi-stream = <0>;
		qcom,mdss-dsi-panel-width = <1080>;
		qcom,mdss-dsi-panel-height = <1920>;
		qcom,mdss-dsi-h-front-porch = <125>;
		qcom,mdss-dsi-h-back-porch = <54>;
		qcom,mdss-dsi-h-pulse-width = <20>;
		qcom,mdss-dsi-h-sync-skew = <0>;
		qcom,mdss-dsi-v-back-porch = <14>;
		qcom,mdss-dsi-v-front-porch = <14>;
		qcom,mdss-dsi-v-pulse-width = <2>;
		qcom,mdss-dsi-h-left-border = <0>;
		qcom,mdss-dsi-h-right-border = <0>;
		qcom,mdss-dsi-v-top-border = <0>;
		qcom,mdss-dsi-v-bottom-border = <0>;
		qcom,mdss-dsi-bpp = <24>;
		qcom,mdss-dsi-underflow-color = <0x00>;
		qcom,mdss-dsi-border-color = <0>;
		qcom,mdss-dsi-color-order = "rgb_swap_rgb";
		qcom,mdss-dsi-on-command = [39 01 00 00 00 00 04 B9 FF 83 99
		39 01 00 00 00 00 12 BA 43 42 A0 6D B2 09 09 40 10 FF 0F 00 00 3A 00 00 3D
		39 01 00 00 00 00 0d B1 00 74 2a 2a 11 09 22 22 71 F1 5e 66
		39 01 00 00 00 00 0b B2 00 80 00 7F 05 07 23 4D 02 02
		39 01 00 00 00 00 29 B4 00 FF 08 0C 42 42 00 00 00 00 00 00 00 11 01 02 04 21 00 03 44 08 0C 42 42 00 00 00 00 00 00 00 0F 01 02 03 21 00 03 44
		39 01 00 00 00 00 23 D3 00 04 00 00 00 30 00 00 00 06 00 05 00 17 88 07 88 00 00 00 00 00 15 01 01 01 00 00 00 05 08 00 10 4A
		39 01 00 00 00 00 21 D5 20 20 1E 1E 1F 1F 01 01 00 00 25 25 18 18 18 18 24 24 18 18 18 18 18 18 18 18 30 30 31 31 32 32
		39 01 00 00 00 00 21 D6 24 24 1E 1E 1F 1F 00 00 01 01 25 25 18 18 18 18 20 20 18 18 18 18 18 18 18 18 30 30 31 31 32 32
		39 01 00 00 00 00 31 D8 AA 8A AA AA AA 8A AA AA AA 8A AA AA AA 8A AA AA 38 0A 2A 80 38 0A 2A 80 BA CA AA AA BA CA AA AA 00 00 00 00 00 00 00 00 FF CF EA BF FF CF EA BF	
		39 01 00 00 00 00 02 CC 00
		39 01 00 00 00 00 02 C0 00
		39 01 00 00 00 00 02 C6 FF
		39 01 00 00 00 00 07 BF CF 00 42 08 00 04
		39 01 00 00 00 00 02 36 02
		39 01 00 00 00 00 2b E0 02 10 15 33 37 3F 21 3D 06 0C 0D 12 14 12 13 13 1B 0A 17 07 16 02 10 15 33 37 3F 21 3D 06 0C 0D 12 14 12 13 13 1B 0A 17 07 16
		39 01 00 00 00 00 02 BD 00
		39 01 00 00 00 00 2C C1 01 00 0E 16 1D 24 2B 33 3C 43 4A 54 5C 65 6D 74 7C 84 8C 95 9D A4 AB B3 BB C3 CC D4 DB E3 EA F1 F8 FF 17 B0 F3 0E A0 10 A2 7F C0
		39 01 00 00 00 00 02 BD 01
		39 01 00 00 00 00 2B C1 00 0E 16 1D 24 2B 33 3C 43 4A 54 5C 65 6D 74 7C 84 8C 95 9D A4 AB B3 BB C3 CC D4 DB E3 EA F1 F8 FF 17 B0 F3 0E A0 10 A2 7F C0
		39 01 00 00 00 00 02 BD 02
		39 01 00 00 00 00 2B C1 00 0E 16 1D 24 2B 33 3C 43 4A 54 5C 65 6D 74 7C 84 8C 95 9D A4 AB B3 BB C3 CC D4 DB E3 EA F1 F8 FF 17 B0 F3 0E A0 10 A2 7F C0
		39 01 00 00 00 00 02 BD 00
		39 01 00 00 00 00 08 C9 1F 00 1B 1E 01 1E 00
		15 01 00 00 00 00 02 51 00
		15 01 00 00 00 00 02 53 24
		15 01 00 00 05 00 02 55 01
		39 01 00 00 00 00 0F CE 00 08 10 18 20 28 30 38 3F 40 49 4C 52 56
		15 01 00 00 00 00 02 5E 28
		05 01 00 00 78 00 02 11 00
		05 01 00 00 14 00 02 29 00];
		qcom,mdss-dsi-off-command = [05 01 00 00 40 00 02 28 00
		05 01 00 00 28 00 02 10 00];
		qcom,mdss-dsi-on-command-state = "dsi_lp_mode";
		qcom,mdss-dsi-off-command-state = "dsi_hs_mode";
		qcom,mdss-dsi-h-sync-pulse = <1>;
		qcom,mdss-dsi-traffic-mode = "burst_mode";
		qcom,mdss-dsi-lane-map = "lane_map_0123";
		qcom,mdss-dsi-bllp-eof-power-mode;
		qcom,mdss-dsi-bllp-power-mode;
		qcom,mdss-dsi-lane-0-state;
		qcom,mdss-dsi-lane-1-state;
		qcom,mdss-dsi-lane-2-state;
		qcom,mdss-dsi-lane-3-state;
		qcom,mdss-dsi-panel-timings = [e6 38 26 00 68 6e 2a 3c 2c 03 04 00];
		qcom,mdss-dsi-t-clk-post = <0x2c>;
		qcom,mdss-dsi-t-clk-pre = <0x2b>;
		qcom,mdss-dsi-bl-min-level = <2>;
		qcom,mdss-dsi-bl-max-level = <255>;
		qcom,mdss-dsi-dma-trigger = "trigger_sw";
		qcom,mdss-dsi-mdp-trigger = "none";
		qcom,mdss-dsi-bl-pmic-control-type = "bl_ctrl_dcs";
		qcom,panel-cabc-ui-cmds = [15 01 00 00 00 00 02 55 01
					15 01 00 00 00 00 02 53 24];
		qcom,panel-cabc-video-cmds = [15 01 00 00 05 00 02 55 03
					15 01 00 00 00 00 02 53 2C
					39 01 00 00 00 00 0A CA 40 3C 38 34 33 20 20 20 20];
		qcom,cabc-ui-cmds-dsi-state = "dsi_hs_mode";
		qcom,cabc-video-cmds-dsi-state = "dsi_lp_mode";
		qcom,panel-dot-inversion-mode-cmds = [39 01 00 00 00 00 0b B2 81 80 00 7F 05 07 23 4D 02 02];
		qcom,panel-column-inversion-mode-cmds = [39 01 00 00 00 00 0b B2 80 80 00 7F 05 07 23 4D 02 02];
		qcom,dot-inversion-cmds-dsi-state = "dsi_lp_mode";
		qcom,column-inversion-cmds-dsi-state = "dsi_lp_mode";
		huawei,panel-power-off-reset-flag = <1>;
		qcom,mdss-dsi-lp11-init;
		qcom,mdss-pan-physical-width-dimension = <68>;
		qcom,mdss-pan-physical-height-dimension = <121>;
		huawei,long-read-flag = <1>;
		huawei,reg-read-expect-value = <0x9C>;
		huawei,reg-long-read-count = <3>;
			qcom,mdss-dsi-reset-sequence = <1 5>, <0 5>, <1 15>;

	};
};
