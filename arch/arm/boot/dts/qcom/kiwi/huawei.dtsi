#include "msm8939-common.dtsi"
#include "msm8939-mdss.dtsi"
#include "msm8939-pm.dtsi"
#include "msm-pm8916.dtsi"
#include "msm8939-regulator.dtsi"
#include "msm8939-qrd-skuk.dtsi"

#include "huawei-lcd.dtsi"
#include "huawei-tp.dtsi"
#include "huawei-camera.dtsi"
#include "huawei-sensors.dtsi"
#include "huawei-vibrator.dtsi"
#include "huawei-audio.dtsi"
#include "huawei-battery.dtsi"
#include "huawei-sdcard.dtsi"
#include "huawei-usb.dtsi"
#include "huawei-fingerprint.dtsi"

#include "huawei-ramoops.dtsi"
