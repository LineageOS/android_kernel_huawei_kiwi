/* Copyright (c) 2014, The Linux Foundation. All rights reserved.
 *
 * This program is free software; you can redistribute it and/or modify
 * it under the terms of the GNU General Public License version 2 and
 * only version 2 as published by the Free Software Foundation.
 *
 * This program is distributed in the hope that it will be useful,
 * but WITHOUT ANY WARRANTY; without even the implied warranty of
 * MERCHANTABILITY or FITNESS FOR A PARTICULAR PURPOSE.  See the
 * GNU General Public License for more details.
 */

&soc {
	mdss_dsi0: qcom,mdss_dsi@1a98000 {
		/* Optimize the mipi signal sigquality for DCDC Mode. */
		qcom,platform-regulator-settings-dcdc = [01 08 07 00 20 07 01];
		qcom,dsi-clk-ln-recovery;
	};

	mdss_dsi1: qcom,mdss_dsi@1aa0000 {
		/* Optimize the mipi signal sigquality for DCDC Mode. */
		qcom,platform-regulator-settings-dcdc = [01 08 07 00 20 07 01];
		qcom,dsi-clk-ln-recovery;
	};
};
