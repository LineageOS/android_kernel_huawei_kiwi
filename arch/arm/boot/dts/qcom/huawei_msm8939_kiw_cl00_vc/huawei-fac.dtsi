 / {
        huawei_fac_info {
                  compatible = "huawei,hw_fac_info";
                  fac,product_name = "HUAWEI KIW-CL00";
                  fac,hardware_ver = "HL1KIWMAL";
                  fac,software_ver = "MSM8939_KIW_CL00_VC";
                  status = "ok";
        };
};
