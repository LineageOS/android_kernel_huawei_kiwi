/* Copyright (c) 2013, The Linux Foundation. All rights reserved.
 *
 * This program is free software; you can redistribute it and/or modify
 * it under the terms of the GNU General Public License version 2 and
 * only version 2 as published by the Free Software Foundation.
 *
 * This program is distributed in the hope that it will be useful,
 * but WITHOUT ANY WARRANTY; without even the implied warranty of
 * MERCHANTABILITY or FITNESS FOR A PARTICULAR PURPOSE.  See the
 * GNU General Public License for more details.
 */

/*---------------------------------------------------------------------------
 * This file is autogenerated file using gcdb parser. Please do not edit it.
 * Update input XML file to add a new entry or update variable in this file
 * VERSION = "1.0"
 *---------------------------------------------------------------------------*/
&mdss_mdp {
	dsi_auo_otm1901a_5p5_1080pxa_video: qcom,mdss_dsi_auo_otm1901a_5p5_1080pxa_video {
		qcom,mdss-dsi-panel-name = "AUO_OTM1901A_5P5_1080PXA_VIDEO";
		qcom,cont-splash-enabled;
		qcom,mdss-dsi-panel-controller = <&mdss_dsi0>;
		qcom,mdss-dsi-panel-type = "dsi_video_mode";
		qcom,mdss-dsi-panel-destination = "display_1";
		qcom,mdss-dsi-panel-clockrate = <897610000>;
		qcom,mdss-dsi-panel-framerate = <60>;
		qcom,mdss-dsi-virtual-channel-id = <0>;
		qcom,mdss-dsi-stream = <0>;
		qcom,mdss-dsi-panel-width = <1080>;
		qcom,mdss-dsi-panel-height = <1920>;
		qcom,mdss-dsi-h-front-porch = <104>;
		qcom,mdss-dsi-h-back-porch = <54>;
		qcom,mdss-dsi-h-pulse-width = <20>;
		qcom,mdss-dsi-h-sync-skew = <0>;
		qcom,mdss-dsi-v-back-porch = <46>;
		qcom,mdss-dsi-v-front-porch = <14>;
		qcom,mdss-dsi-v-pulse-width = <2>;
		qcom,mdss-dsi-h-left-border = <0>;
		qcom,mdss-dsi-h-right-border = <0>;
		qcom,mdss-dsi-v-top-border = <0>;
		qcom,mdss-dsi-v-bottom-border = <0>;
		qcom,mdss-dsi-bpp = <24>;
		qcom,mdss-dsi-underflow-color = <0x00>;
		qcom,mdss-dsi-border-color = <0>;
		qcom,mdss-dsi-color-order = "rgb_swap_rgb";
		qcom,mdss-dsi-on-command = [29 01 00 00 00 00 02 00 00
					29 01 00 00 00 00 05 FF 19 01 01 00
					29 01 00 00 00 00 02 00 80
					29 01 00 00 00 00 03 FF 19 01
					29 01 00 00 00 00 02 00 00
					29 01 00 00 00 00 02 1C 33
					29 01 00 00 00 00 02 00 A0
					29 01 00 00 00 00 02 C1 E8
					29 01 00 00 00 00 02 00 A7
					29 01 00 00 00 00 02 C1 00
					29 01 00 00 00 00 02 00 90
					29 01 00 00 00 00 07 C0 00 2F 00 00 00 01
					29 01 00 00 00 00 02 00 C0
					29 01 00 00 00 00 07 C0 00 2F 00 00 00 01
					29 01 00 00 00 00 02 00 9A
					29 01 00 00 00 00 02 C0 1E
					29 01 00 00 00 00 02 00 AC
					29 01 00 00 00 00 02 C0 06
					29 01 00 00 00 00 02 00 DC
					29 01 00 00 00 00 02 C0 06
					29 01 00 00 00 00 02 00 81
					29 01 00 00 00 00 02 A5 06
					29 01 00 00 00 00 02 00 82
					29 01 00 00 00 00 02 C4 F0
					29 01 00 00 00 00 02 00 92
					29 01 00 00 00 00 02 E9 00
					29 01 00 00 00 00 02 00 90
					29 01 00 00 00 00 02 F3 01
					29 01 00 00 00 00 02 00 93
					29 01 00 00 00 00 02 C5 1E
					29 01 00 00 00 00 02 00 95
					29 01 00 00 00 00 02 C5 32
					29 01 00 00 00 00 02 00 97
					29 01 00 00 00 00 02 C5 19
					29 01 00 00 00 00 02 00 99
					29 01 00 00 00 00 02 C5 2D
					29 01 00 00 00 00 02 00 9B
					29 01 00 00 00 00 03 C5 44 40
					29 01 00 00 00 00 02 00 00
					29 01 00 00 00 00 03 D8 1F 1F
					29 01 00 00 00 00 02 00 B3
					29 01 00 00 00 00 02 C0 CC
					29 01 00 00 00 00 02 00 BC
					29 01 00 00 00 00 02 C0 00
					29 01 00 00 00 00 02 00 84
					29 01 00 00 00 00 02 C4 22
					29 01 00 00 00 00 02 00 80
					29 01 00 00 00 00 02 C4 38
					29 01 00 00 00 00 02 00 94
					29 01 00 00 00 00 02 C1 84
					29 01 00 00 00 00 02 00 98
					29 01 00 00 00 00 02 C1 74
					29 01 00 00 00 00 02 00 CD
					29 01 00 00 00 00 02 F5 19
					29 01 00 00 00 00 02 00 DB
					29 01 00 00 00 00 02 F5 19
					29 01 00 00 00 00 02 00 F5
					29 01 00 00 00 00 02 C1 40
					29 01 00 00 00 00 02 00 B9
					29 01 00 00 00 00 02 C0 11
					29 01 00 00 00 00 02 00 8D
					29 01 00 00 00 00 02 F5 20
					29 01 00 00 00 00 02 00 80
					29 01 00 00 00 00 0F C0 00 86 00 0A 0A 00 86 0A 0A 00 86 00 0A 0A
					29 01 00 00 00 00 02 00 F0
					29 01 00 00 00 00 07 C3 00 00 00 00 00 80
					29 01 00 00 00 00 02 00 A0
					29 01 00 00 00 00 08 C0 00 00 03 00 00 1E 06
					29 01 00 00 00 00 02 00 D0
					29 01 00 00 00 00 08 C0 00 00 03 00 00 1E 06
					29 01 00 00 00 00 02 00 90
					29 01 00 00 00 00 05 C2 82 00 3D 40
					29 01 00 00 00 00 02 00 B0
					29 01 00 00 00 00 09 C2 01 00 45 43 01 01 45 43
					29 01 00 00 00 00 02 00 80
					29 01 00 00 00 00 0D C3 84 04 01 00 02 87 83 04 01 00 02 87
					29 01 00 00 00 00 02 00 80
					29 01 00 00 00 00 10 CC 09 0D 11 12 13 14 15 16 17 18 0E 28 28 28 28
					29 01 00 00 00 00 02 00 90
					29 01 00 00 00 00 10 CC 0D 09 12 11 13 14 15 16 17 18 0E 28 28 28 28
					29 01 00 00 00 00 02 00 A0
					29 01 00 00 00 00 10 CC 1D 1E 1F 19 1A 1B 1C 20 21 22 23 24 25 26 27
					29 01 00 00 00 00 02 00 B0
					29 01 00 00 00 00 09 CC 01 02 03 05 06 07 04 08
					29 01 00 00 00 00 02 00 C0
					29 01 00 00 00 00 0D CC 00 00 00 00 00 00 00 00 00 00 00 77
					29 01 00 00 00 00 02 00 D0
					29 01 00 00 00 00 0D CC FF 00 30 C0 0F 30 00 00 33 03 00 77
					29 01 00 00 00 00 02 00 DE
					29 01 00 00 00 00 02 CC 00
					29 01 00 00 00 00 02 00 80
					29 01 00 00 00 00 10 CB 00 00 00 00 00 00 00 00 00 00 30 00 00 00 00
					29 01 00 00 00 00 02 00 90
					29 01 00 00 00 00 10 CB 30 00 FF 00 00 00 00 00 00 00 00 00 00 00 00
					29 01 00 00 00 00 02 00 A0
					29 01 00 00 00 00 10 CB 15 15 05 F5 01 01 00 00 00 00 01 00 00 00 00
					29 01 00 00 00 00 02 00 B0
					29 01 00 00 00 00 10 CB 00 01 FD 00 00 00 00 00 00 00 00 00 00 00 00
					29 01 00 00 00 00 02 00 C0
					29 01 00 00 00 00 09 CB 00 00 00 00 00 00 77 77
					29 01 00 00 00 00 02 00 D0
					29 01 00 00 00 00 09 CB 00 00 00 00 00 00 77 77
					29 01 00 00 00 00 02 00 E0
					29 01 00 00 00 00 09 CB 00 00 00 01 01 01 77 77
					29 01 00 00 00 00 02 00 F0
					29 01 00 00 00 00 09 CB 11 11 11 11 11 11 77 77
					29 01 00 00 00 00 02 00 80
					29 01 00 00 00 00 10 CD 3F 3F 3F 3F 3F 3F 3F 3F 01 12 11 03 04 0B 17
					29 01 00 00 00 00 02 00 90
					29 01 00 00 00 00 0C CD 3D 02 3D 25 25 25 1F 20 21 25 25
					29 01 00 00 00 00 02 00 A0
					29 01 00 00 00 00 10 CD 3F 3F 3F 3F 3F 3F 3F 3F 01 12 11 03 04 0B 17
					29 01 00 00 00 00 02 00 B0
					29 01 00 00 00 00 0C CD 17 02 3D 25 25 25 1F 20 21 25 25
					29 01 00 00 00 00 02 00 D4
					29 01 00 00 00 00 05 C3 01 01 01 01
					29 01 00 00 00 00 02 00 F2
					29 01 00 00 00 00 04 C1 80 0f 0f
					29 01 00 00 00 00 02 00 F7
					29 01 00 00 00 00 05 C3 03 1B 00 00
					29 01 00 00 00 00 02 00 B0
					29 01 00 00 00 00 02 CA 04
					29 01 00 00 00 00 02 00 B1
					29 01 00 00 00 00 02 CA 04
					29 01 00 00 00 00 02 00 B3
					29 01 00 00 00 00 02 CA 48
					29 01 00 00 00 00 02 00 90
					29 01 00 00 00 00 02 B0 00
					29 01 00 00 00 00 02 00 00
					29 01 00 00 00 00 19 E1 1f 2e 33 3c 42 49 54 64 6c 7d 88 90 6b 67 63 54 43 33 27 21 18 00 00 00
					29 01 00 00 00 00 02 00 00
					29 01 00 00 00 00 19 E2 1f 2e 33 3c 42 49 54 64 6c 7d 88 90 6b 67 63 54 43 33 27 21 18 00 00 00
					29 01 00 00 00 00 02 00 00
					29 01 00 00 00 00 19 E3 37 3e 41 47 4d 52 5b 68 70 81 8a 91 6a 66 62 54 43 33 29 23 1b 13 0c 00
					29 01 00 00 00 00 02 00 00
					29 01 00 00 00 00 19 E4 37 3e 41 47 4d 52 5b 68 70 81 8a 91 6a 66 62 54 43 33 29 23 1b 13 0c 00
					29 01 00 00 00 00 02 00 00
					29 01 00 00 00 00 19 E5 1f 2a 2f 38 40 46 51 62 6b 7e 88 90 6b 67 64 56 45 35 2b 25 1e 0f 00 00
					29 01 00 00 00 00 02 00 00
					29 01 00 00 00 00 19 E6 1f 2a 2f 38 40 46 51 62 6b 7e 88 90 6b 67 64 56 45 35 2b 25 1e 0f 00 00
					29 01 00 00 00 00 02 00 90
					29 01 00 00 00 00 0A CA cc ff a8 ff 80 ff 00 00 00
					29 01 00 00 00 00 02 00 00
					29 01 00 00 00 00 02 C6 10
					29 01 00 00 00 00 02 00 00
					29 01 00 00 00 00 13 C7 b0 ab bc bb b9 cb 88 88 88 78 77 66 66 66 66 66 66 66
					29 01 00 00 00 00 02 00 00
					29 01 00 00 00 00 02 C6 11
					29 01 00 00 00 00 02 00 00
					29 01 00 00 00 00 13 C7 b0 aa ac bb a9 cb 88 88 88 78 77 77 67 66 66 66 66 66
					29 01 00 00 00 00 02 00 00
					29 01 00 00 00 00 02 C6 12
					29 01 00 00 00 00 02 00 00
					29 01 00 00 00 00 13 C7 b0 b9 9b ac a9 bb 88 88 88 78 77 77 77 77 66 66 66 66
					29 01 00 00 00 00 02 00 00
					29 01 00 00 00 00 02 C6 13
					29 01 00 00 00 00 02 00 00
					29 01 00 00 00 00 13 C7 a0 aa aa bb 98 bb 88 88 88 78 77 77 77 77 77 67 66 66
					29 01 00 00 00 00 02 00 00
					29 01 00 00 00 00 02 C6 14
					29 01 00 00 00 00 02 00 00
					29 01 00 00 00 00 13 C7 a0 9a aa ba a8 ba 88 88 88 78 77 77 77 77 77 77 67 66
					29 01 00 00 00 00 02 00 00
					29 01 00 00 00 00 02 C6 15
					29 01 00 00 00 00 02 00 00
					29 01 00 00 00 00 13 C7 a0 99 aa aa 99 aa 88 88 88 78 77 77 77 77 77 77 77 77
					29 01 00 00 00 00 02 00 00
					29 01 00 00 00 00 02 C6 16
					29 01 00 00 00 00 02 00 00
					29 01 00 00 00 00 13 C7 90 9a 9a aa 98 aa 88 88 88 88 78 77 77 77 77 77 77 77
					29 01 00 00 00 00 02 00 00
					29 01 00 00 00 00 02 C6 17
					29 01 00 00 00 00 02 00 00
					29 01 00 00 00 00 13 C7 90 99 9a a9 99 a9 88 88 88 88 88 78 77 77 77 77 77 77
					29 01 00 00 00 00 02 00 00
					29 01 00 00 00 00 02 C6 18
					29 01 00 00 00 00 02 00 00
					29 01 00 00 00 00 13 C7 90 99 99 a9 98 a9 88 88 88 88 88 88 78 77 77 77 77 77
					29 01 00 00 00 00 02 00 00
					29 01 00 00 00 00 02 C6 19
					29 01 00 00 00 00 02 00 00
					29 01 00 00 00 00 13 C7 90 98 a9 a8 88 a9 88 88 88 88 88 88 88 78 77 77 77 77
					29 01 00 00 00 00 02 00 00
					29 01 00 00 00 00 02 C6 1a
					29 01 00 00 00 00 02 00 00
					29 01 00 00 00 00 13 C7 90 98 99 a8 88 99 88 88 88 88 88 88 88 88 78 77 77 77
					29 01 00 00 00 00 02 00 00
					29 01 00 00 00 00 02 C6 1b
					29 01 00 00 00 00 02 00 00
					29 01 00 00 00 00 13 C7 90 88 99 98 89 a8 88 88 88 88 88 88 88 88 88 77 77 77
					29 01 00 00 00 00 02 00 00
					29 01 00 00 00 00 02 C6 1c
					29 01 00 00 00 00 02 00 00
					29 01 00 00 00 00 13 C7 80 98 a8 97 89 98 88 88 88 88 88 88 88 88 88 88 77 77
					29 01 00 00 00 00 02 00 00
					29 01 00 00 00 00 02 C6 1d
					29 01 00 00 00 00 02 00 00
					29 01 00 00 00 00 13 C7 80 88 89 98 88 89 88 88 88 88 88 88 88 88 88 88 88 77
					29 01 00 00 00 00 02 00 00
					29 01 00 00 00 00 02 C6 1e
					29 01 00 00 00 00 02 00 00
					29 01 00 00 00 00 13 C7 80 88 98 88 89 88 88 88 88 88 88 88 88 88 88 88 88 78
					29 01 00 00 00 00 02 00 00
					29 01 00 00 00 00 02 C6 1f
					29 01 00 00 00 00 02 00 00
					29 01 00 00 00 00 13 C7 80 88 88 88 88 98 88 88 88 88 88 88 88 88 88 88 88 88
					29 01 00 00 00 00 02 00 00
					29 01 00 00 00 00 02 C6 00
					29 01 00 00 00 00 02 00 00
					29 01 00 00 00 00 04 FF FF FF FF
					15 01 00 00 00 00 02 51 00
					15 01 00 00 00 00 02 53 24
					15 01 00 00 00 00 02 55 01
					15 01 00 00 00 00 02 5E 28
					05 01 00 00 78 00 02 11 00
					05 01 00 00 14 00 02 29 00];
		qcom,mdss-dsi-off-command = [05 01 00 00 28 00 02 28 00
					05 01 00 00 78 00 02 10 00];
		qcom,mdss-dsi-on-command-state = "dsi_lp_mode";
		qcom,mdss-dsi-off-command-state = "dsi_hs_mode";
		qcom,mdss-dsi-h-sync-pulse = <1>;
		qcom,mdss-dsi-traffic-mode = "burst_mode";
		qcom,mdss-dsi-lane-map = "lane_map_0123";
		qcom,mdss-dsi-bllp-eof-power-mode;
		qcom,mdss-dsi-bllp-power-mode;
		qcom,mdss-dsi-lane-0-state;
		qcom,mdss-dsi-lane-1-state;
		qcom,mdss-dsi-lane-2-state;
		qcom,mdss-dsi-lane-3-state;
		qcom,mdss-dsi-panel-timings = [e6 38 26 00 68 6e 2a 3c 2c 03 04 00];
		qcom,mdss-dsi-t-clk-post = <0x2c>;
		qcom,mdss-dsi-t-clk-pre = <0x2b>;
		qcom,mdss-dsi-bl-min-level = <2>;
		qcom,mdss-dsi-bl-max-level = <255>;
		qcom,mdss-dsi-dma-trigger = "trigger_sw";
		qcom,mdss-dsi-mdp-trigger = "none";
		qcom,mdss-dsi-bl-pmic-control-type = "bl_ctrl_dcs";
		qcom,panel-cabc-ui-cmds = [15 01 00 00 00 00 02 55 01
					15 01 00 00 00 00 02 53 24];
		qcom,panel-cabc-video-cmds = [15 01 00 00 00 00 02 55 03
					15 01 00 00 00 00 02 53 2C];
		qcom,cabc-ui-cmds-dsi-state = "dsi_hs_mode";
		qcom,cabc-video-cmds-dsi-state = "dsi_lp_mode";
		qcom,panel-dot-inversion-mode-cmds = [29 01 00 00 00 00 02 00 00
					29 01 00 00 00 00 05 FF 19 01 01 00
					29 01 00 00 00 00 02 00 80
					29 01 00 00 00 00 03 FF 19 01
					29 01 00 00 00 00 02 00 B3
					29 01 00 00 00 00 02 C0 DD
					29 01 00 00 00 00 02 00 BC
					29 01 00 00 00 00 02 C0 11
					29 01 00 00 00 00 02 00 00
					29 01 00 00 00 00 02 FB 01
					29 01 00 00 00 00 02 00 00
					29 01 00 00 00 00 04 FF FF FF FF];
		qcom,panel-column-inversion-mode-cmds = [29 01 00 00 00 00 02 00 00
					29 01 00 00 00 00 05 FF 19 01 01 00
					29 01 00 00 00 00 02 00 80
					29 01 00 00 00 00 03 FF 19 01
					29 01 00 00 00 00 02 00 B3
					29 01 00 00 00 00 02 C0 CC
					29 01 00 00 00 00 02 00 BC
					29 01 00 00 00 00 02 C0 00
					29 01 00 00 00 00 02 00 00
					29 01 00 00 00 00 02 FB 01
					29 01 00 00 00 00 02 00 00
					29 01 00 00 00 00 04 FF FF FF FF];
		qcom,dot-inversion-cmds-dsi-state = "dsi_lp_mode";
		qcom,column-inversion-cmds-dsi-state = "dsi_lp_mode";
		qcom,panel-esd-check-enabled;
		qcom,panel-esd-read-commands = [06 01 00 01 05 00 02 0A 9C
			06 01 00 01 05 00 02 0C 07
			06 01 00 01 05 00 02 0D 00];
		qcom,esd-read-cmds-state = "dsi_hs_mode";
		huawei,panel-esd-set-cabc-flag = <1>;
		qcom,mdss-dsi-lp11-init;
		qcom,mdss-pan-physical-width-dimension = <68>;
		qcom,mdss-pan-physical-height-dimension = <121>;
			qcom,mdss-dsi-reset-sequence = <1 5>, <0 5>, <1 15>;

	};
};
