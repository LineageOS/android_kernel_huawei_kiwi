/* Copyright (c) 2013, The Linux Foundation. All rights reserved.
 *
 * This program is free software; you can redistribute it and/or modify
 * it under the terms of the GNU General Public License version 2 and
 * only version 2 as published by the Free Software Foundation.
 *
 * This program is distributed in the hope that it will be useful,
 * but WITHOUT ANY WARRANTY; without even the implied warranty of
 * MERCHANTABILITY or FITNESS FOR A PARTICULAR PURPOSE.  See the
 * GNU General Public License for more details.
 */

/*---------------------------------------------------------------------------
 * This file is autogenerated file using gcdb parser. Please do not edit it.
 * Update input XML file to add a new entry or update variable in this file
 * VERSION = "1.0"
 *---------------------------------------------------------------------------*/
&mdss_mdp {
	dsi_boe_otm1906c_5p2_1080p_cmd: qcom,mdss_dsi_boe_otm1906c_5p2_1080p_cmd {
		qcom,mdss-dsi-panel-name = "BOE_OTM1906C_5P2_1080P_CMD";
		qcom,cont-splash-enabled;
		qcom,mdss-dsi-panel-controller = <&mdss_dsi0>;
		qcom,mdss-dsi-panel-type = "dsi_cmd_mode";
		qcom,mdss-dsi-panel-destination = "display_1";
		qcom,mdss-dsi-panel-clockrate = <896000000>;
		qcom,mdss-dsi-panel-framerate = <60>;
		qcom,mdss-dsi-virtual-channel-id = <0>;
		qcom,mdss-dsi-stream = <0>;
		qcom,mdss-dsi-panel-width = <1080>;
		qcom,mdss-dsi-panel-height = <1920>;
		qcom,mdss-dsi-h-front-porch = <80>;
		qcom,mdss-dsi-h-back-porch = <16>;
		qcom,mdss-dsi-h-pulse-width = <16>;
		qcom,mdss-dsi-h-sync-skew = <0>;
		qcom,mdss-dsi-v-back-porch = <32>;
		qcom,mdss-dsi-v-front-porch = <32>;
		qcom,mdss-dsi-v-pulse-width = <16>;
		qcom,mdss-dsi-h-left-border = <0>;
		qcom,mdss-dsi-h-right-border = <0>;
		qcom,mdss-dsi-v-top-border = <0>;
		qcom,mdss-dsi-v-bottom-border = <0>;
		qcom,mdss-dsi-bpp = <24>;
		qcom,mdss-dsi-underflow-color = <0xff>;
		qcom,mdss-dsi-border-color = <0>;
		qcom,mdss-dsi-color-order = "rgb_swap_rgb";
		qcom,mdss-dsi-on-command = [29 01 00 00 00 00 02 00 00
					29 01 00 00 00 00 04 FF 19 06 01
					29 01 00 00 00 00 02 00 80
					29 01 00 00 00 00 03 FF 19 06
					29 01 00 00 00 00 02 00 A0
					29 01 00 00 00 00 04 C1 00 C0 10
					29 01 00 00 00 00 02 00 91
					29 01 00 00 00 00 03 C5 14 28
					29 01 00 00 00 00 02 00 95
					29 01 00 00 00 00 02 C5 11
					29 01 00 00 00 00 02 00 80
					29 01 00 00 00 00 03 C1 55 55
					29 01 00 00 00 00 02 00 94
					29 01 00 00 00 00 02 C5 67
					29 01 00 00 00 00 02 00 A4
					29 01 00 00 00 00 02 C5 67
					29 01 00 00 00 00 02 00 C1
					29 01 00 00 00 00 02 C5 b5
					29 01 00 00 00 00 02 00 B3
					29 01 00 00 00 00 02 C0 88
					29 01 00 00 00 00 02 00 B4
					29 01 00 00 00 00 02 C0 00
					29 01 00 00 00 00 02 00 00
					29 01 00 00 00 00 03 D8 23 23
					29 01 00 00 00 00 02 00 80
					29 01 00 00 00 00 02 C4 81
					29 01 00 00 00 00 02 00 A0
					29 01 00 00 00 00 02 B3 33
					29 01 00 00 00 00 02 00 A6
					29 01 00 00 00 00 02 B3 20
					29 01 00 00 00 00 02 00 E0
					29 01 00 00 00 00 0B B4 1C 19 3F 01 64 5C 01 A0 5F A0
					29 01 00 00 00 00 02 00 F0
					29 01 00 00 00 00 02 B4 64
					29 01 00 00 00 00 02 00 80
					29 01 00 00 00 00 0F C0 00 71 00 0A 0A 00 71 0A 0A 00 71 00 0A 0A
					29 01 00 00 00 00 02 00 90
					29 01 00 00 00 00 07 C0 00 00 00 02 00 04
					29 01 00 00 00 00 02 00 A0
					29 01 00 00 00 00 10 C0 00 00 02 00 04 14 04 33 00 33 00 33 00 33 00	
					29 01 00 00 00 00 02 00 D0
					29 01 00 00 00 00 10 C0 00 00 02 00 04 14 04 33 00 33 00 33 00 33 00
					29 01 00 00 00 00 02 00 80
					29 01 00 00 00 00 0D C2 83 01 00 00 82 01 00 00 00 00 00 00
					29 01 00 00 00 00 02 00 90
					29 01 00 00 00 00 0D C2 00 00 00 00 00 00 00 00 00 00 00 00
					29 01 00 00 00 00 02 00 A0
					29 01 00 00 00 00 0E C2 00 00 00 00 00 00 00 00 00 00 00 00 00
					29 01 00 00 00 00 02 00 B0
					29 01 00 00 00 00 10 C2 82 02 00 00 88 81 02 00 00 88 00 02 00 00 88
					29 01 00 00 00 00 02 00 C0
					29 01 00 00 00 00 10 C2 01 02 00 00 88 00 00 00 00 00 00 00 00 00 00
					29 01 00 00 00 00 02 00 D0
					29 01 00 00 00 00 10 C2 00 00 00 00 00 00 00 00 00 00 33 33 33 33 00
					29 01 00 00 00 00 02 00 80
					29 01 00 00 00 00 10 C3 00 00 00 00 00 00 00 00 00 00 00 00 00 00 00
					29 01 00 00 00 00 02 00 A0
					29 01 00 00 00 00 0D C3 83 01 00 00 82 01 00 00 00 00 00 00
					29 01 00 00 00 00 02 00 B0
					29 01 00 00 00 00 0F C3 00 00 00 00 82 02 00 00 88 81 02 00 00 88
					29 01 00 00 00 00 02 00 C0
					29 01 00 00 00 00 10 C3 00 02 00 00 88 01 02 00 00 88 00 00 00 00 00
					29 01 00 00 00 00 02 00 D0
					29 01 00 00 00 00 10 C3 00 00 00 00 00 00 00 00 00 00 00 00 00 00 00
					29 01 00 00 00 00 02 00 E0
					29 01 00 00 00 00 06 C3 33 33 33 33 00
					29 01 00 00 00 00 02 00 80
					29 01 00 00 00 00 0C CB 00 00 00 00 30 00 03 00 00 00 70
					29 01 00 00 00 00 02 00 90
					29 01 00 00 00 00 10 CB 00 00 00 00 00 00 00 00 00 00 00 00 00 00 00
					29 01 00 00 00 00 02 00 A0
					29 01 00 00 00 00 10 CB 00 00 00 BF 00 00 00 00 00 FF 00 00 00 00 00
					29 01 00 00 00 00 02 00 B0
					29 01 00 00 00 00 0D CB 00 00 00 00 00 00 00 00 00 00 77 77
					29 01 00 00 00 00 02 00 C0
					29 01 00 00 00 00 10 CB 01 01 01 01 01 01 01 01 01 01 01 01 01 01 01
					29 01 00 00 00 00 02 00 D0
					29 01 00 00 00 00 10 CB 01 01 01 F3 01 01 01 01 00 F3 00 00 01 00 01
					29 01 00 00 00 00 02 00 E0
					29 01 00 00 00 00 0D CB 00 01 00 01 00 01 00 01 00 00 77 07
					29 01 00 00 00 00 02 00 F0
					29 01 00 00 00 00 0C CB 00 00 FF FF FF FF 03 22 02 00 70
					29 01 00 00 00 00 02 00 80
					29 01 00 00 00 00 0D CC 08 09 18 19 0C 0D 0E 0F 07 07 07 07
					29 01 00 00 00 00 02 00 90
					29 01 00 00 00 00 0D CC 09 08 19 18 0F 0E 0D 0C 07 07 07 07
					29 01 00 00 00 00 02 00 A0
					29 01 00 00 00 00 10 CC 14 15 16 17 1C 1D 1E 1F 01 04 20 07 07 07 00
					29 01 00 00 00 00 02 00 B0
					29 01 00 00 00 00 09 CC 01 02 03 04 05 06 07 07
					29 01 00 00 00 00 02 00 C0
					29 01 00 00 00 00 10 CC 00 00 00 00 00 00 00 00 00 00 00 00 00 00 00
					29 01 00 00 00 00 02 00 D0
					29 01 00 00 00 00 10 CC 00 00 00 00 00 00 00 00 00 00 00 00 00 00 00
					29 01 00 00 00 00 02 00 E0
					29 01 00 00 00 00 10 CC 00 00 00 00 00 00 00 00 00 00 00 00 00 00 00
					29 01 00 00 00 00 02 00 80
					29 01 00 00 00 00 10 CD 1A 01 11 12 1A 05 18 07 1A 1A 23 23 23 1F 1E
					29 01 00 00 00 00 02 00 90
					29 01 00 00 00 00 04 CD 1D 23 23
					29 01 00 00 00 00 02 00 A0
					29 01 00 00 00 00 10 CD 1A 02 11 12 1A 06 18 08 1A 1A 23 23 23 1F 1E
					29 01 00 00 00 00 02 00 B0
					29 01 00 00 00 00 04 CD 1D 23 23
					29 01 00 00 00 00 02 00 80
					29 01 00 00 00 00 0B A4 AF 00 20 04 00 17 15 03 60 00
					29 01 00 00 00 00 02 00 90
					29 01 00 00 00 00 04 A4 00 00 00
					29 01 00 00 00 00 02 00 81
					29 01 00 00 00 00 02 A5 05
					29 01 00 00 00 00 02 00 80
					29 01 00 00 00 00 0D A7 FF 0F 1E 00 1F 00 01 98 00 00 00 00
					29 01 00 00 00 00 02 00 90
					29 01 00 00 00 00 0B A7 1C 1F 3B 00 00 BE 80 BE 05 F0
					29 01 00 00 00 00 02 00 A0
					29 01 00 00 00 00 02 A7 30
					29 01 00 00 00 00 02 00 B0
					29 01 00 00 00 00 06 A7 39 20 10 00 00
					29 01 00 00 00 00 02 00 C0
					29 01 00 00 00 00 0D A7 FF 0F 1E 00 1F 00 01 18 00 00 00 00
					29 01 00 00 00 00 02 00 D0
					29 01 00 00 00 00 0B A7 FF FF 1D 00 01 7C 81 7C 0B E0
					29 01 00 00 00 00 02 00 E0
					29 01 00 00 00 00 02 A7 30
					29 01 00 00 00 00 02 00 F0
					29 01 00 00 00 00 06 A7 1C 3E 3D 00 00
					29 01 00 00 00 00 02 00 80
					29 01 00 00 00 00 0D A9 00 00 00 00 00 00 00 00 00 00 00 00
					29 01 00 00 00 00 02 00 90
					29 01 00 00 00 00 0B A9 00 00 00 00 00 00 00 00 00 00
					29 01 00 00 00 00 02 00 A0
					29 01 00 00 00 00 02 A9 00
					29 01 00 00 00 00 02 00 B0
					29 01 00 00 00 00 06 A9 00 00 00 00 00
					29 01 00 00 00 00 02 00 C0
					29 01 00 00 00 00 0F A9 FF 3A 49 00 1E 00 01 00 00 00 00 00 00 77
					29 01 00 00 00 00 02 00 D0
					29 01 00 00 00 00 0B A9 FF FF 1D 00 01 7C 81 7C 0B E0
					29 01 00 00 00 00 02 00 E0
					29 01 00 00 00 00 02 A9 30
					29 01 00 00 00 00 02 00 F0
					29 01 00 00 00 00 06 A9 00 3C 3C 00 00
					29 01 00 00 00 00 02 00 B0
					29 01 00 00 00 00 09 A4 05 F0 0B E0 00 00 0B E0
					29 01 00 00 00 00 02 00 80
					29 01 00 00 00 00 10 AB 05 14 00 00 FF 6A 00 00 00 00 00 00 00 00 00
					29 01 00 00 00 00 02 00 A0
					29 01 00 00 00 00 10 AB 00 00 00 00 00 00 00 07 00 00 00 00 01 00 00
					29 01 00 00 00 00 02 00 B0
					29 01 00 00 00 00 0D AB 00 00 68 0A 00 00 44 04 00 00 00 00
					29 01 00 00 00 00 02 00 93
					29 01 00 00 00 00 02 B3 01
					29 01 00 00 00 00 02 00 80
					29 01 00 00 00 00 08 CE 00 00 00 00 00 00 00
					29 01 00 00 00 00 02 00 87
					29 01 00 00 00 00 08 CE 00 00 33 00 33 00 00
					29 01 00 00 00 00 02 00 F0
					29 01 00 00 00 00 05 CE 00 00 00 00
					29 01 00 00 00 00 02 00 90
					29 01 00 00 00 00 10 CE 00 00 00 F0 00 00 00 00 FC 00 FC 00 00 00 00
					29 01 00 00 00 00 02 00 B0
					29 01 00 00 00 00 04 C5 00 00 01
					29 01 00 00 00 00 02 00 A0
					29 01 00 00 00 00 08 CE 00 00 40 40 40 00 00
					29 01 00 00 00 00 02 00 B0
					29 01 00 00 00 00 10 CE 01 01 01 01 01 01 01 01 F1 01 F1 01 01 01 01
					29 01 00 00 00 00 02 00 C0
					29 01 00 00 00 00 08 CE 01 01 01 01 01 01 01
					29 01 00 00 00 00 02 00 D0
					29 01 00 00 00 00 10 CE 04 04 04 04 04 04 04 04 F7 04 F7 04 04 00 00
					29 01 00 00 00 00 02 00 E0
					29 01 00 00 00 00 08 CE 00 00 15 15 15 04 04
					29 01 00 00 00 00 02 00 F4
					29 01 00 00 00 00 02 CE 25
					29 01 00 00 00 00 02 00 A0
					29 01 00 00 00 00 0D D6 02 fe 03 02 fc f5 fc 0c 02 f3 f1 05
					29 01 00 00 00 00 02 00 B0
					29 01 00 00 00 00 0D D6 00 00 cd e6 cd b3 66 fd fd fd da 00
					29 01 00 00 00 00 02 00 C0
					29 01 00 00 00 00 0D D6 00 00 89 9a 89 77 44 a9 a9 a9 91 00
					29 01 00 00 00 00 02 00 D0
					29 01 00 00 00 00 0D D6 00 09 44 4d 44 3c 22 54 54 54 49 00
					29 01 00 00 00 00 02 00 00
					29 01 00 00 00 00 02 81 80
					29 01 00 00 00 00 02 00 00
					29 01 00 00 00 00 B5 D4 00 40 00 40 00 40 00 40 00 40 00 40 00 40 00 40 00 40 00 40 00 40 00 40 00 40 00 40 00 40 00 40 00 40 00 40 00 40 00 40 00 40 00 40 00 40 00 40 00 40 00 40 00 40 00 40 00 40 00 40 00 40 00 40 00 40 00 40 00 40 00 40 ff 40 ff 40 ff 40 ff 40 ff 40 ff 40 ff 40 ff 40 ff 40 ff 40 ff 40 ff 40 ff 40 ff 40 ff 40 ff 40 ff 40 ff 40 ff 40 00 40 00 40 00 40 00 40 00 40 00 40 01 40 01 40 01 40 02 40 02 40 03 40 03 40 03 40 04 40 04 40 05 40 06 40 06 40 07 40 07 40 06 40 06 40 06 40 04 40 04 40 04 40 03 40 03 40 02 40 02 40 02 40 01 40 01 40 00 40
					29 01 00 00 00 00 B5 D4 00 40 00 40 00 40 00 40 00 40 00 40 00 40 00 40 00 40 00 40 00 40 00 40 00 40 00 40 00 40 00 40 00 40 00 40 00 40 ff 40 ff 40 ff 40 ff 40 ff 40 ff 40 ff 40 fe 40 fe 40 fe 40 fe 40 fe 40 fe 40 fe 40 ff 40 ff 40 ff 40 ff 40 00 40 00 40 00 40 00 40 01 40 01 40 01 40 01 40 01 40 01 40 01 40 01 40 01 40 00 40 00 40 00 40 00 40 00 40 00 40 ff 40 ff 40 ff 40 ff 40 ff 40 ff 40 ff 40 fe 40 fe 40 fe 40 fe 40 fe 40 fe 40 fe 40 fe 40 fd 40 fd 40 fd 40 fd 40 fd 40 fd 40 fd 40 fe 40 fe 40 fe 40 fe 40 fe 40 fe 40 ff 40 ff 40 ff 40 ff 40 ff 40 ff 40
					29 01 00 00 00 00 B5 D4 fb 46 fb 46 fb 46 fb 46 fb 46 fb 46 fb 46 fb 46 fc 46 fc 46 fc 47 fc 47 fc 47 fc 47 fc 47 fd 47 fd 47 fd 48 fd 48 fd 48 fd 49 fd 49 fd 49 fd 4a fd 4a fd 4a fd 4b fd 4b ff 4b ff 4c fe 4c ff 4c ff 4c ff 4c 00 4d 00 4d 00 4d 00 4d 00 4d 01 4d 01 4d 01 4e 01 4e 02 4e 03 4e 03 4e 03 4e 03 4e 03 4d 04 4d 04 4d 04 4d 04 4d 04 4c 05 4c 05 4c 05 4c 05 4c 05 4b 05 4b 06 4b 07 4b 07 4b 07 4b 08 4b 08 4b 08 4b 09 4b 09 4b 09 4b 09 4b 0a 4b 0a 4b 0a 4b 0a 4b 0b 4b 0a 4a 0a 4a 0a 4a 0a 4a 0a 49 09 49 09 49 09 49 09 48 09 48 08 48 08 48 07 47 07 47
					29 01 00 00 00 00 B5 D4 07 47 07 46 06 46 06 46 06 45 06 45 05 45 05 44 05 44 05 44 05 43 05 43 03 42 03 42 03 42 03 42 03 42 02 42 02 43 02 43 02 43 02 44 01 44 01 45 01 45 01 45 00 46 00 46 00 46 00 47 00 47 ff 47 ff 47 ff 47 ff 48 ff 48 ff 48 ff 48 ff 48 ff 48 ff 48 ff 48 ff 48 fd 49 fd 49 fe 49 fd 48 fe 47 fe 47 fe 46 fe 46 fe 45 fe 44 fe 44 fd 43 fd 43 fd 42 fd 42 fd 41 fd 40 fd 40 fd 40 fc 40 fb 41 fb 41 fb 41 fb 41 fa 42 fa 42 fa 42 fa 42 fa 43 f9 43 f9 43 f9 43 f9 44 f9 44 f9 44 f9 44 f9 44 f9 44 f9 44 fa 45 fa 45 fa 45 fa 45 fa 45 fa 45 fa 45 fa 45
					29 01 00 00 00 00 02 00 00
					29 01 00 00 00 00 B5 D5 00 45 00 45 00 45 ff 45 ff 45 ff 45 ff 44 ff 44 ff 44 ff 44 ff 44 ff 44 ff 43 ff 43 ff 43 ff 43 ff 43 ff 43 ff 43 ff 43 ff 43 ff 44 ff 44 ff 44 ff 44 ff 44 ff 44 ff 44 ff 44 ff 44 00 45 00 45 00 45 00 45 00 45 00 45 00 45 00 45 00 45 00 46 00 46 00 46 00 46 00 46 00 46 00 46 00 47 00 47 00 47 00 48 00 48 ff 48 ff 49 ff 49 ff 49 ff 4a ff 4a ff 4a ff 4b fd 4b fe 4b ff 4b ff 4b ff 4b 00 4b 00 4b 00 4b 01 4b 01 4b 01 4b 01 4b 03 4b 03 4b 03 4b 04 4b 04 4b 04 4b 04 4a 04 49 04 49 04 48 04 47 04 47 04 46 04 45 04 45 04 44 04 43 03 43 03 42
					29 01 00 00 00 00 B5 D5 03 41 02 41 02 41 02 41 02 41 02 41 02 41 02 41 02 41 02 41 02 41 01 41 01 41 01 41 01 41 01 41 01 43 00 44 00 45 ff 47 ff 48 fe 49 fd 4b fd 4c fc 4d fc 4f fb 50 fa 51 fa 53 f9 54 f9 55 f9 55 fa 55 fa 55 fa 55 fa 55 fb 55 fc 55 fc 55 fc 55 fc 55 fd 55 fd 55 fd 55 fd 55 fd 55 fd 53 fd 52 fd 50 fd 4f fd 4e fd 4c fd 4b fd 49 fd 48 fe 47 fe 45 fe 44 fe 42 fe 41 fe 40 fe 41 fe 42 fe 43 fe 44 fe 45 fe 47 fe 48 fd 49 fd 4a fd 4b fd 4c fd 4d fd 4e fd 4f fd 50 fd 4f fd 4e fd 4d ff 4d ff 4c ff 4b ff 4b ff 4a ff 49 ff 49 ff 48 ff 47 ff 47 00 46
					29 01 00 00 00 00 B5 D5 f2 4a f1 4c f2 4d f2 4e f2 4f f2 51 f2 52 f1 53 f1 54 f1 55 f1 56 f1 58 f0 59 f0 5a f0 5b f0 5c f0 5d f1 5e f3 5e f3 5f f4 60 f5 60 f6 61 f7 62 f8 63 f9 63 fa 64 fb 64 fc 65 fd 66 fe 66 ff 65 00 64 02 64 03 63 03 62 04 61 05 60 07 5f 07 5f 08 5e 09 5d 0a 5c 0b 5b 0c 5a 0c 59 0c 58 0c 58 0e 56 0e 56 0d 55 0d 54 0f 53 0e 52 0e 51 0e 50 0f 4f 0f 4e 0f 4d 0f 4d 10 4c 10 4b 10 4a 10 4a 10 49 11 48 10 47 10 47 10 46 11 45 11 45 11 44 11 43 12 43 12 42 12 41 11 41 11 41 10 41 10 40 10 40 0f 40 0f 40 0f 3f 0f 3f 0f 3f 0d 3f 0d 3e 0d 3e 0d 3e
					29 01 00 00 00 00 B5 D5 0c 3e 0c 3d 0c 3c 0b 3b 0b 3a 0b 39 0b 38 0b 37 0b 36 0a 35 0a 34 0a 34 0a 33 0a 32 09 31 09 30 09 30 09 31 08 31 07 31 07 31 06 31 06 31 05 32 05 32 04 32 04 32 03 32 03 32 02 32 02 32 01 32 01 31 00 30 00 2f 00 2e ff 2d ff 2d fe 2c fe 2b fe 2a fe 29 fd 28 fd 28 fd 27 fd 26 fd 27 fc 28 fc 29 fc 29 fc 2a fb 2b fb 2c fb 2c fa 2d fa 2e f9 2f f9 2f f9 30 f8 31 f8 32 f8 33 f7 34 f7 35 f7 36 f6 37 f5 38 f5 39 f5 3a f4 3b f3 3c f3 3d f3 3e f2 3f f1 40 f1 41 f1 42 f1 42 f2 43 f2 44 f1 44 f1 45 f1 45 f1 46 f2 47 f2 47 f2 48 f2 49 f2 49 f2 4a
					29 01 00 00 00 00 02 00 90
					29 01 00 00 00 00 0A CA f0 ff cc ff a6 ff 53 53 53
					29 01 00 00 00 00 02 00 00
					29 01 00 00 00 00 02 C6 10
					29 01 00 00 00 00 13 C7 b0 ba ca bb 7c bc 8c bc c9 ba c9 88 78 45 23 22 22 22
					29 01 00 00 00 00 02 00 00
					29 01 00 00 00 00 02 C6 11
					29 01 00 00 00 00 13 C7 b0 b9 ca ba 8b bb 8c ab ba aa ba 88 78 56 34 33 22 22
					29 01 00 00 00 00 02 00 00
					29 01 00 00 00 00 02 C6 12
					29 01 00 00 00 00 13 C7 a0 ba c9 aa 8b ba 8c ba aa b9 a9 88 88 57 34 33 33 33
					29 01 00 00 00 00 02 00 00
					29 01 00 00 00 00 02 C6 13
					29 01 00 00 00 00 13 C7 a0 a9 ba aa 8b b9 8c b9 aa b8 a9 88 88 67 45 44 33 33
					29 01 00 00 00 00 02 00 00
					29 01 00 00 00 00 02 C6 14
					29 01 00 00 00 00 13 C7 90 9a ba 9a 8b b9 8b a9 aa 99 aa 88 88 67 45 44 44 44
					29 01 00 00 00 00 02 00 00
					29 01 00 00 00 00 02 C6 15
					29 01 00 00 00 00 13 C7 90 a9 a9 8b 7c b9 8b 99 ba 97 aa 88 88 78 56 44 44 44
					29 01 00 00 00 00 02 00 00
					29 01 00 00 00 00 02 C6 16
					29 01 00 00 00 00 13 C7 90 99 9a 8b 8b a8 8b 99 aa 98 a9 88 88 78 56 55 55 44
					29 01 00 00 00 00 02 00 00
					29 01 00 00 00 00 02 C6 17
					29 01 00 00 00 00 13 C7 90 a8 99 7b 7c a8 8b 89 aa 88 a9 88 88 88 67 55 55 55
					29 01 00 00 00 00 02 00 00
					29 01 00 00 00 00 02 C6 18
					29 01 00 00 00 00 13 C7 80 99 99 8a 7b 89 8c 98 99 89 a8 88 88 88 67 66 56 55
					29 01 00 00 00 00 02 00 00
					29 01 00 00 00 00 02 C6 19
					29 01 00 00 00 00 13 C7 80 89 a9 89 7b 88 7c 89 a9 88 a8 88 88 88 67 66 66 66
					29 01 00 00 00 00 02 00 00
					29 01 00 00 00 00 02 C6 1A
					29 01 00 00 00 00 13 C7 80 98 99 89 7a 79 7c 89 a8 98 97 88 88 88 78 77 66 66
					29 01 00 00 00 00 02 00 00
					29 01 00 00 00 00 02 C6 1B
					29 01 00 00 00 00 13 C7 80 98 98 89 7a 79 7b 89 a8 97 88 88 88 88 78 77 77 67
					29 01 00 00 00 00 02 00 00
					29 01 00 00 00 00 02 C6 1C
					29 01 00 00 00 00 13 C7 80 98 98 89 7a 79 8a 89 a8 97 88 88 88 88 78 77 77 67
					29 01 00 00 00 00 02 00 00
					29 01 00 00 00 00 02 C6 1D
					29 01 00 00 00 00 13 C7 80 88 89 89 7a 88 89 89 98 88 88 88 88 88 88 78 77 77
					29 01 00 00 00 00 02 00 00
					29 01 00 00 00 00 02 C6 1E
					29 01 00 00 00 00 13 C7 80 88 98 88 89 88 89 88 98 88 88 88 88 88 88 88 78 77
					29 01 00 00 00 00 02 00 00
					29 01 00 00 00 00 02 C6 1F
					29 01 00 00 00 00 13 C7 80 88 88 88 89 97 88 98 97 88 88 88 88 88 88 88 88 78
					29 01 00 00 00 00 02 00 00
					29 01 00 00 00 00 02 C6 00
					29 01 00 00 00 00 02 00 80
					29 01 00 00 00 00 03 FF 00 00
					29 01 00 00 00 00 02 00 00
					29 01 00 00 00 00 04 FF 00 00 00
					29 00 00 00 00 00 02 53 24
					29 01 00 00 00 00 02 55 01
					29 01 00 00 00 00 02 5E 28
					29 00 00 00 00 00 02 35 00
					15 00 00 00 00 00 02 51 00
					29 00 00 00 00 00 05 2A 00 00 04 37
					29 00 00 00 00 00 05 2B 00 00 07 7F
					05 01 00 00 78 00 02 11 00
					05 01 00 00 28 00 02 29 00];
		qcom,mdss-dsi-off-command = [05 01 00 00 28 00 02 28 00
					05 01 00 00 78 00 02 10 00];
		qcom,mdss-dsi-on-command-state = "dsi_lp_mode";
		qcom,mdss-dsi-off-command-state = "dsi_hs_mode";
		qcom,mdss-dsi-h-sync-pulse = <1>;
		qcom,mdss-dsi-traffic-mode = "burst_mode";
		qcom,mdss-dsi-lane-map = "lane_map_0123";
		qcom,mdss-dsi-bllp-eof-power-mode;
		qcom,mdss-dsi-bllp-power-mode;
		qcom,mdss-dsi-lane-0-state;
		qcom,mdss-dsi-lane-1-state;
		qcom,mdss-dsi-lane-2-state;
		qcom,mdss-dsi-lane-3-state;
		qcom,mdss-dsi-te-pin-select = <1>;
		qcom,mdss-dsi-te-v-sync-rd-ptr-irq-line = <0x2c>;
		qcom,mdss-dsi-te-dcs-command = <1>;
		qcom,mdss-dsi-te-check-enable;
		qcom,mdss-dsi-te-using-te-pin;
		qcom,mdss-dsi-panel-timings = [E6 38 26 00 68 6c 2a 3c 2c 03 04 00];
		qcom,mdss-dsi-t-clk-post = <0x2c>;
		qcom,mdss-dsi-t-clk-pre = <0x1c>;
		qcom,mdss-dsi-bl-min-level = <4>;
		qcom,mdss-dsi-bl-max-level = <250>;
		qcom,mdss-dsi-dma-trigger = "trigger_sw";
		qcom,mdss-dsi-mdp-trigger = "none";
		qcom,mdss-dsi-bl-pmic-control-type = "bl_ctrl_dcs";
		qcom,panel-cabc-ui-cmds = [15 01 00 00 00 00 02 55 01
					15 01 00 00 00 00 02 53 24];
		qcom,panel-cabc-video-cmds = [15 01 00 00 00 00 02 55 03
					   15 01 00 00 00 00 02 53 2C];
		qcom,cabc-ui-cmds-dsi-state = "dsi_lp_mode";
		qcom,cabc-video-cmds-dsi-state = "dsi_lp_mode";
		qcom,panel-dot-inversion-mode-cmds = [29 01 00 00 00 00 02 00 00
                          29 01 00 00 00 00 04 FF 19 06 01
                          29 01 00 00 00 00 02 00 80
                          29 01 00 00 00 00 03 FF 19 06
                          29 01 00 00 00 00 02 00 B3
                          29 01 00 00 00 00 02 C0 00
                          29 01 00 00 00 00 02 00 80
                          29 01 00 00 00 00 03 FF 00 00
                          29 01 00 00 00 00 02 00 00
                          29 01 00 00 00 00 04 FF 00 00 00];
		qcom,panel-column-inversion-mode-cmds = [29 01 00 00 00 00 02 00 00
                             29 01 00 00 00 00 04 FF 19 06 01
                             29 01 00 00 00 00 02 00 80
                             29 01 00 00 00 00 03 FF 19 06
                             29 01 00 00 00 00 02 00 B3
                             29 01 00 00 00 00 02 C0 88
                             29 01 00 00 00 00 02 00 80
                             29 01 00 00 00 00 03 FF 00 00
                             29 01 00 00 00 00 02 00 00
                             29 01 00 00 00 00 04 FF 00 00 00];
		qcom,dot-inversion-cmds-dsi-state = "dsi_lp_mode";
		qcom,column-inversion-cmds-dsi-state = "dsi_lp_mode";
		qcom,panel-esd-check-enabled;
		qcom,panel-esd-read-commands = [06 01 00 00 00 00 02 0A 9C];
		qcom,mdss-dsi-lp11-init;
		qcom,mdss-pan-physical-width-dimension = <68>;
		qcom,mdss-pan-physical-height-dimension = <121>;
		qcom,mdss-dsi-mipi-rst-delay = <80>;
		huawei,mdss-dsi-lens-type = <2>;
			qcom,mdss-dsi-reset-sequence = <1 15>, <0 5>, <1 15>;

	};
};
