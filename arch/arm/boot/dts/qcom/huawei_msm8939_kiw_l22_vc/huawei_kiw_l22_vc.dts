/* Copyright (c) 2014, The Linux Foundation. All rights reserved.
 *
 * This program is free software; you can redistribute it and/or modify
 * it under the terms of the GNU General Public License version 2 and
 * only version 2 as published by the Free Software Foundation.
 *
 * This program is distributed in the hope that it will be useful,
 * but WITHOUT ANY WARRANTY; without even the implied warranty of
 * MERCHANTABILITY or FITNESS FOR A PARTICULAR PURPOSE.  See the
 * GNU General Public License for more details.
 */
/dts-v1/;
#include "msm8939.dtsi"
#include "msm8939-qrd-skuk.dtsi"
#include "huawei_msm8939_kiw_l22_vc/huawei.dtsi"
/ {
	model = "Qualcomm MSM 8939 HUAWEI KIW-L22";
	compatible = "qcom,msm8939-qrd-skuk", "qcom,msm8939", "qcom,qrd";
	qcom,board-id = <8103 0> , <8103 4>;
	huawei,modem_id = <0xFFB40107 0x0>;
};