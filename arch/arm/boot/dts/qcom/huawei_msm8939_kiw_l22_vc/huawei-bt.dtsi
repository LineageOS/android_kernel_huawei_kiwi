 / {
        huawei_bt_info {
                  compatible = "huawei,hw_bt_info";
                  status = "ok";
                  bt,fw_ver = "QCOM_WCN3620_2.0.1";
                  bt,chiptype = "BT_FM_QUALCOMM_WCN3620";
        };
};
