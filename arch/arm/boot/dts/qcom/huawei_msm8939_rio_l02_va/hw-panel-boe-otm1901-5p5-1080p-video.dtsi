/* Copyright (c) 2013, The Linux Foundation. All rights reserved.
 *
 * This program is free software; you can redistribute it and/or modify
 * it under the terms of the GNU General Public License version 2 and
 * only version 2 as published by the Free Software Foundation.
 *
 * This program is distributed in the hope that it will be useful,
 * but WITHOUT ANY WARRANTY; without even the implied warranty of
 * MERCHANTABILITY or FITNESS FOR A PARTICULAR PURPOSE.  See the
 * GNU General Public License for more details.
 */

/*---------------------------------------------------------------------------
 * This file is autogenerated file using gcdb parser. Please do not edit it.
 * Update input XML file to add a new entry or update variable in this file
 * VERSION = "1.0"
 *---------------------------------------------------------------------------*/
&mdss_mdp {
	dsi_boe_otm1901_5p5_1080p_video: qcom,mdss_dsi_boe_otm1901_5p5_1080p_video {
		qcom,mdss-dsi-panel-name = "BOE_OTM1901_5P5_1080P_VIDEO";
		qcom,cont-splash-enabled;
		qcom,mdss-dsi-panel-controller = <&mdss_dsi0>;
		qcom,mdss-dsi-panel-type = "dsi_video_mode";
		qcom,mdss-dsi-panel-destination = "display_1";
		qcom,mdss-dsi-panel-clockrate = <898000000>;
		qcom,mdss-dsi-panel-framerate = <60>;
		qcom,mdss-dsi-virtual-channel-id = <0>;
		qcom,mdss-dsi-stream = <0>;
		qcom,mdss-dsi-panel-width = <1080>;
		qcom,mdss-dsi-panel-height = <1920>;
		qcom,mdss-dsi-h-front-porch = <108>;
		qcom,mdss-dsi-h-back-porch = <96>;
		qcom,mdss-dsi-h-pulse-width = <8>;
		qcom,mdss-dsi-h-sync-skew = <0>;
		qcom,mdss-dsi-v-back-porch = <3>;
		qcom,mdss-dsi-v-front-porch = <7>;
		qcom,mdss-dsi-v-pulse-width = <2>;
		qcom,mdss-dsi-h-left-border = <0>;
		qcom,mdss-dsi-h-right-border = <0>;
		qcom,mdss-dsi-v-top-border = <0>;
		qcom,mdss-dsi-v-bottom-border = <0>;
		qcom,mdss-dsi-bpp = <24>;
		qcom,mdss-dsi-underflow-color = <0x00>;
		qcom,mdss-dsi-border-color = <0>;
		qcom,mdss-dsi-color-order = "rgb_swap_rgb";
		qcom,mdss-dsi-on-command = [29 01 00 00 00 00 02 00 00
				    29 01 00 00 00 00 04 FF 19 01 01
				    29 01 00 00 00 00 02 00 80
				    29 01 00 00 00 00 03 FF 19 01
				    29 01 00 00 00 00 02 00 82
				    29 01 00 00 00 00 02 D6 02
				    29 01 00 00 00 00 02 00 00
				    29 01 00 00 00 00 B5 D4 00 40 00 40 00 40 00 40 00 40 00 40 00 40 00 40 00 40 00 40 00 40 00 40 00 40 00 40 00 40 00 40 00 40 00 40 00 40 00 40 00 40 00 40 00 40 00 40 00 40 00 40 00 40 00 40 00 40 00 40 00 40 00 40 00 40 00 40 00 40 00 40 00 40 00 40 00 40 00 40 00 40 00 40 00 40 00 40 00 40 00 40 00 40 00 40 00 40 00 40 00 40 00 40 00 40 00 40 00 40 00 40 00 40 00 40 00 40 00 40 00 40 00 40 00 40 00 40 00 40 00 40 00 40 00 40 00 40 00 40 00 40 00 40 00 40 00 40 00 40 00 40 00 40 00 40 00 40 00 40 00 40 00 40 00 40 00 40 00 40 00 40 00 40 00 40 00 40 00 40
				    29 01 00 00 00 00 B5 D4 00 40 00 40 00 40 00 40 00 40 00 40 00 40 00 40 00 40 00 40 00 40 00 40 00 40 00 40 00 40 00 40 00 40 00 40 00 40 00 40 00 40 00 40 00 40 00 40 00 40 00 40 00 40 00 40 00 40 00 40 00 40 00 40 00 40 00 40 00 40 00 40 00 40 00 40 00 40 00 40 00 40 00 40 00 40 00 40 00 40 00 40 00 40 00 40 00 40 00 40 00 40 00 40 00 40 00 40 00 40 00 40 00 40 00 40 00 40 00 40 00 40 00 40 00 40 00 40 00 40 00 40 00 40 00 40 00 40 00 40 00 40 00 40 00 40 00 40 00 40 00 40 00 40 00 40 00 40 00 40 00 40 00 40 00 40 00 40 00 40 00 40 00 40 00 40 00 40 00 40
				    29 01 00 00 00 00 B5 D4 fc 47 fc 47 fb 47 fb 47 fb 47 fb 47 fb 47 fb 47 fa 47 fa 47 fa 47 fa 47 fa 47 fa 47 f9 47 f9 47 f9 46 fa 45 fa 45 fa 44 fa 44 fa 43 fa 43 fa 42 fa 41 fa 41 fa 40 fa 40 fa 3f fb 3f fb 3e fc 3e fd 3f fe 3f ff 3f ff 40 01 40 02 40 02 40 03 40 05 41 06 41 06 41 07 41 09 41 09 41 08 42 08 42 06 43 06 43 05 44 04 44 03 45 02 45 01 46 01 46 00 46 ff 47 fe 47 fd 47 fc 48 fc 48 fc 48 fd 48 fd 49 fd 49 fd 49 fd 49 ff 4a ff 4a ff 4a ff 4a ff 4b 00 4b 00 4b 00 4b 00 4b ff 4b ff 4b ff 4b ff 4c fe 4c fd 4c fd 4c fd 4c fd 4c fc 4c fc 4c fc 4c fb 4c
				    29 01 00 00 00 00 B5 D4 fb 4c fb 4c fb 4c fb 4c fb 4c fb 4c fb 4c fc 4c fc 4c fc 4c fc 4d fc 4d fc 4d fc 4d fc 4d fc 4d fc 4d fc 4d fc 4d fc 4d fd 4d fd 4d fd 4d fd 4d fd 4d fd 4d fd 4d ff 4d ff 4d ff 4d ff 4d ff 4d 00 4d 00 4d 01 4d 01 4d 01 4d 03 4e 03 4e 03 4e 04 4e 04 4e 05 4e 05 4e 05 4e 07 4e 07 4d 07 4d 07 4d 07 4d 07 4c 07 4c 07 4c 08 4b 08 4b 08 4b 08 4a 08 4a 08 4a 08 49 08 49 08 49 08 48 08 48 08 48 07 47 07 47 07 47 07 46 07 46 07 45 07 45 07 45 07 44 07 44 07 44 06 44 05 44 05 44 04 45 04 45 02 45 02 45 01 46 00 46 00 46 ff 46 fe 46 fe 47 fc 47
				    29 01 00 00 00 00 02 00 00
				    29 01 00 00 00 00 B5 D5 02 48 02 48 01 47 01 47 01 46 01 46 01 45 01 45 01 45 00 44 00 44 00 43 00 43 00 42 00 42 00 42 ff 42 ff 42 ff 42 ff 42 ff 42 fe 42 fe 41 fe 41 fe 41 fe 41 fe 41 fd 41 fd 41 fd 41 fd 41 fd 42 fd 42 fd 42 fd 42 fd 42 fd 42 fd 43 fd 43 fc 43 fc 43 fc 43 fc 43 fc 44 fc 44 fc 44 fc 44 fc 44 fe 45 fe 45 fe 45 fe 45 fe 46 ff 46 ff 46 ff 46 ff 47 ff 47 00 47 00 47 00 47 00 48 00 48 00 48 00 48 00 48 00 48 00 48 00 49 00 49 00 49 00 49 00 49 00 49 00 49 00 49 00 49 00 48 00 47 00 47 00 46 00 46 00 45 00 44 00 44 00 43 00 42 00 42 00 41 00 40
				    29 01 00 00 00 00 B5 D5 00 40 00 40 00 40 00 40 00 40 00 40 00 40 00 40 00 40 00 40 00 40 00 40 00 40 00 40 00 40 00 40 00 40 00 40 00 40 00 40 00 40 00 40 00 40 00 40 00 40 00 40 00 40 00 40 00 40 00 40 00 40 00 40 00 40 00 40 00 40 00 40 00 40 00 40 00 40 00 40 00 40 00 40 00 40 00 40 00 40 00 40 00 40 00 40 00 40 00 40 00 40 00 40 00 40 00 40 00 40 00 40 00 40 00 40 00 40 00 40 00 40 00 40 00 40 00 40 00 40 00 40 00 40 00 40 00 40 00 40 00 40 00 40 00 40 00 40 00 40 00 40 00 41 00 41 00 42 01 42 01 43 01 43 01 44 01 44 01 45 01 46 01 46 01 47 02 47 03 48
				    29 01 00 00 00 00 B5 D5 ff 38 fe 39 fe 39 fe 3a fe 3a fe 3b fd 3b fd 3b fd 3c fd 3c fd 3d fc 3d fc 3d fc 3e fc 3e fc 3e fb 3e fb 3d fb 3c fb 3b fb 3a fa 3a fa 39 fa 38 fa 37 fa 37 fa 36 fa 35 fa 34 fa 33 fa 33 fa 33 fb 34 fb 35 fc 35 fd 36 fd 36 fe 37 ff 37 ff 38 00 38 00 39 01 39 02 3a 03 3a 03 3b 03 3b 03 3c 02 3c 02 3d 02 3d 02 3d 02 3e 01 3e 01 3f 01 3f 01 40 01 40 00 41 00 41 00 42 00 42 00 43 00 43 00 43 00 44 00 44 00 45 00 45 00 46 00 46 00 46 00 47 00 47 00 48 00 48 ff 49 ff 49 ff 49 fd 4a fd 4a fd 4b fc 4b fc 4b fb 4c fb 4c fb 4c f9 4d f9 4d f9 4e
				    29 01 00 00 00 00 B5 D5 f8 4e f8 4e f8 4f f8 4f f9 50 f9 50 f9 50 f9 51 f9 51 f9 52 f9 52 fa 52 fa 53 fa 53 fa 54 fa 54 fa 54 fb 54 fc 54 fc 53 fc 53 fc 53 fd 53 fd 53 fd 53 fe 52 ff 52 ff 52 ff 52 ff 52 00 52 ff 52 ff 52 ff 51 fd 51 fd 51 fd 51 fc 51 fc 51 fc 51 fb 51 fa 50 fa 50 fa 50 f9 50 fa 50 fb 4f fd 4f fe 4e ff 4e 01 4d 02 4d 03 4c 05 4b 07 4a 08 4a 09 49 0a 48 0b 47 0c 47 0e 46 0d 45 0d 45 0d 44 0d 43 0d 42 0d 42 0d 41 0d 40 0c 40 0c 3f 0c 3e 0c 3e 0c 3d 0c 3c 0b 3c 0b 3c 09 3c 08 3b 08 3b 07 3b 06 3b 05 3b 04 3a 04 3a 03 3a 02 39 01 39 00 39 ff 39
				    29 01 00 00 00 00 02 00 00
				    29 01 00 00 00 00 02 1C 33
				    29 01 00 00 00 00 02 00 A0
				    29 01 00 00 00 00 02 C1 E8
				    29 01 00 00 00 00 02 00 A7
				    29 01 00 00 00 00 02 C1 00
				    29 01 00 00 00 00 02 00 90
				    29 01 00 00 00 00 07 C0 00 2F 00 00 00 01
				    29 01 00 00 00 00 02 00 C0
				    29 01 00 00 00 00 07 C0 00 2F 00 00 00 01
				    29 01 00 00 00 00 02 00 9A
				    29 01 00 00 00 00 02 C0 1E
				    29 01 00 00 00 00 02 00 AC
				    29 01 00 00 00 00 02 C0 06
				    29 01 00 00 00 00 02 00 DC
				    29 01 00 00 00 00 02 C0 06
				    29 01 00 00 00 00 02 00 81
				    29 01 00 00 00 00 02 A5 04
				    29 01 00 00 00 00 02 00 84
				    29 01 00 00 00 00 02 C4 20
				    29 01 00 00 00 00 02 00 A5
				    29 01 00 00 00 00 02 B3 1D
				    29 01 00 00 00 00 02 00 92
				    29 01 00 00 00 00 02 E9 00
				    29 01 00 00 00 00 02 00 90
				    29 01 00 00 00 00 02 F3 01
				    29 01 00 00 00 00 02 00 93
				    29 01 00 00 00 00 02 C5 19
				    29 01 00 00 00 00 02 00 95
				    29 01 00 00 00 00 02 C5 2D
				    29 01 00 00 00 00 02 00 97
				    29 01 00 00 00 00 02 C5 14
				    29 01 00 00 00 00 02 00 99
				    29 01 00 00 00 00 02 C5 29
				    29 01 00 00 00 00 02 00 00
				    29 01 00 00 00 00 03 D8 1D 1D
				    29 01 00 00 00 00 02 00 B3
				    29 01 00 00 00 00 02 C0 CC
				    29 01 00 00 00 00 02 00 BC
				    29 01 00 00 00 00 02 C0 00
				    29 01 00 00 00 00 02 00 F7
				    29 01 00 00 00 00 05 C3 04 18 04 04
				    29 01 00 00 00 00 02 00 81
				    29 01 00 00 00 00 02 A5 07
				    29 01 00 00 00 00 02 00 9D
				    29 01 00 00 00 00 02 C5 77
				    29 01 00 00 00 00 02 00 9B
				    29 01 00 00 00 00 03 C5 55 55
				    29 01 00 00 00 00 02 00 80
				    29 01 00 00 00 00 02 C4 15
				    29 01 00 00 00 00 02 00 00
				    29 01 00 00 00 00 19 E1 11 17 17 1e 22 27 2f 3d 45 57 61 6a 8e 85 7c 68 53 42 34 2d 25 1c 17 03
				    29 01 00 00 00 00 02 00 00
				    29 01 00 00 00 00 19 E2 11 17 17 1e 22 27 2f 3d 45 57 61 6a 8e 85 7c 68 53 42 34 2d 25 1c 17 03
				    29 01 00 00 00 00 02 00 00
				    29 01 00 00 00 00 19 E3 1c 1E 21 25 2a 2e 36 43 49 5a 63 6b 8d 84 7b 68 53 42 34 2d 25 1c 17 03
				    29 01 00 00 00 00 02 00 00
				    29 01 00 00 00 00 19 E4 1c 1E 21 25 2a 2e 36 43 49 5a 63 6b 8d 84 7b 68 53 42 34 2d 25 1c 17 03
				    29 01 00 00 00 00 02 00 00
				    29 01 00 00 00 00 19 E5 00 04 07 0e 15 1b 25 36 40 53 5f 68 8f 86 7c 6a 54 43 35 2e 26 1c 17 03
				    29 01 00 00 00 00 02 00 00
				    29 01 00 00 00 00 19 E6 00 04 07 0e 15 1b 25 36 40 53 5f 68 8f 86 7c 6a 54 43 35 2e 26 1c 17 03
				    29 01 00 00 00 00 02 00 90
				    29 01 00 00 00 00 0A CA ed ff b9 ff a6 ff 53 53 53
				    29 01 00 00 00 00 02 00 00
				    29 01 00 00 00 00 02 C6 10
				    29 01 00 00 00 00 13 C7 90 cb ba bd a8 cb a9 ab bc ac bb 8b 78 46 23 11 11 11
				    29 01 00 00 00 00 02 00 00
				    29 01 00 00 00 00 02 C6 11
				    29 01 00 00 00 00 13 C7 90 bb ba ac 99 cb a9 aa bb bb ba 8a 78 56 34 22 22 11
				    29 01 00 00 00 00 02 00 00
				    29 01 00 00 00 00 02 C6 12
				    29 01 00 00 00 00 13 C7 90 ba aa ac 99 bb 99 ba ba ba aa 8a 88 67 35 22 22 22
				    29 01 00 00 00 00 02 00 00
				    29 01 00 00 00 00 02 C6 13
				    29 01 00 00 00 00 13 C7 80 ab aa bb 88 bb 99 aa aa bb a9 89 88 67 45 33 33 23
				    29 01 00 00 00 00 02 00 00
				    29 01 00 00 00 00 02 C6 14
				    29 01 00 00 00 00 13 C7 80 9b aa ba 88 ca 98 aa 9a ba 9a 89 88 78 56 33 33 33
				    29 01 00 00 00 00 02 00 00
				    29 01 00 00 00 00 02 C6 15
				    29 01 00 00 00 00 13 C7 80 aa a9 aa 89 ba 98 a9 9a aa 9a 89 88 78 56 44 44 33
				    29 01 00 00 00 00 02 00 00
				    29 01 00 00 00 00 02 C6 16
				    29 01 00 00 00 00 13 C7 80 9a 9a aa 98 b9 98 99 a9 a9 aa 88 88 88 67 44 44 44
				    29 01 00 00 00 00 02 00 00
				    29 01 00 00 00 00 02 C6 17
				    29 01 00 00 00 00 13 C7 80 a9 99 a9 89 a9 89 a9 99 a9 a9 88 88 88 67 55 55 44
				    29 01 00 00 00 00 02 00 00
				    29 01 00 00 00 00 02 C6 18
				    29 01 00 00 00 00 13 C7 80 99 99 a9 98 b8 88 99 99 99 aa 88 88 88 68 55 55 55
				    29 01 00 00 00 00 02 00 00
				    29 01 00 00 00 00 02 C6 19
				    29 01 00 00 00 00 13 C7 80 99 89 a9 88 b8 88 99 89 99 a9 89 88 88 78 66 55 55
				    29 01 00 00 00 00 02 00 00
				    29 01 00 00 00 00 02 C6 1a
				    29 01 00 00 00 00 13 C7 80 98 89 99 89 a8 88 99 98 98 9a 89 88 88 78 66 66 56
				    29 01 00 00 00 00 02 00 00
				    29 01 00 00 00 00 02 C6 1b
				    29 01 00 00 00 00 13 C7 70 99 98 99 88 98 89 88 99 98 98 89 88 88 88 77 66 66
				    29 01 00 00 00 00 02 00 00
				    29 01 00 00 00 00 02 C6 1c
				    29 01 00 00 00 00 13 C7 80 98 98 99 88 98 89 88 99 98 98 89 88 88 88 77 66 66
				    29 01 00 00 00 00 02 00 00
				    29 01 00 00 00 00 02 C6 1d
				    29 01 00 00 00 00 13 C7 80 88 89 98 88 a8 88 98 88 98 98 89 88 88 88 77 77 67
				    29 01 00 00 00 00 02 00 00
				    29 01 00 00 00 00 02 C6 1e
				    29 01 00 00 00 00 13 C7 80 88 98 88 89 98 88 88 98 88 98 88 88 88 88 88 77 77
				    29 01 00 00 00 00 02 00 00
				    29 01 00 00 00 00 02 C6 1f
				    29 01 00 00 00 00 13 C7 80 88 88 88 88 98 88 88 88 89 88 88 88 88 88 88 88 78
				    29 01 00 00 00 00 02 00 00
				    29 01 00 00 00 00 02 C6 00
				    29 01 00 00 00 00 02 00 80
				    29 01 00 00 00 00 0F C0 00 87 00 0A 0A 00 87 0A 0A 00 87 00 0A 0A
				    29 01 00 00 00 00 02 00 F0
				    29 01 00 00 00 00 07 C3 22 02 00 00 00 0C
				    29 01 00 00 00 00 02 00 A0
				    29 01 00 00 00 00 08 C0 00 00 00 00 03 22 03
				    29 01 00 00 00 00 02 00 D0
				    29 01 00 00 00 00 08 C0 00 00 00 00 03 22 03
				    29 01 00 00 00 00 02 00 90
				    29 01 00 00 00 00 09 C2 83 01 00 00 82 01 00 00
				    29 01 00 00 00 00 02 00 80
				    29 01 00 00 00 00 0D C3 82 02 03 00 03 84 81 03 03 00 03 84
				    29 01 00 00 00 00 02 00 90
				    29 01 00 00 00 00 0D C3 00 01 03 00 03 84 01 02 03 00 03 84
				    29 01 00 00 00 00 02 00 80
				    29 01 00 00 00 00 10 CC 09 0A 11 12 13 14 15 16 17 18 28 28 28 28 28
				    29 01 00 00 00 00 02 00 90
				    29 01 00 00 00 00 10 CC 0A 09 14 13 12 11 15 16 17 18 28 28 28 28 28
				    29 01 00 00 00 00 02 00 A0
				    29 01 00 00 00 00 10 CC 1D 1E 1F 19 1A 1B 1C 20 21 22 23 24 25 26 27
				    29 01 00 00 00 00 02 00 B0
				    29 01 00 00 00 00 09 CC 01 02 03 05 06 07 04 08
				    29 01 00 00 00 00 02 00 C0
				    29 01 00 00 00 00 0D CC 00 00 00 00 00 00 00 00 00 00 00 77
				    29 01 00 00 00 00 02 00 D0
				    29 01 00 00 00 00 0D CC 00 00 00 00 05 00 00 00 00 00 00 77
				    29 01 00 00 00 00 02 00 80
				    29 01 00 00 00 00 10 CB 00 00 00 00 00 00 00 00 00 00 00 00 00 00 00
				    29 01 00 00 00 00 02 00 90
				    29 01 00 00 00 00 10 CB 00 00 00 00 00 00 00 00 00 00 00 00 00 00 00
				    29 01 00 00 00 00 02 00 A0
				    29 01 00 00 00 00 10 CB 01 01 01 01 01 01 00 00 00 00 00 00 00 00 00
				    29 01 00 00 00 00 02 00 B0
				    29 01 00 00 00 00 10 CB 00 01 FD 00 00 00 00 00 00 00 00 00 00 00 00
				    29 01 00 00 00 00 02 00 C0
				    29 01 00 00 00 00 09 CB 00 00 00 00 00 00 77 77
				    29 01 00 00 00 00 02 00 D0
				    29 01 00 00 00 00 09 CB 00 00 00 00 00 00 77 77
				    29 01 00 00 00 00 02 00 E0
				    29 01 00 00 00 00 09 CB 00 00 00 00 00 00 77 77
				    29 01 00 00 00 00 02 00 F0
				    29 01 00 00 00 00 09 CB 01 01 01 00 00 00 77 77
				    29 01 00 00 00 00 02 00 80
				    29 01 00 00 00 00 10 CD 3F 3F 3F 3F 3F 3F 3F 3F 3F 02 12 11 3F 04 3F
				    29 01 00 00 00 00 02 00 90
				    29 01 00 00 00 00 0C CD 06 3F 3F 26 26 26 21 20 1F 26 26
				    29 01 00 00 00 00 02 00 A0
				    29 01 00 00 00 00 10 CD 3F 3F 3F 3F 3F 3F 3F 3F 3F 01 12 11 3F 03 3F
				    29 01 00 00 00 00 02 00 B0
				    29 01 00 00 00 00 0C CD 05 3F 3F 26 26 26 21 20 1F 26 26
				    29 01 00 00 00 00 02 00 B0
				    29 01 00 00 00 00 02 CA 01
				    15 01 00 00 00 00 02 81 80
				    15 01 00 00 00 00 02 55 01
				    15 01 00 00 00 00 02 5E 28
				    15 01 00 00 00 00 02 53 24
				    15 01 00 00 00 00 02 51 00
				    29 01 00 00 00 00 02 00 00
				    29 01 00 00 00 00 04 FF FF FF FF
				    05 01 00 00 78 00 02 11 00
				    05 01 00 00 14 00 02 29 00
				    29 01 00 00 00 00 02 00 00
				    29 01 00 00 01 00 03 99 11 11];
		qcom,mdss-dsi-off-command = [29 01 00 00 00 00 02 00 00
				    29 01 00 00 01 00 03 99 95 27
				    05 01 00 00 28 00 02 28 00
				    05 01 00 00 78 00 02 10 00];
		qcom,mdss-dsi-on-command-state = "dsi_lp_mode";
		qcom,mdss-dsi-off-command-state = "dsi_hs_mode";
		qcom,mdss-dsi-h-sync-pulse = <1>;
		qcom,mdss-dsi-traffic-mode = "burst_mode";
		qcom,mdss-dsi-lane-map = "lane_map_0123";
		qcom,mdss-dsi-bllp-eof-power-mode;
		qcom,mdss-dsi-bllp-power-mode;
		qcom,mdss-dsi-lane-0-state;
		qcom,mdss-dsi-lane-1-state;
		qcom,mdss-dsi-lane-2-state;
		qcom,mdss-dsi-lane-3-state;
		qcom,mdss-dsi-panel-timings = [e6 38 26 00 68 6e 2a 3c 2c 03 04 00];
		qcom,mdss-dsi-t-clk-post = <0x1e>;
		qcom,mdss-dsi-t-clk-pre = <0x38>;
		qcom,mdss-dsi-bl-min-level = <4>;
		qcom,mdss-dsi-bl-max-level = <250>;
		qcom,mdss-dsi-dma-trigger = "trigger_sw";
		qcom,mdss-dsi-mdp-trigger = "none";
		qcom,mdss-dsi-bl-pmic-control-type = "bl_ctrl_dcs";
		qcom,panel-cabc-ui-cmds = [29 01 00 00 00 00 02 00 00
					29 01 00 00 01 00 03 99 95 27
					15 01 00 00 00 00 02 55 01
					15 01 00 00 00 00 02 53 24
					29 01 00 00 00 00 02 00 00
					29 01 00 00 01 00 03 99 11 11];
		qcom,panel-cabc-video-cmds = [29 01 00 00 00 00 02 00 00
					29 01 00 00 01 00 03 99 95 27
					15 01 00 00 00 00 02 55 03
					15 01 00 00 00 00 02 53 2C
					29 01 00 00 00 00 02 00 00
					29 01 00 00 01 00 03 99 11 11];
		qcom,cabc-ui-cmds-dsi-state = "dsi_hs_mode";
		qcom,cabc-video-cmds-dsi-state = "dsi_lp_mode";
		qcom,panel-dot-inversion-mode-cmds = [29 01 00 00 00 00 02 00 00
					29 01 00 00 00 00 05 FF 19 01 01 00
					29 01 00 00 00 00 02 00 80
					29 01 00 00 00 00 03 FF 19 01
					29 01 00 00 00 00 02 00 B3
					29 01 00 00 00 00 02 C0 DD
					29 01 00 00 00 00 02 00 BC
					29 01 00 00 00 00 02 C0 11
					29 01 00 00 00 00 02 00 00
					29 01 00 00 00 00 02 FB 01
					29 01 00 00 00 00 02 00 00
					29 01 00 00 00 00 04 FF FF FF FF];
		qcom,panel-column-inversion-mode-cmds = [29 01 00 00 00 00 02 00 00
					29 01 00 00 00 00 05 FF 19 01 01 00
					29 01 00 00 00 00 02 00 80
					29 01 00 00 00 00 03 FF 19 01
					29 01 00 00 00 00 02 00 B3
					29 01 00 00 00 00 02 C0 CC
					29 01 00 00 00 00 02 00 BC
					29 01 00 00 00 00 02 C0 00
					29 01 00 00 00 00 02 00 00
					29 01 00 00 00 00 02 FB 01
					29 01 00 00 00 00 02 00 00
					29 01 00 00 00 00 04 FF FF FF FF];
		qcom,dot-inversion-cmds-dsi-state = "dsi_lp_mode";
		qcom,column-inversion-cmds-dsi-state = "dsi_lp_mode";
		qcom,panel-frame_crc_read_cmds = [AA];
		qcom,panel-frame-checksum-support;
		qcom,panel-frame_crc_read_cmds_value = [78 5e d7];
		qcom,mdss-dsi-lp11-init;
		qcom,mdss-pan-physical-width-dimension = <68>;
		qcom,mdss-pan-physical-height-dimension = <121>;
			qcom,mdss-dsi-reset-sequence = <1 5>, <0 5>, <1 15>;

	};
};
