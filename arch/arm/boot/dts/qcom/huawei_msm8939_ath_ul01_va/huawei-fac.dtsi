 / {
        huawei_fac_info {
                  compatible = "huawei,hw_fac_info";
                  fac,product_name = "HUAWEI ATH-UL01";
                  fac,hardware_ver = "HL1ATHUL01M";
                  fac,software_ver = "MSM8939_ATH_UL01_VA";
                  status = "ok";
        };
};
