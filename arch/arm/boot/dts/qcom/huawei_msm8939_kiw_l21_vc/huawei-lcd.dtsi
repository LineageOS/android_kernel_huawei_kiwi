/*---------------------------------------------------------------------------
 * This file is autogenerated file using huawei LCD parser. Please do not edit it.
 * Update input XML file to add a new entry or update variable in this file
 * Parser location: device/qcom/common/display/tools/huawei_lcd_panel 
 *---------------------------------------------------------------------------*/


#include "hw-panel-auo-otm1901a-5p5-1080pxa-video.dtsi"
#include "hw-panel-boe-otm1901a-5p5-1080pxa-video.dtsi"
#include "hw-panel-cmi-nt35532-5p5-1080pxa-video-old.dtsi"
#include "hw-panel-cmi-nt35532-5p5-1080pxa-video.dtsi"
#include "hw-panel-tianma-nt35596-5p5-1080pxa-video.dtsi"
#include "hw-panel-truly-hx8399a-5p5-1080pxa-video.dtsi"
