## Kconfig
```kconfig
#
# For a description of the syntax of this configuration file,
# see Documentation/kbuild/kconfig-language.txt.
#
mainmenu "Linux/$ARCH $KERNELVERSION Kernel Configuration"

config SRCARCH
	string
	option env="SRCARCH"

config HUAWEI_KERNEL
	bool "Use huawei code"
	default y
	help
	use huawei code

config HUAWEI_KERNEL_DEBUG
	bool "Use Huawei kernel debug mode"
	depends on HUAWEI_KERNEL
	default n
	help
	  Enable sysrq, dump mode and some debug masks by default.

config SELINUX_DMD_REPORT
	bool "Use selinux dmd report function"
	depends on HUAWEI_KERNEL
	default n
	help
	  Enable selinux dmd report function.

source "arch/$SRCARCH/Kconfig"
```

## drivers/huawei/store_exception/Kconfig
```kconfig
menu HUAWEI_LOG_MODULE

config  HUAWEI_LOG_MODULE
        default n
	bool "huawei log module"
	help
          huawei log module control

endmenu

menu HUAWEI_STORE_EXCEPTION

config  HUAWEI_STORE_EXCEPTION
        default n
	bool "huawei store exception"
	help
          huawei store exception control

endmenu
```

## drivers/huawei_platform/Kconfig
```kconfig
config HUAWEI_DRIVERS
	bool "huawei drivers"
	default y
	help
	  Say Y here if you want to build the huawei drivers.
	  If unsure, say N here.

config HUAWEI_SENSORS
	bool "huawei sensors"
	default y
	help
	  Say Y here if you want to build the huawei sensor drivers.If unsure, say N here.

source "drivers/huawei_platform/sensor/Kconfig"
```

## drivers/huawei_platform/sensor/lpsensor/Kconfig
```kconfig
config HUAWEI_LP_SENSORS_APDS993X
	tristate "Avago APDS993X combined als and proximity sensors"
	depends on I2C
	default n
	help
	  Say Y here if you want to build a driver for Avago APDS993X
	  combined ambient light and proximity sensor chip.
	  To compile this driver as a module, choose M here: the module will be called apds993x. If unsure, say N here.

config HUAWEI_LP_SENSORS_ROHM_RPR521
	tristate "ROHM RPR0521 combined als and proximity sensors"
	depends on I2C
	default n
	help
	  Say Y here if you want to build a driver for ROHM RPR0521 combined ambient light and proximity sensor chip.
	  To compile this driver as a module, choose M here: the module will be called rpr0521. If unsure, say N here.
```

## drivers/huawei_platform/touchscreen/Kconfig
```kconfig
config CYTTSP5_CS445A
	tristate "cypress cs445a touch screen driver"
	default n
	help
	  Say Y here if you have cypress touch device us cyttsp5 to connected to your system and want
	  it to be available to applications.
	  Say N here if you have no cypress touch device use cyttsp5 in your system.
	  If unsure, say Y.
	  To compile this driver as a module, choose M here: the
	  module will be called input.
source "drivers/huawei_platform/touchscreen/cyttsp5_cs445a/Kconfig"

config SYNAPTICS_DSX_S3207
	tristate "synaptics s3207 touch screen driver"
	default n
	help
	  Say Y here if you have synaptics s3207 device connected to your system and want
	  it to be available to applications.
	  Say N here if you have no synaptics s3207 device in your system.
	  If unsure, say Y.
	  To compile this driver as a module, choose M here: the
	  module will be called input.
source "drivers/huawei_platform/touchscreen/synaptics_dsx_s3207/Kconfig"
```
